//-----------------------------------------------------------------
//  名称: INT0中断计数
//-----------------------------------------------------------------
//  说明: 每次按下计数键时触发INT0中断,中断程序累加计数,
//		计数值显示在三只数码管上,按下清零键时数码管清零.
//
//-----------------------------------------------------------------
#include "STC15xxx.h"
#include <intrins.h>
#define u8 	unsigned char
#define u16	unsigned int
const u8 SEG_CODE[] =  //0~9的数字编码,最后一位为黑屏
 { 0xC0,0xF9,0xA4,0xB0,0x99,0x92,0x82,0xF8,0x80,0x90,0xFF };
//计数器值分解后的各待显示数位
u8 Display_Buffer[3] = {0,0,0};
u16 Count = 0;
sbit Clear_Key = P3^4;
#define MAIN_Fosc 12000000L			//时钟频率定义
//-----------------------------------------------------------------
// 延时函数(参数取值限于1~255)
//-----------------------------------------------------------------
void delay_ms(u8 ms) {
	u16 i;
	do{
		i = MAIN_Fosc / 13000;
		while(--i);
	}while(--ms);
}
//-----------------------------------------------------------------
// 在数码管上显示计数值
//-----------------------------------------------------------------
void Refresh_Display() {  





} 
//-----------------------------------------------------------------
// 主程序
//-----------------------------------------------------------------
void main() { 
	P0M1 = 0x00; P0M0 = 0x00;			//P0,P1,P2,P3配置为准双向口
	P1M1 = 0x00; P1M0 = 0x00;
	P2M1 = 0x00; P2M0 = 0x00;
	P3M1 = 0x00; P3M0 = 0x00;

	
	
	
	
	while(1) { 

	
	
	
	}
}
//-----------------------------------------------------------------
// INT0中断函数
//-----------------------------------------------------------------
void EX_INT0() interrupt 0 {





}
//-----------------------------------------------------------------
//  名称: TIMER3控制门铃声音输出
//-----------------------------------------------------------------
//  说明: 按下按键时蜂鸣器发出叮咚的门铃声
//
//-----------------------------------------------------------------
#include "STC15xxx.h"
#include <intrins.h>
#define u8 	unsigned char
#define u16	unsigned int
sbit Key = P3^5;			//按键引脚定义
sbit DoorBell =  P2^0; 		//蜂鸣器输出引脚定义
#define MAIN_Fosc 12000000L	//系统时钟频率
#define T3MS_1 (-700) 		//700us延时：	对应1/(2*0.7)=0.714KHz
#define T3MS_2 (-1000) 		//1000us延时：	对应1/(2*1)=0.5KHZ
//-----------------------------------------------------------------
// 延时函数(参数取值限于1~255)
//-----------------------------------------------------------------
void delay_ms(u8 ms) {
	u16 i;
	do{
		i = MAIN_Fosc / 13000;
		while(--i);
	}while(--ms);
}
//-----------------------------------------------------------------
// T3初始化(12T/16位/模式0，1ms@12.000MHz)
//-----------------------------------------------------------------
void Timer3Init() {


}
//------------------------------------------------------------------
// T3中断服务程序（控制门铃声音输出）
//------------------------------------------------------------------
void Timer3_ISR() interrupt 19 {
	static int p = 0;
	static u8 f1 = 1, f2 = 1;
	DoorBell ^= 1; p++;		//门铃声音输出,变量p累加
	//如果需要声音拖得更长,可调整延时控制变量p(500,1200)
	if (p < 500 ) {			//高音

	
	}
	else
	if (p < 1200) {			//低音

	
	}
	else {					//停止

	
	}
}
//-----------------------------------------------------------------
// 主程序
//-----------------------------------------------------------------
void main() { 
	P2M1 = 0x00; P2M0 = 0x00;	//P2配置为准双向口
	P3M1 = 0xFF; P3M0 = 0x00;	//P3配置为高阻输入口
	Timer3Init();				//T3初始化
	IE2 |= 0x20;				//使能T3中断（ET3=1）
	while(1) {

	
	}
}
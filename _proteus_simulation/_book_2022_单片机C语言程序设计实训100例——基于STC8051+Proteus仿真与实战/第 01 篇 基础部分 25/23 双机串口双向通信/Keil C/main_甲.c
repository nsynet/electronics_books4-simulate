//---------------------------	甲机代码	----------------------------
//  名称: 甲机串口程序
//-----------------------------------------------------------------
//  说明: 甲单片机向乙单片机发送控制命令字符,甲机同时还可接收乙机发送的数字,
//		 所接收的数字将显示在数码管上.
//
//-----------------------------------------------------------------
#include "STC15xxx.h"
#include <intrins.h>
#define u8 	unsigned char
#define u16	unsigned int
#define MAIN_Fosc 11059200L		//系统时钟
sbit LED1	= P1^0;				//两个LED定义
sbit LED2	= P1^3;
sbit K1 	= P1^7;				//控制按键定义
u8 Operation_NO = 0;			//操作代码
volatile u8 recv_byte = 0x00;	//接收字节变量
bit TX1_Busy;					//串口1发送忙标志
const u8 SEG_CODE[]= {			//共阳数码管段码
 0xC0,0xF9,0xA4,0xB0,0x99,0x92,0x82,0xF8,0x80,0x90 };
//-----------------------------------------------------------------
// 延时函数（x = 1~255ms,自适应时钟）
//-----------------------------------------------------------------
void delay_ms(u8 x) {
	u16 i;
	do{
		i = MAIN_Fosc / 13000;
		while(--i);
	}while(--x);
}
//-----------------------------------------------------------------
// 初始化串口(9600bps@11.0592MHz)
//-----------------------------------------------------------------
void UartInit() {


}
//-----------------------------------------------------------------
// 向串口输出一个字符
//-----------------------------------------------------------------
void PutChar(u8 c) {

}
//------------------------------------------------------------------
// 串口输出字符串
//------------------------------------------------------------------
//void Putstr(char *s) { while(*s) PutChar(*s++); }
//-----------------------------------------------------------------
// 主程序 
//-----------------------------------------------------------------
void main() { 
	P0M1 = 0x00; P0M0 = 0x00;	//P0,P3配置为准双向口
	P3M1 = 0x00; P3M0 = 0x00; 
	P1M1 = 0x80; P1M0 = 0x00;	//P1.7为输入,P1其余为准双向口
	LED1 = LED2 = 1;			//初始时关闭LED
	UartInit();					//串口初始化(9600)
	P0 = 0xBF;					//初始时共阳数码管显示"-"
	ES = 1; EA = 1;				//允许串口中断,开总中断
	while(1) {

	
	
	}
}
//-----------------------------------------------------------------
// 甲机串口接收中断函数
//-----------------------------------------------------------------
void Serial_INT() interrupt 4 {
	if (RI) {			//接收到1字节

	
	}
	if (TI) {

	
	}
}
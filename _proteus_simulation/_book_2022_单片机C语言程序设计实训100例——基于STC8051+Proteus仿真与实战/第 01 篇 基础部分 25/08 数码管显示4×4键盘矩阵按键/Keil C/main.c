//---------------------------------------------------------------------
//	名称: 数码管显示4×4键盘矩阵按键序号
//---------------------------------------------------------------------
//	说明: 按下任意一个按键时,数码管会显示它在键盘矩阵上的序号0～F
//		 扫描程序首先判断被按下的按键在哪一列,然后判断按键在哪一行，
//		 根据不同列与行,即可得到按键序号0～F
//			
//---------------------------------------------------------------------
#include "STC15xxx.h"
#define u8 	unsigned char
#define u16	unsigned int
//0~F的共阳数码管段码,最后一个是"-"
const u8 SEG_CODE[] = {
	0xC0,0xF9,0xA4,0xB0,0x99,0x92,0x82,0xF8,
	0x80,0x90,0x88,0x83,0xC6,0xA1,0x86,0x8E,0xBF
};
sbit BEEP = P1^7; 
//该矩阵中序号范围为0-15,0xFF表示无按键
u8 keyNum = 0xFF;
//-----------------------------------------------------------------
// 延时函数(100us,1ms,xms,x100us)
//-----------------------------------------------------------------
void Delay100us() {	//@12.000MHz
	u8 i = 2, j = 39;
	do	{
		while (--j);
	} while (--i);
}
void Delay1ms()	{		//@12MHz
	u8 i = 12, j = 169;
	do {
		while (--j);
	} while (--i);
}
//-----------------------------------------------------------------
void delay_ms(u8 x) 			{ while(x--) Delay1ms(); } 
void delay_nx100us(u8 x)	{ while(x--) Delay100us(); } 
//-----------------------------------------------------------------
// 键盘矩阵扫描子程序1
//-----------------------------------------------------------------
u8 Keys_Scan1() { 


}
//-----------------------------------------------------------------
// 蜂鸣器子程序
//-----------------------------------------------------------------
void Beep() {
	u8 i;
	for (i = 0; i < 50; i++) { delay_nx100us(20); BEEP ^= 1; }
	BEEP = 0;
}
//-----------------------------------------------------------------
// 主程序
//-----------------------------------------------------------------
void main() {
	P0M1 = 0; P0M0 = 0;				//配置为准双向
	P1M1 = 0; P1M0 = 0;	
	P2M1 = 0; P2M0 = 0;
	BEEP = 0; P0 = 0xBF;			//共阳数码管初始显示"-"
	while(1) {

	
	}
}
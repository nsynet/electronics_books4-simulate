//-----------------------------------------------------------------
//  名称: 普通开关与拨码开关应用
//-----------------------------------------------------------------
//  说明: SW1控制显示开/关,拨码开关所设置的编码000-255(0x00-0xFF)由
//		  数码管显示,显示开关控制使用了8总线收发驱动器74LS245控制及
//		  位码控制两种方法.
//		  SW2控制报警器,实现两种不同频率的声音输出.
//
//-----------------------------------------------------------------
#include "STC15xxx.h"
#include <intrins.h>
typedef unsigned char	u8;
typedef unsigned int	u16;
code u8 SEG_CODE[] = 			//共阴数码管段码
 { 0x3F,0x06,0x5B,0x4F,0x66,0x6D,0x7D,0x07,0x7F,0x6F };
u8 disp_buff[3] = {0,0,0};		//显示缓冲
sbit BUZZER = P3^3;				//蜂鸣器定义
sbit SW1	= P3^0;				//显示开关
sbit SW2	= P3^6;				//报警器开关
sbit CE		= P2^0;				//74LS245使能控制端
//-----------------------------------------------------------------
// 延时函数(100us,1ms,xms,x100us)
//-----------------------------------------------------------------
void Delay100us() {	//@12.000MHz
	u8 i = 2, j = 39;
	do	{
		while (--j);
	} while (--i);
}
//-----------------------------------------------------------------
void Delay1ms()	{	//@12MHz
	u8 i = 12, j = 169;
	do {
		while (--j);
	} while (--i);
}
//-----------------------------------------------------------------
void delay_ms(u8 x) 		{ while(--x) Delay1ms(); } 
void delay_nx100us(u8 x)	{ while(--x) Delay100us(); } 
//-----------------------------------------------------------------
// 报警声音子程序
//-----------------------------------------------------------------
void Alarm(u8 t) {


}
//-----------------------------------------------------------------
// 主程序
//-----------------------------------------------------------------
void main() {
	u8 i;						//循环控制变量
	P0M1 = 0xFF; P0M0 = 0x00;	//P0配置为高阻输入
	P1M1 = 0x00; P1M0 = 0x00;	//P1配置为准双向口
	P2M1 = 0x00; P2M0 = 0x00;	//P2配置为准双向口
	P3M1 = 0x41; P3M0 = 0x00;	//P3口0,6高阻输入,其余为准双向
	BUZZER = 0;					//蜂鸣器控制引脚初始输出0
	CE = 0;						//初始时使能74LS245
	while(1) {

	
	}
}
//-----------------------------------------------------------------
//  名称: TIMER0、TIMER1及INT0控制报警器与旋转灯
//-----------------------------------------------------------------
//  说明: 定时器控制报警灯旋转显示,并发出仿真警报声
//
//-----------------------------------------------------------------
#include "STC15xxx.h"
#include <intrins.h>
#define u8	unsigned char
#define u16	unsigned int
sbit SPK = P3^7;					//音频输出引脚
volatile u8 FRQ = 0x00;				//音频控制变量
#define MAIN_Fosc 12000000L			//时钟频率
//-----------------------------------------------------------------
// 延时子程序
//-----------------------------------------------------------------
void delay_ms(u8 ms) {
	u16 i;
	do{
		i = MAIN_Fosc / 13000; while(--i);
	}while(--ms);
}
//-----------------------------------------------------------------
// Timer0初始化
//-----------------------------------------------------------------
void Timer0Init(){


}
//-----------------------------------------------------------------
// Timer1初始化
//-----------------------------------------------------------------
void Timer1Init() {


}
//-----------------------------------------------------------------
// 主程序
//-----------------------------------------------------------------
void main() {
	P1M1 = 0x00; P1M0 = 0x00;	//P1,P3配置为准双向口
	P3M1 = 0x00; P3M0 = 0x00;
	P1 = 0x00;			//关闭所有LED
	Timer0Init();		//T0定时器初始化
	Timer1Init();		//T1定时器初始化
	IT0 = 1;			//下降沿触发INT0中断
	PX0 = 1;			//INT0设为高优先级
	IE = 0x8B;			//开启0,1,3号中断(分别为：INT0,T0,T1)
	while(1) {			//循环过程中递增频率,溢出后再次递增

	
	}
}
//-----------------------------------------------------------------
// INT0中断程序
//-----------------------------------------------------------------
void EX0_INT() interrupt 0 {


}
//-----------------------------------------------------------------
// 定时器0中断程序
//-----------------------------------------------------------------
void Timer0_INT() interrupt 1 {


}
//-----------------------------------------------------------------
// 定时器1中断程序
//-----------------------------------------------------------------
void Timer1_INT() interrupt 3 {


}
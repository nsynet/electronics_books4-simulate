//-----------------------------------------------------------------
//  名称: 数码管显示两路A／D转换结果
//-----------------------------------------------------------------
//  说明: 程序运行时，两路模拟电压将显示在8只集成式数码管上.
//
//-----------------------------------------------------------------
#include "STC15xxx.h"
#include <intrins.h>
#define u8 	unsigned char
#define u16	unsigned int
#define MAIN_Fosc 12000000L	//系统时钟
#define ADC_POWER 	0x80 	//ADC电源控制位
#define ADC_FLAG 	0x10 	//ADC完成标志
#define ADC_START 	0x08 	//ADC起始控制位
#define ADC_SPEEDLL	0x00 	//540个时钟
#define ADC_SPEEDL 	0x20 	//360个时钟
#define ADC_SPEEDH 	0x40 	//180个时钟
#define ADC_SPEEDHH	0x60 	//90个时钟
//数码管段码表,最后一位为空白
const u8 SEG_CODE[] = {
 0xC0,0xF9,0xA4,0xB0,0x99,0x92,0x82,0xF8,0x80,0x90,0xFF};
float Result = 0;			//ADC换算结果
//两路模拟转换结果显示缓冲,显示格式为:X.XX X.XX ,第4位和第8位不显示
u8 array[] = {0,0,0,10,0,0,0,10};
//-----------------------------------------------------------------
// 延时函数(参数取值限于1~255)
//-----------------------------------------------------------------
void delay_ms(u8 ms) {
	u16 i;
	do{
		i = MAIN_Fosc / 13000;
		while(--i);
	}while(--ms);
}
//-----------------------------------------------------------------
// 初始化ADC
//-----------------------------------------------------------------
void InitADC() {


}
//-----------------------------------------------------------------
// 读取ADC结果并分解到数码管显示缓存
//-----------------------------------------------------------------
void GetADCResult(u8 ch) {


}
//-----------------------------------------------------------------
// 主程序
//-----------------------------------------------------------------
void main() {
	u8 i;
	P0M1 = 0x00; P0M0 = 0x00;			//P0配置为准双向口
	P1M1 = 0xFF; P1M0 = 0x00;			//P1配置为高阻输入
	P2M1 = 0x00; P2M0 = 0x00;			//P2配置为准双向口
	InitADC();							//初始化ADC
	while (1) {

	
	
	}
}
//-----------------------------------------------------------------
//  名称: 继电器及双向可控硅控制照明设备
//-----------------------------------------------------------------
//  说明: K1/K2分别控制继电器与可控硅开关.
//  
//-----------------------------------------------------------------
#include "STC15xxx.h"
#define u8	unsigned char
#define u16	unsigned int
sbit K1 = P0^0;					//继电器控制按键(在P0端口注意接上拉电阻)
sbit K2 = P3^3;					//双向可控硅控制按键
sbit RELAY = P1^0;				//继电器控制引脚
sbit TRIAC = P1^1;				//双向可控硅控制引脚
#define MAIN_Fosc 12000000L		//时钟频率定义
//-----------------------------------------------------------------
// 延时函数(参数取值限于1~255)
//-----------------------------------------------------------------
void delay_ms(u8 ms) {
	u16 i;
	do{
		i = MAIN_Fosc / 13000;
		while(--i);
	}while(--ms);
}
//-----------------------------------------------------------------
// 主程序
//-----------------------------------------------------------------
void main() {
	P0M1 = 0x00; P0M0 = 0x00;		//P0、P1	、P3配置为准双向口
	P1M1 = 0x00; P1M0 = 0x00;
	P3M1 = 0x00; P3M0 = 0x00;
	RELAY = 1;  TRIAC = 1;			//初始时两个灯泡全部关闭
	while(1) {
		if ( K1 == 0)	{			//继电器开关控制

		
		}
		if ( K2 == 0)	{	//可控硅开关控制

		
		}
	}
}
//-----------------------------------------------------------------
//  名称: 单片机内置EEPROM读写测试
//-----------------------------------------------------------------
//  说明: 按下K1时向EEPROM 0x0000地址开始写入512个有序字节
//        按下K2时向EEPROM 0x0200地址开始写入512个随机字节
//        按下K3,K4时分别读取写入EEPROM的两扇区各512字节并送串口输出显示
//        按下K5时删除写入EEPROM的两扇区数据,读取显示将全为0xFF.
//  
//-----------------------------------------------------------------
#include "STC15xxx.h"
#include <absacc.h>
#include <math.h>
#include <stdlib.h>
#include <intrins.h>
#define u8 	unsigned char
#define u16	unsigned int
sbit K1 = P1^0;					//K1按键
sbit K2 = P1^2;					//K2按键
sbit K3 = P1^4;					//K3按键
sbit K4 = P1^6;					//K4按键
sbit K5 = P1^7;					//K5按键
#define MAIN_Fosc 11059200L		//时钟频率定义
//-----------------------------------------------------------------
// 延时函数(参数取值限于1~255)
//-----------------------------------------------------------------
void delay_ms(u8 ms) {
	u16 i;
	do{
		i = MAIN_Fosc / 13000; while(--i);
	} while(--ms);
}
//-----------------------------------------------------------------
sbit LED1	=	P0^0;			//开始指示灯
sbit LED2	=	P0^3;			//完成指示灯
//-----------------------------------------------------------------
#define CMD_IDLE		0		//空闲模式
#define CMD_READ		1		//IAP字节读命令
#define CMD_PROGRAM		2		//IAP字节编程命令
#define CMD_ERASE		3		//IAP扇区擦除命令
//#define ENABLE_IAP	0x80	//使能IAP并设置操作等待时间(WT2,1,0)
//#define ENABLE_IAP	0x81
#define ENABLE_IAP		0x82
//#define ENABLE_IAP	0x83
//#define ENABLE_IAP	0x84
//#define ENABLE_IAP	0x85
//#define ENABLE_IAP	0x86
//#define ENABLE_IAP	0x87
void IapIdle();					//IAP空闲
u8 IapReadByte(u16 addr); 		//从指定地址读字节
void IapProgramByte(u16 addr, u8 dat); 	//向指定地址写字节
void IapEraseSector(u16 addr); 	//擦除扇区数据
void InitUart();				//串口初始化
//-----------------------------------------------------------------
// 测试用数组
//-----------------------------------------------------------------
u8 code Test_Array[512] = {
	0x00,0x01,0x02,0x03,0x04,0x05,0x06,0x07,0x08,0x09,0x0a,0x0b,0x0c,0x0d,0x0e,0x0f,
	0x10,0x11,0x12,0x13,0x14,0x15,0x16,0x17,0x18,0x19,0x1a,0x1b,0x1c,0x1d,0x1e,0x1f,
	0x20,0x21,0x22,0x23,0x24,0x25,0x26,0x27,0x28,0x29,0x2a,0x2b,0x2c,0x2d,0x2e,0x2f,
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	0xf0,0xf1,0xf2,0xf3,0xf4,0xf5,0xf6,0xf7,0xf8,0xf9,0xfa,0xfb,0xfc,0xfd,0xfe,0xff
};
//-----------------------------------------------------------------
// 初始化串口(9600bps@22.1184MHz)
//-----------------------------------------------------------------
void UartInit() {





}
//-----------------------------------------------------------------
// 向串口输出一个字符
//-----------------------------------------------------------------
void PutChar(u8 c)	{                              }
//------------------------------------------------------------------
// 串口输出字符串
//------------------------------------------------------------------
void Putstr(char *s)	{                        	}
//-----------------------------------------------------------------
// 以十六进制形式显示所读取的字节
//-----------------------------------------------------------------
void Puts_HEX(u8 dat) {




}
//-----------------------------------------------------------------
// 关闭IAP
//-----------------------------------------------------------------
void IapIdle() {
	IAP_CONTR = 0;					//关闭IAP功能
	IAP_CMD = 0;					//清除命令寄存器
	IAP_TRIG = 0;					//清除触发寄存器
	IAP_ADDRH = 0x80;				//将地址设置到非IAP区域
	IAP_ADDRL = 0;
}
//-----------------------------------------------------------------
// 从指定的ISP/IAP/EEPROM区域地址读取一字节
//-----------------------------------------------------------------
u8 IapReadByte(u16 addr) {
	u8 dat;							//数据缓冲区
	IAP_CONTR = ENABLE_IAP;			//使能IAP
	IAP_CMD = CMD_READ;				//设置IAP命令（读字节命令）
	IAP_ADDRL = addr;				//设置IAP低8位地址
	IAP_ADDRH = addr >> 8;			//设置IAP高8位地址
	IAP_TRIG = 0x5A;				//写触发命令(0x5A)
	IAP_TRIG = 0xA5;				//写触发命令(0xA5)
	_nop_();						//等待ISP/IAP/EEPROM操作完成
	dat = IAP_DATA;					//读ISP/IAP/EEPROM数据
	IapIdle();						//关闭IAP功能
	return dat;						//返回读取的数据字节
}
//-----------------------------------------------------------------
// 向指定的ISP/IAP/EEPROM区域地址写入一字节
//-----------------------------------------------------------------
void IapProgramByte(u16 addr, u8 dat) {
	IAP_CONTR = ENABLE_IAP;			//使能IAP
	IAP_CMD = CMD_PROGRAM;			//设置IAP命令（写字节命令：编程）
	IAP_ADDRL = addr;				//设置IAP低8地址
	IAP_ADDRH = addr >> 8;			//设置IAP高8地址
	IAP_DATA = dat;					//写ISP/IAP/EEPROM数据
	IAP_TRIG = 0x5A;				//写触发命令(0x5A)
	IAP_TRIG = 0xA5;				//写触发命令(0xA5)
	_nop_();						//等待ISP/IAP/EEPROM操作完成
	IapIdle();
}
//-----------------------------------------------------------------
// 扇区擦除
//-----------------------------------------------------------------
void IapEraseSector(u16 addr) {
	IAP_CONTR = ENABLE_IAP;			//使能IAP
	IAP_CMD = CMD_ERASE;			//设置IAP命令（删除扇区命令）
	IAP_ADDRL = addr;				//设置IAP低地址
	IAP_ADDRH = addr >> 8;			//设置IAP高地址
	IAP_TRIG = 0x5A;				//写触发命令(0x5A)
	IAP_TRIG = 0xA5;				//写触发命令(0xA5)
	_nop_();						//等待ISP/IAP/EEPROM操作完成
	IapIdle();
}
//-----------------------------------------------------------------
// 主程序
//-----------------------------------------------------------------
void main() {
	u8 OP = 0xFF; u16 i = 0;		//变量定义
	P0M0 = 0x00;	P0M1 = 0x00;	//P0,P3配置为准双向口
	P3M0 = 0x00;	P3M1 = 0x00;
	P1M0 = 0xFF;	P1M1 = 0x00;	//P1配置为高阻输入
	UartInit();						//串口初始化
	LED1 = 1; LED2 = 1;				//初始时LED全部熄灭
	//提示进行K1-K4操作
	Putstr("Plase Press K1,K2,K3 or K4 to Play EEPROM Test...\r\n");
	srand(300);						//设置随机种子
	while(1) {
		while (P1 == 0xFF); //未按键则等待-------------------------
		if (K1 == 0) 		{ delay_ms(10); if (K1 == 0) OP = 1; }
		else if (K2 == 0)	{ delay_ms(10); if (K2 == 0) OP = 2; }
		else if (K3 == 0)	{ delay_ms(10); if (K3 == 0) OP = 3; }
		else if (K4 == 0)	{ delay_ms(10); if (K4 == 0) OP = 4; }
		else if (K5 == 0)	{ delay_ms(10); if (K5 == 0) OP = 5; }
		if (OP == 1){ //--------------------------------------------
			Putstr("Write EEPROM order bytes(512)...\r\n"); 

			
			
			
			
		}
		else if (OP == 2) { //---------------------------------------
			Putstr("Write EEPROM random bytes(512)...\r\n"); 

			
			
			
			
		}
		else if (OP == 3) { //---------------------------------------
			Putstr("\r\r\rRead EEPROM DEMO: orderd bytes......\r\n");

			
			
			
			
		}
		else if (OP == 4){ //---------------------------------------
			Putstr("\r\r\rRead EEPROM DEMO: random bytes......\r\n");

			
			
			
			
		}
		else if (OP == 5){ //---------------------------------------
			Putstr("\r\r\rErase EEPROM DEMO:......\r\n");

			
			
			
		}
		Putstr("\r\n----OK!!!-----\r\n");
		while (P1 != 0xFF); 		//等待释放按键-----------------
	}
}
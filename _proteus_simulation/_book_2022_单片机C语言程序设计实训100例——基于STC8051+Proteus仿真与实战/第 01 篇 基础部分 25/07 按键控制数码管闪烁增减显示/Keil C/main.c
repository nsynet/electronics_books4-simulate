//-----------------------------------------------------------------
//  名称: 按键调节数码管数字显示
//-----------------------------------------------------------------
//  说明: 本例通过按键加减数码管所显示的数字,调节过程中数码管闪烁显示.
//		 确定后恢复正常显示,按下取消时将恢复到调节之前的值.
//
//-----------------------------------------------------------------
#include "STC15xxx.h"
#define u8 	unsigned char
#define u16	unsigned int
//调节按键定义
sbit K1 = P3^4; //加
sbit K2 = P3^5; //减
sbit K3 = P3^6; //确定
sbit K4 = P3^7; //取消
//数字0~9的数码管段码表
u8 code SEG_CODE[] = 
 { 0xC0,0xF9,0xA4,0xB0,0x99,0x92,0x82,0xF8,0x80,0x90 };
u8  Adjust = 0;							//标识当前是否处理调节状态
u8  Pre_key = 0xF0;					//保存上次按键状态
u8  array[] = {0,0,0,0,};		//保存数位分解结果的数组
u16 Count = 2900;						//本例所设置的显示初值
u16 Temp;										//临时变量
#define MAIN_Fosc 12000000L	//时钟频率定义
//-----------------------------------------------------------------
// 延时函数(参数取值限于1~255)
//-----------------------------------------------------------------
void delay_ms(u8 ms) {
	u16 i;
	do{
		i = MAIN_Fosc / 13000;
		while(--i);
	}while(--ms);
}
//-----------------------------------------------------------------
// 数位分解函数(分解为4个数位)
// 使用循环减法的分解速度优于使用/与%分解
//-----------------------------------------------------------------
void INT_TO_4Digit(u16 n) {


}
//-----------------------------------------------------------------
// 按键处理函数
//-----------------------------------------------------------------
void key_handle() {
	P3 |= 0xF0;											//P3高4位先置高电平
	if (Pre_key == (P3 & 0xF0)) return;		//按键状态未改变时继续
	Pre_key = P3 & 0xF0;						//保存当前新的按键状态
	//--------------------------------------------------------------
	if (!K1) {											//递增,进入调节状态

	
	}
	if (!K2) {											//递减,进入调节状态

	
	}
	if (!K3) {											//确定,进入正常显示状态

	
	}
	if (!K4) {											//取消,进入正常显示状态

	
	}
}
//-----------------------------------------------------------------
// 主程序
//-----------------------------------------------------------------
void main() {
	u8 i;	u16 t;
	P1M1 = 0x00; P1M0 = 0x00;					//P1配置为准双向口
	P3M1 = 0xF0; P3M0 = 0x00;					//P3配置为高4位输入/低四位准双向
	while(1) {
		//1.正常刷新显示---------------------------------------------
		for (t = 0; t < 35; t++) {			//此循环用于保持数码管稳定显示

		
		}
		//2.处于调节状态---------------------------------------------
		if (Adjust)	{										//脱离了扫描刷新,数码管开始闪烁

		
		}
	}
}
//-----------------------------------------------------------------
// 名称: LED模拟交通灯
//-----------------------------------------------------------------
// 说明: 东西向绿灯亮若干秒后,黄灯闪烁,闪烁5次后亮红灯,
//		红灯亮后,南北向由红灯变为绿灯,若干秒后南北向黄灯闪烁, 
//		闪烁5次后亮红灯,东西向绿灯亮,如此往复.
//		本例将时间设得较短是为了调试的时候能较快的观察到运行效果.
//	
//-----------------------------------------------------------------
#include "STC15xxx.h"
#define u8 	unsigned char
#define u16	unsigned int
sbit RED_A 		= P0^0;	//东西向指示灯
sbit YELLOW_A	= P0^1;
sbit GREEN_A	= P0^2; 
sbit RED_B 		= P0^3;	//南北向指示灯
sbit YELLOW_B	= P0^4;
sbit GREEN_B 	= P0^5;
//闪烁次数及操作类型变量定义
u8 Flash_Count = 0, Operation_Type = 1;
//-----------------------------------------------------------------
// 延时函数(1ms, xms)
//-----------------------------------------------------------------
void Delay1ms()	{	//@12MHz
	u8 i = 12, j = 169;
	do {
		while (--j);
	} while (--i);
}
//-----------------------------------------------------------------
void delay_ms(u16 x) { while(--x) Delay1ms(); } 
//-----------------------------------------------------------------
// 交通灯切换子程序
//-----------------------------------------------------------------
void Traffic_Light() {
	switch (Operation_Type) 	{
		case 1://东西向绿灯与南北向红灯亮

		
		case 2://东西向黄灯开始闪烁,绿灯关闭

		
		case 3://东西向红灯与南北向绿灯亮

		
		case 4://南北向黄灯开始闪烁

		
	 }
}      
//-----------------------------------------------------------------
// 主程序
//-----------------------------------------------------------------
void main() {
	P0M1 = 0; P0M0 = 0; 				//配置为准双向口
	while(1) Traffic_Light();		//循环控制
}
//---------------------------------------------------------------------
//  名称: INT0～INT3中断计数
//---------------------------------------------------------------------
//  说明: 每次按下K1计数按键时第1组计数值被累加并被显示在左边的3只数码管上
//		 每次按下K2计数按键时第2组计数值被累加并被显示在右边的3只数码管上
//		 后两个按键K3、K4分别用于对应清零
//  
//---------------------------------------------------------------------
#include "STC15xxx.h"
#include <intrins.h>
#define u8 	unsigned char
#define u16	unsigned int
#define MAIN_Fosc 12000000L				//时钟频率定义
u8 code DSY_CODE[] = 					//共阳数码管段码表
{ 0xC0,0xF9,0xA4,0xB0,0x99,0x92,0x82,0xF8,0x80,0x90,0xFF};
u8 code Scan_BITs[] = {0x20,0x10,0x08,0x04,0x02,0x01};
//两组计数的显示缓冲,前三位为一组,后三位为另一组
u8 data disp_buff[] = {0,0,0,0,0,0};
//两个计数值
u16 Count_A = 0,Count_B = 0;
//-----------------------------------------------------------------
// 延时函数(参数取值限于1~255)
//-----------------------------------------------------------------
void delay_ms(u8 ms) {
	u16 i;
	do{
		i = MAIN_Fosc / 13000;
		while(--i);
	}while(--ms);
}
//-----------------------------------------------------------------
// 计数值显示
//-----------------------------------------------------------------
void Show_Counts() {


}
//-----------------------------------------------------------------
// 主程序
//-----------------------------------------------------------------
void main() {
	P1M1 = 0x00; P1M0 = 0x00;		//P1,P2,P3配置为准双向口
	P2M1 = 0x00; P2M0 = 0x00;
	P3M1 = 0x00; P3M0 = 0x00;
	IT0 = 1;						//INT0下降沿触发（注：当前版此行仿真有异常）
	IT1 = 1;						//INT1下降沿触发
	PX0 = 1;						//设置优先级
	IE = 0x05;						//INT0,INT1开中断
	INT_CLKO |= (1<<4) | (1<<5);	//INT2,INT3开中断
	EA = 1;							//开总中断控制位
	while(1) Show_Counts();			//循环刷新显示
}
//-----------------------------------------------------------------
// INT0中断(INT0/P3.2:A累加)
// 注:因Proteus存在BUG,IT0=1时应为下降沿触发，但仿真时上下沿均被触发
//-----------------------------------------------------------------
void EX_INT0() interrupt 0 {


}
//-----------------------------------------------------------------
// INT1中断(INT1/P3.3:B累加)
//-----------------------------------------------------------------
void EX_INT1() interrupt 2 {


}
//-----------------------------------------------------------------
// INT2中断(INT2/P3.6:A清0)
//-----------------------------------------------------------------
void EX_INT2() interrupt 10 {


}
//-----------------------------------------------------------------
// INT3中断(INT3/P3.7:B清0)
//-----------------------------------------------------------------
void EX_INT3() interrupt 11 {


}
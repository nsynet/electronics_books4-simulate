//-----------------------------------------------------------------
//	名称：74HC595串入并出芯片控制数码管显示四位数字
//-----------------------------------------------------------------
//	说明：4片74HC595串入并出芯片控制四位数码管循环显示指定的四组数据.
//
//-----------------------------------------------------------------
#include "STC15xxx.h"
#include <intrins.h>
#define u8	unsigned char
#define u16 unsigned int
sbit SH_CP	=	P1^0;				//移位时钟脉冲
sbit DS		=	P1^1;				//串行数据输入
sbit ST_CP	=	P1^2;				//输出锁存器控制脉冲
code u8 SEG_CODE[] = {				//共阳数码管段码表
 0xC0,0xF9,0xA4,0xB0,0x99,0x92,0x82,0xF8,0x80,0x90};
u16 myData[4] = {2938,1234,1509,3506};	//待显示数据
//-----------------------------------------------------------------
// 延时函数(1ms, xms, x取值1~65535)
//-----------------------------------------------------------------
void Delay1ms() {	//@12.000MHz
	u8 i = 12, j = 169;
	do {
		while (--j);
	} while (--i);
}
//-----------------------------------------------------------------
void delay_ms(u16 x) { while(x--) Delay1ms(); }
//-----------------------------------------------------------------
// 1字节数据串行输入595子程序
//-----------------------------------------------------------------
void Serial_Input_595(u8 d) {


}
//-----------------------------------------------------------------
// 595并行输出子程序
//-----------------------------------------------------------------
void Parallel_Output_595() {


}
//-----------------------------------------------------------------
//主程序
//-----------------------------------------------------------------
void main() {
	u8 i,t;
	P1M1 = 0x00; P1M0 = 0x00;		//配置为准双向口
	while (1) {

	
	}
}
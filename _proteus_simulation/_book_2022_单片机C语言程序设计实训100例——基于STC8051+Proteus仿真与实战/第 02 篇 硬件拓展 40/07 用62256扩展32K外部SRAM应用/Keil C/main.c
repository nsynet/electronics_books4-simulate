//-----------------------------------------------------------------
//  名称: 用62256扩展32K外部SRAM应用
//-----------------------------------------------------------------
//  说明: 按下K1时将向62256的0地址开始循环写入0x00-0xFF
//        按下K2时将向62256的0地址开始循环写入32K指定数据（原始数据来自FLASH空间）
//        写入结束时LED闪烁然后熄灭，暂停后通过debug菜单可查看内存数据.
//
//-----------------------------------------------------------------
#include "STC15xxx.h"
#include <intrins.h>
#include <absacc.h>				//绝对地址访问定义头文件(使用XBYTE时需引用)
#define MAIN_Fosc 12000000L		//时钟频率定义
#define u8	unsigned char
#define u16	unsigned int
#define u32	unsigned long
//-----------------------------------------------------------------
#define	BUS_SPEED_1T()	BUS_SPEED = 0
#define	BUS_SPEED_2T()	BUS_SPEED = 1
#define	BUS_SPEED_4T()	BUS_SPEED = 2
#define	BUS_SPEED_8T()	BUS_SPEED = 3
//-----------------------------------------------------------------
sbit LED = P3^0;				//操作指示灯
sbit K1 = P3^3;					//向62256循环写00~FF的操作按键
sbit K2 = P3^6;					//将FLASH字节写62256的操作按键
//-----------------------------------------------------------------
#define ExternalRAM_enable() AUXR |=  2		//允许外部XRAM，禁止使用内部RAM
#define InternalRAM_enable() AUXR &= ~2	//禁止外部XRAM，允许使用内部RAM
//-----------------------------------------------------------------
// 测试用数组（初始时保存于FLASH程序空间:可直接定义32K字节，此处仅放了128字节）
//-----------------------------------------------------------------
code u8 TempData[]={
	0x02,0x20,0x3F,0x20,0x22,0x50,0x3A,0x50,0x2A,0x88,
	0x7F,0x06,0x41,0x48,0xBE,0x48,0x22,0x48,0x3E,0x48,
	0x22,0x48,0x3E,0x48,0x22,0x48,0x22,0x48,0x2A,0x88,
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	0x45,0xF4,0x44,0x04,0x54,0x28,0x48,0x10
};
//-----------------------------------------------------------------
// 延时函数(参数取值限于1~255)
//-----------------------------------------------------------------
void delay_ms(u8 ms) {
	u16 i;
	do{
		i = MAIN_Fosc / 13000;
		while(--i);
	}while(--ms);
}
//-----------------------------------------------------------------
// LED闪烁
//-----------------------------------------------------------------
void LED_Blink() {
	u8 i;
	for (i = 0; i < 5; i++) {
		LED = 0; delay_ms(100); LED = 1; delay_ms(100);
	}
}
//-----------------------------------------------------------------
// 主程序
//-----------------------------------------------------------------
void main() { 
	u16 i,j; u8 xdata *ptx;			//循环控制变量、外部SRAM指针变量定义
	P0M1 = 0;	P0M0 = 0;			//P0,P2设置为准双向口
	P2M1 = 0;	P2M0 = 0;
	P3M1 = (1<<3|(1<<6));P3M0 = 0;	//P3.3,P3.6高阻输入，其他为准双向口
	LED = 0;						//初始时LED点亮
	BUS_SPEED_1T();					//1T 2T 4T 8T 3V@22MHZ用1T会访问错误
	ExternalRAM_enable();			//允许外部XDATA
	//InternalRAM_enable();			//允许内部XDATA
	while (1) {

	
	}
}

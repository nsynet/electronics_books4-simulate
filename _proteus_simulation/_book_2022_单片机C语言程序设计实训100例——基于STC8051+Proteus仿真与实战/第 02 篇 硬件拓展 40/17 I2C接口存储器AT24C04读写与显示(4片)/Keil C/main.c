//-------------------------- main.c -------------------------------
//	名称: I2C接口存储器AT24C04读写与显示(4片)
//-----------------------------------------------------------------
//	说明: 按下K1-K4按键时,前两个分别向第1,2片AT24C04中写入400个随机字节
//		  后2个按键分别写第3,4片AT24C04,先写入200个0x01,再写入200个0x02
//		  写入后接着读取并显示.(400个字节的地址范围: 0x0000~0x018F)
//
//-----------------------------------------------------------------
#define u8 	unsigned char
#define u16	unsigned int
#define  MAIN_Fosc  11059200L		//定义主时钟
#include "STC15xxx.h"
#include <intrins.h>
#include <stdio.h>
#include <stdlib.h>
sbit K1 = P0^0;						//四个操作按键定义
sbit K2 = P0^1;
sbit K3 = P0^2;
sbit K4 = P0^3;
u16 r = 0;							//满20个字节换行控制变量
bit TX1_Busy = 0;
//AT24C04相关函数
extern void Random_Write(u8 Dev_Addr,u16 mem_addr,u8 dat);
extern u8 Random_Read(u8 Dev_Addr,u16 mem_addr);
extern void Sequential_Read(u8 Dev_Addr,u16 mem_addr,u16 N);
//-----------------------------------------------------------------
// 延时子程序（x=1~255ms,自适应时钟）
//-----------------------------------------------------------------
void delay_ms(u8 x) {
	u16 i;
	do{
		i = MAIN_Fosc / 13000;
		while(--i);
	} while(--x);
}
//-----------------------------------------------------------------
// 串口初始化（9600bps@11.0592MHz）
//-----------------------------------------------------------------
void UartInit() {


}
//-----------------------------------------------------------------
// 向串口输出1字符
//-----------------------------------------------------------------
void PutChar(u8 c) {


}
//-----------------------------------------------------------------
// 向串口发送字符串
//-----------------------------------------------------------------
void PutStr(u8 *s) {                    }
//-----------------------------------------------------------------
// sprintf对%2X格式支持不稳定,编译时有时可以输出正确结果,有时则不正常
// sprintf(s,"%02X ",(u8)Random_Read(0xA0,i)); PutStr(s);
// 故改用下面的函数实现十六进制形式显示所读取的字节
//-----------------------------------------------------------------
void Show_HEX(u8 dat) {

}
//-----------------------------------------------------------------
// 主程序
//-----------------------------------------------------------------
void main() {
	u16 i; char s[] = "NO.X\r\n";
	u8 n = 0, ChipNo = 0;
	P0M1 = 0xFF; P0M0 = 0x00;			//P0高阻输入
	P1M1 = 0x00; P1M0 = 0x00;			//P1,P3准双向口
	P3M1 = 0x00; P3M0 = 0x00;
	UartInit();							//串口配置
	ES = 1; EA = 1;						//允许串口中断,开总中断
	srand(30);							//随机种子
	PutStr("\r\n>>> Press K1~K4, Write/Read No.1~4 AT24C04...\r\n ");
	while(1) {

	
	
	
	
	}
}
//-----------------------------------------------------------------
// 串口接收中断函数
//-----------------------------------------------------------------
void Serial_INT() interrupt 4 {



}
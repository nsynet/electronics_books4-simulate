//-----------------------------------------------------------------
//  名称: LGM12864LCD显示驱动程序 (不带字库)
//-----------------------------------------------------------------
#include "STC15xxx.h"
#include <intrins.h>
#include <stdio.h>
#include <string.h>
#include "LGM19264_KS0108.h"
//-----------------------------------------------------------------
// 延时函数
//-----------------------------------------------------------------
#define MAIN_Fosc 12000000L
void delay_ms(u8 x) {
	unsigned int i;
	do{
		i = MAIN_Fosc / 13000;
		while(--i); 
	}while(--x);
}
//-----------------------------------------------------------------
// 向LCD发送命令
//-----------------------------------------------------------------
void LCD_Write_Comm(u8 cmd) {


} 
//-----------------------------------------------------------------
// 向LCD发送数据
//-----------------------------------------------------------------
void LCD_Write_Data(u8 dat) {


} 
//-----------------------------------------------------------------
// LCD初始化函数
//-----------------------------------------------------------------
void LCD_Initialize() {
	RST = 0; delay_ms(1);								//复位LCD
	RST = 1;														//恢复LCD正常工作
	LCD_Write_Comm(0x30); delay_ms(15);	//基本指令操作
	LCD_Write_Comm(0x01); delay_ms(15);	//清除显示
	LCD_Write_Comm(0x06); delay_ms(15);	//光标移动方向
	LCD_Write_Comm(0x0c); delay_ms(15);	//开显示,关光标,不闪烁
}
//-----------------------------------------------------------------
//
// 通用显示函数
// 
// 从第P页第L列开始显示W个字节数据,数据在r所指向的缓冲
// 每字节8位是垂直显示的,高位在下,低位在上
// 每个8*(64+64+64),即8*192的矩形区域为一页
// 整个LCD又由64x64的左、中、右三个部分构成(整体幅面为：192*64)
//-----------------------------------------------------------------
void Common_Show(u8 P,u8 L,u8 W,u8 *r) {
	u8 i = 0;
	if (i+L < 64) {
		CS1 = 0; CS2 = 1; CS3 = 1;		//绘制左屏
		LCD_Write_Comm(LCD_PAGE + P);
		LCD_Write_Comm(LCD_COL + L);
		for(i = 0; i+L < 64 && i < W; i++) LCD_Write_Data(r[i]);
	}
	if (i+L >= 64 && i+L < 128) {
		CS1 = 1; CS2 = 0; CS3 = 1;		//绘制中屏
		LCD_Write_Comm(LCD_PAGE + P);
		LCD_Write_Comm(LCD_COL + i + L - 64);
		for(; i+L < 128 && i < W; i++) LCD_Write_Data(r[i]);
	}
	if (i+L >= 128 && i+L < 192){
		CS1 = 1; CS2 = 1; CS3 = 0;		//绘制右屏
		LCD_Write_Comm(LCD_PAGE + P);
		LCD_Write_Comm(LCD_COL+ (i + L - 128));
		for(; i+L < 192 && i < W; i++) LCD_Write_Data(r[i]);
	}
}
//-----------------------------------------------------------------
// 显示一个8×16点阵字符
//-----------------------------------------------------------------
void Disp_A_Char_8x16(u8 P,u8 L,u8 *M) {
	Common_Show( P,	 		L, 8, M );				//显示上半部分8*8
	Common_Show( P + 1,	L, 8, M + 8 );		//显示下半部分8*8
}
//-----------------------------------------------------------------
// 显示一个16×16点阵汉字
//-----------------------------------------------------------------
void Disp_A_WORD(u8 P,u8 L,u8 *M){
	Common_Show( P,			L, 16, M );				//显示汉字上半部分16*8
	Common_Show( P + 1,	L, 16, M + 16	);	//显示汉字下半部分16*8
}
//-----------------------------------------------------------------
// 显示一串16×16点阵汉字
//-----------------------------------------------------------------
void Disp_CHN_String(u8 P,u8 L,u8 C,u8 *M) {
	u8 i;
	for (i = 0; i < C; i++) Disp_A_WORD(P, L + i * 16, M + i * 32);
}
//-----------------------------------------------------------------
// 显示位图：W，H分别为图像的高度与宽度像素值，H/8为页高数量
//-----------------------------------------------------------------
void Disp_Image(u8 P,u8 L,u8 W,u8 H,u8* G) {
	u8 i;
	for (i = 0; i < H / 8; i++) {
		//Common_Show( 3, 0, 184, 40, Screen_Image + p * 184 );
		Common_Show( P + i, L, W, G + i * W );
	}
}
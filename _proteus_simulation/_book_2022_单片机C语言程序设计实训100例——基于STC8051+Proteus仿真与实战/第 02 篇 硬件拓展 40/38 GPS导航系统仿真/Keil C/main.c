//-----------------------------------------------------------------
//	名称: GPS导航系统仿真 (使用硬件串口2)
//-----------------------------------------------------------------
//	说明：本例运行时,由GPS实物模块或虚拟GPS软件Virtual GPS输出的
//        GPS协议数据将被系统接收,并对其中的"$GPRMC"协议数据进行解析,
//        所获取的当前经度、纬度、速度、时间信息将被刷新显示LCD.
//
//-----------------------------------------------------------------
#define u8 	unsigned char
#define u16	unsigned int
#define MAIN_Fosc	12000000L						//主时钟频率
#define Baudrate2	9600L							//UART2波特率
#include "STC15xxx.h"
#include "T6963C.h"
#include "PictureDots.h"
#include <intrins.h>
#include <stdlib.h>
//-----------------------------------------------------------------
code char p[] = "$GPRMC";							//协议头部
volatile u8 RX2_OK = 0;								//UART2接收成功标识
volatile char time[] = "00:00:00";					//时间
volatile char Longitude[]	= "ddd°mm.mmmm' X";	//经度
volatile char Latitude[]	= " dd°mm.mmmm' X";	//纬度
volatile char Speed[12];							//地面速度
//-----------------------------------------------------------------
// 设置波特率(基于T2)
//-----------------------------------------------------------------
void SetTimer2Baudraye(u16 dat) {

}
//-----------------------------------------------------------------
// UART2初始化函数 brt:波特率 使用T2
//-----------------------------------------------------------------
void UART2_config(u8 brt) {

}
//-----------------------------------------------------------------
// 主程序
//-----------------------------------------------------------------
void main() {
	int sp;
	P1M1 = 0x00; P1M0 = 0x00;			//配置为准双向口
	P2M1 = 0x00; P2M0 = 0x00;
	P3M1 = 0x00; P3M0 = 0x00;
	LCD_Initialise();					//初始化T6963C-LCD
	UART2_config(2);					//配置UART2
	EA = 1; 							//允许全局中断
	//显示标题文字及四项导航栏目名称
	Draw_Image((u8*)Title_Image,0,0);
	Draw_Image((u8*)Info4_Image,30,0);
	while(1) {				//刷新显示新接收到的GPS定位信息
		if (RX2_OK == 1) {	//接收成功则分解时间,经纬度及速度并显示

		}
	}
}
//-----------------------------------------------------------------
// UART2中断服务函数:解析所接收的GPS各协议数据中"$GPRMC"序列,如:
// $GPRMC,194633.656,A,8702.999833,N,12149.593667,E,130.07,6,180308,...
//-----------------------------------------------------------------
void UART2_ISR() interrupt 8 {
	static u8 i = 0, END_Flag = 0;	u8 c;
	if((S2CON & 0x01) != 0) {		//接收字符
		S2CON &= ~0x01;				//清除RX标识
		//---------------------------------------------------------
		c = S2BUF;					//从串口缓冲寄存器读取字符
		//未接收到完整的"$GPRMC"协议头时索引归0,开中断,返回
		if (i < 6 && p[i] != c) { i = 0; return; } 
		//继续接收时间信息hh:mm:ss,忽略0.ssss
		if (i >= 7 && i <= 12) { 
			//将hhmmss转换为hh:mm:ss的格式,存入time数组
			time[ (3 * i + 1) / 2 - 11] = c;
		}
		//纬度信息
		else if (i == 20 || i == 21)	Latitude[i-19]	= c;//度存入1,2
		else if (i >= 22 && i <= 28)	Latitude[i-17]	= c;//分存入5~11
		else if (i == 32)				Latitude[14]	= c;
		//经度信息
		else if (i >= 34 && i <= 36)	Longitude[i-34]	= c;//度存入0~2
		else if (i >= 37 && i <= 43)	Longitude[i-32]	= c;//分存入5~11
		else if (i == 47 )				Longitude[14]	= c;
		//速度信息
		if (i >= 49) {
			if (c == ',') END_Flag = 1; 
			else { Speed[i-49] = c; Speed[i-48] = '\0'; }
		}
		if (++i > 60 || END_Flag ==1) { i = 0; END_Flag = 0; RX2_OK = 1; }
		//---------------------------------------------------------
	}
}

//------------------------- oled.c --------------------------------
//  名称: OLED显示驱动程序
//-----------------------------------------------------------------
#include "oled.h"
#include "i2c.h"
#include "oledfont.h"
//-----------------------------------------------------------------
// 通过I2C接口向OLED写入命令
//-----------------------------------------------------------------
void Write_IIC_Com(u8 IIC_Command) {


}
//-----------------------------------------------------------------
// 通过I2C接口向OLED写入数据
//-----------------------------------------------------------------
void Write_IIC_Dat(u8 IIC_Data) {


}
//-----------------------------------------------------------------
// 填充图形（OLED显存格式：横向宽128像素，纵向高64像素/共8页）
//-----------------------------------------------------------------
void Fill_picture(u8 fill_Data) {


}
//-----------------------------------------------------------------
// 设置显示位置
//-----------------------------------------------------------------
void OLED_Set_Pos(u8 x, u8 y) {


}
//-----------------------------------------------------------------
// 开启OLED显示
//-----------------------------------------------------------------
void OLED_Display_On() {

}
//-----------------------------------------------------------------
// 关闭OLED显示
//-----------------------------------------------------------------
void OLED_Display_Off() {

}
//-----------------------------------------------------------------
// 清屏
//-----------------------------------------------------------------
void OLED_Clear() {

}
//-----------------------------------------------------------------
// 开显示
//-----------------------------------------------------------------
void OLED_On() {

}
//-----------------------------------------------------------------
// 在指定位置显示一个字符
// x:0~127 y:0~63 mode:0,反白显示;1,正常显示 size:选择字体(字号)12/16
//-----------------------------------------------------------------
void OLED_ShowChar(u8 x,u8 y,u8 chr,u8 font) {
	u8 c = 0,i = 0;
	c = chr - ' ';
	if(x > Max_Column - 1) { x = 0; y += 2; }
	if(font == 16) {			//字体16
		OLED_Set_Pos(x,y);			//设置显示位置（上页）
		for(i = 0; i < 8; i++) Write_IIC_Dat(F8x16[c * 16 + i]);
		OLED_Set_Pos(x, y + 1);		//设置显示位置（下页）
		for(i = 0; i < 8; i++) Write_IIC_Dat(F8x16[c * 16 + i + 8]);
	}
	else {							//字体12
		OLED_Set_Pos(x,y);			//设置显示位置
		for(i = 0; i < 6; i++) Write_IIC_Dat(F6x8[c][i]);
	}
}
//-----------------------------------------------------------------
// m^n函数（本例十进制数位分解将调用该函数）
//-----------------------------------------------------------------
u32 __pow(u8 m,u8 n) {
	u32 result = 1;
	while(n--) result *= m;
	return result;
}
//-----------------------------------------------------------------
// 显示数字: x,y:显示位置,n:待显示数值,w:占据宽度,font:字体(字号)
//-----------------------------------------------------------------
void OLED_ShowNum(u8 x,u8 y,u32 n,u8 w,u8 font) {
	u8 i, t, show = 0;
	//假定n=123,显示宽度w=5,则分解数位为 0 0 1 2 3，前两个0将显示为空格
	for( i = 0; i < w; i++) {			//按宽度w输出,不足的补空格
		t = (n/__pow(10,w-1-i))%10;		//按总宽度为w开始逐位分解
		//show==0表示还未开始正常显示(可能需补空格)
		//注:当i==w-1时(也就是到达最后1位时),无论是什么数字(包括0)
		//都需正常显示,因此if的第2个条件不能写成i<=(w-1)
		if(show == 0 && i < (w-1)) { 
			if(t == 0) {				//如分解高位为0则用空格补充
				OLED_ShowChar(x + (font/2)*i, y, ' ',font);
				continue;				//进入下一循环继续进行分解
			} else show = 1;	//遇到高位非0则show=1,表示以下开始正常显示
		}
		//正常显示1个数字字符
	 	OLED_ShowChar(x + (font/2)*i, y, t+'0', font);
	}
}
//-----------------------------------------------------------------
// 显示字符串
//-----------------------------------------------------------------
void OLED_ShowStr(u8 x,u8 y,u8 *s,u8 font){
	u8 i = 0;
	while (s[i]!='\0') {			//未遇到字符串结束符则继续
		OLED_ShowChar(x, y, s[i], font);//在当前位置输出1字符
		x += 8;						//横向+8,到下一字符位置
		if(x > 120){ x = 0;y += 2; } //将要越界,x归0,y下移2页
		i++;						//字符索引递增
	}
}
//-----------------------------------------------------------------
// 显示汉字(参数分别显示位置x,y及中文字符在点阵数组中的索引no)
//-----------------------------------------------------------------
void OLED_ShowHZ(u8 x,u8 y,u8 no) {
	u8 t;
	OLED_Set_Pos(x,y);				//设置显示位置(上页)
	for(t = 0;t < 16; t++) {		//显示上16列
		Write_IIC_Dat(Hzk[2*no][t]);//显示上半部分当前列像素
	}
	OLED_Set_Pos(x,y+1);			//设置显示位置(下页)
	for(t = 0;t < 16;t++) {			//显示下16列
		Write_IIC_Dat(Hzk[2*no+1][t]); //显示下半部分当前列像素
	}
}
//-----------------------------------------------------------------
// 显示显示BMP图片128×64起始点坐标(x,y),x的范围0～127，y为页的范围0～7
//-----------------------------------------------------------------
void OLED_DrawBMP(u8 x0, u8 y0,u8 x1, u8 y1,u8 BMP[]) {
	u16 j = 0; u8 x,y;
	if(y1 % 8 == 0) y = y1 / 8; else y = y1 / 8 + 1;//纵向像素换成页数
	for(y = y0; y < y1; y++) {		//循环输出各页
		OLED_Set_Pos(x0,y);			//设置位置
		for(x = x0; x < x1; x++) Write_IIC_Dat(BMP[j++]);//输出1字节像素
	}
}
//-----------------------------------------------------------------
// 初始化OLED(SSD1306)
//-----------------------------------------------------------------
void OLED_Init() {
	delay_ms(10);
	Write_IIC_Com(0xAE);	//关显示
	Write_IIC_Com(0x40);	//设置起始行地址（置为0，范围为0~63）
	Write_IIC_Com(0xB0);	//设置起始页地址（置为0，范围为0~7）
	Write_IIC_Com(0xC8);	//设置COM扫描方面(C8:上->下,C0:下->上)
	Write_IIC_Com(0x81);	//设置对比度
	Write_IIC_Com(0xFF);	//置为最大值0xFF（范围：0x00~0xFF）
	Write_IIC_Com(0xA1);	//段重映射设置(A1:从左向右，A0:从右向左)
	Write_IIC_Com(0xA6);	//正常显示（A6:正常，A7:反相）
	Write_IIC_Com(0xA8);	//设置复用率(双字节命令，下一字节为参数)
	Write_IIC_Com(0x3F);	//复用参数取值1F(31),最大为3F(63)
	Write_IIC_Com(0xD3);	//设置纵向偏移(双字节命令,下一字节为参数)
	Write_IIC_Com(0x00);	//无偏移
	Write_IIC_Com(0xD5);	//设置显示时钟分频值/震荡频率(下一字节为参数)
	Write_IIC_Com(0xF0);	//高4位：振荡器频率,低4位：分频因子
	Write_IIC_Com(0xD9);	//设置预充电周期(下一字节为参数)
	Write_IIC_Com(0x22);	//预充电周期参数
	Write_IIC_Com(0xDA);	//设置列引脚硬件配置(下一字节为参数)
	Write_IIC_Com(0x02);	//设置为默认值
	Write_IIC_Com(0xDB);	//设置VCOMH反压值(下一字节为参数)
	Write_IIC_Com(0x40);	//对应：~0.77xVCC(RESET)
	Write_IIC_Com(0x8D);	//设置电荷泵（设置DC-DC）命令
	Write_IIC_Com(0x14);	//使能电荷泵
	Write_IIC_Com(0xAF);	//开显示
	OLED_Clear();			//OLED清屏
}
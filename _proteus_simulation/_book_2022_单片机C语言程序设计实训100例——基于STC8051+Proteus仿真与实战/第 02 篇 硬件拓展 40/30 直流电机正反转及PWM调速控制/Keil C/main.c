//-----------------------------------------------------------------
//  名称: 直流电机正反转及PWM调速控制
//-----------------------------------------------------------------
//  说明: 本例SW1的三个档位用于设置电机正、反转及停转，K1、K2用于控制
//        电机PWM调速.
//
//-----------------------------------------------------------------
#define u8 	unsigned char
#define u16	unsigned int
#define u32	unsigned long
#include "STC15xxx.h"
#include <intrins.h>
#define S1_ON() (P3 & (1<<4)) == 0x00	//正转
#define S2_ON() (P3 & (1<<5)) == 0x00	//停转
#define S3_ON() (P3 & (1<<6)) == 0x00	//反转
sbit M_DIR = P1^4; 						//方向控制
sbit M_PWM = P1^7;						//PWM调速控制(PWM7通道)
sbit KA = P3^2;							//加速键
sbit KB = P3^3;							//减速键
//-----------------------------------------------------------------
#define MAIN_Fosc	12000000L			//主频定义12MHz
const u16 CYCLE = 2000L;				//定义PWM周期(最大值为32767)
//-----------------------------------------------------------------
void PWM_config();
void PWM7_SetPwmw(u16 w);
//-----------------------------------------------------------------
// 延时子程序（x=1~255ms,自适应时钟）
//-----------------------------------------------------------------
void delay_ms(u8 x) {
	u16 i;
	do{
		i = MAIN_Fosc / 13000;
		while(--i);
	}while(--x);
}
//-----------------------------------------------------------------
// PWM配置(增强型)
//-----------------------------------------------------------------
void PWM_config() {
	P1M1 = 0x00;	P1M0 = 0x00;		//配置为准双向
	P2M1 = 0x00;	P2M0 = 0x00;
	P3M1 = 0x0C; 	P3M0 = 0x00;		//P3.2-3高阻输入,其余为准双向
	P_SW2 |= 0x80;						//扩展SFR访问控制使能
	PWMCKS = 0x07;		//选择系统时钟,7+1分频,实际为2^7=128分频
	PWMC = CYCLE;		//设置PWM周期=2000*1000/(12000000/128)≈21.3ms
	PWM7T1 = CYCLE/2;	PWM7T2 = 0;//PWM7第1,2次翻转计数初值PWM7T1,PWM7T2
	PWM7CR = 0x00;						//PWM7输出到P1.7
	PWMCFG = 0x00;						//配置PWM初始电平（均为低电平）
	PWMCR = 0x3F;						//使能PWM2~7共6路PWM输出
	PWMCR |= 0x80;						//使能PWM波形发生器，开始计数
	P_SW2 &= ~0x80;						//扩展SFR访问控制禁止
}
//-----------------------------------------------------------------
// PWM7脉宽设置
//-----------------------------------------------------------------
void PWM7_SetPwmw(u16 w) {
	//w=0或CYCLE时,通过PWMCR&=~0x20禁止PWM7输出,直接置M_PWM=0或1
	if (w == 0)				{	PWMCR &= ~0x20;	M_PWM = 0;	}
	else if (w == CYCLE)	{	PWMCR &= ~0x20;	M_PWM = 1;	}
	else {								//w在0与CYCLE之间则开始调速控制
		P_SW2 |= 0x80;					//扩展SFR访问控制使能
		PWM7T1 = w; PWMCR |= 0x20;		//修改第1次翻转值，使能PWM7输出
		P_SW2 &= ~0x80; 				//扩展SFR访问控制禁止
	}
}
//-----------------------------------------------------------------
// 主程序
//-----------------------------------------------------------------
void main() {
	u32 speed = CYCLE/2;				//默认初始速度
	P0M1 = 0xFF; P0M0 = 0x00;			//P0配置为高阻输入
	P1M1 = 0x00; P0M0 = 0x00;			//P1配置为准双向口
	PWM_config();						//PWM配置(增强型)
	while (1) {


	}
}
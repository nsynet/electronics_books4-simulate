//-----------------------------------------------------------------
//  名称: 16键解码芯片74C922及触控芯片TTP224应用
//-----------------------------------------------------------------
//  说明: 通过使用74C922解码芯片,可使得程序代码大为简化.
//		在按下不同按键时,数码管显示对应键值,蜂鸣器输出提示音.
//		本例同时使用了基于触控芯片TTP224的触摸板，可进一步提升
//		用户操控体验(仿真电路中用触摸组件代替).
//
//-----------------------------------------------------------------
#include "STC15xxx.h"
#include <intrins.h>
#define u8 	unsigned char
#define u16	unsigned int
#define MAIN_Fosc 12000000L		//时钟频率定义
sbit BEEP = P3^7;				//蜂鸣器(连接在P3.7)
sbit LED = P7^6;				//LED(连接在P7.6)
sbit TOUCH = P2^0;				//触摸键(连接在P2.0)
//按键判断(有键按下时DA输出高电平)
#define Key_Pressed ((P0 & (1<<4)) != 0x00) //DA在P0.4
#define Key_NO (P0 & 0x0F)		//获取键值(P0端口低4位)
//0-9,A-F的数码管段码
code u8 SEG_CODE[] = {
  0x3F,0x06,0x5B,0x4F,0x66,0x6D,0x7D,0x07,
  0x7F,0x6F,0x77,0x7C,0x39,0x5E,0x79,0x71
};
//-----------------------------------------------------------------
// 延时函数(参数取值限于1~255)
//-----------------------------------------------------------------
void delay_ms(u8 ms) {
	u16 i;
	do{
		i = MAIN_Fosc / 13000;
		while(--i);
	}while(--ms);
}
//-----------------------------------------------------------------
// 发声子程序
//-----------------------------------------------------------------
void Sounder() {


}
//-----------------------------------------------------------------
// 主程序
//-----------------------------------------------------------------
void main() {
	P0M1 = 0xFF; P0M0 = 0x00;			//P0配置为高阻输入P3,P7配置为高阻输入
	P1M1 = 0x00; P1M0 = 0x00;			//P1、P2、P3P7配置为高阻输入
	P2M1 = 0x00; P2M0 = 0x00;
	P3M1 = 0x00; P3M0 = 0x00;
	P7M1 = 0x00; P7M0 = 0x00;
	P0 = 0xFF; P3 = 0x00;
	P1 = 0x00;							//初始时关闭数码管显示
	while(1){

	
	}
}
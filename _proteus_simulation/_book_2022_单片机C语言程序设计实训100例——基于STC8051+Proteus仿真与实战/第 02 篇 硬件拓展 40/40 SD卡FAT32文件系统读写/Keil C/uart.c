//-----------------------------------------------------------------
// 名称: 串口驱动程序
//-----------------------------------------------------------------
#include <string.h>
#include "STC15xxx.h"
#include "FAT/mytype.h"
//-----------------------------------------------------------------
// 长整数转移为字符串
//-----------------------------------------------------------------
u8 Long_Str(long dat, u8* str) {// 长整型数转换为字符串，返回值为转换后的字符串长度
	signed char i = 0;
	u8 len = 0;
	u8 buf[11];								//长整数最大值4294967295，转ASCII码后占用10+1=11字节 
	if (dat < 0) {						//如果为负数，首先取绝对值，并添加负号
		dat = -dat;
		*str++ = '-';
		len++;
	}
	do {											//低位在前高位在后顺序排列
		buf[i++] = dat % 10 + 0x30; // C语言中数组下标固定从0开始
		dat /= 10;
	} while (dat > 0);
	len += i;									//i最后的值就是有效字符的个数
	while (i-- > 0) {					//高位在前低位在后顺序排列
		*str++ = buf[i];
	}
	*str = 0;
	return len;
}
//-----------------------------------------------------------------
// 串口初始化
//-----------------------------------------------------------------
void UART_Init() {					//9600bps@22.1184MHz
	SCON = 0x50; 
	AUXR &= 0xBF;
	AUXR &= 0xFE;
	TMOD &= 0x0F;
	TL1 = 0xD0;
	TH1 = 0xFF;
	ET1 = 0;
	TR1 = 1;
	ES = 1;
	EA = 1;
}
//-----------------------------------------------------------------
// 串口输出1字节
//-----------------------------------------------------------------
void UART_Send_Byte(u8 dat) {
	ES = 0; 	SBUF = dat;	while (!TI);  	TI = 0;  	ES = 1;
}
//-----------------------------------------------------------------
// 串口输出回车换行符
//-----------------------------------------------------------------
void UART_Send_Enter() {
	UART_Send_Byte(0x0D);
	UART_Send_Byte(0x0A);
}
//-----------------------------------------------------------------
// 串口输出字符串
//-----------------------------------------------------------------
void UART_Send_Str(char* s) {
	u16 i;
	u16 len = strlen(s) - 1;
	for (i = 0; i < len; i++)
		UART_Send_Byte(s[i]);
	if (s[i] == '\n') {
		UART_Send_Enter();
	}
	else {
		UART_Send_Byte(s[i]);
	}
}
//-----------------------------------------------------------------
// 串口输出整数串
//-----------------------------------------------------------------
void UART_Send_Num(u32 dat) {
	u8 temp[11];
	Long_Str(dat, temp);
	UART_Send_Str(temp);
	UART_Send_Enter();
}
//-----------------------------------------------------------------
// 发送字符串+数值
//-----------------------------------------------------------------
void UART_Send_StrNum(char* inf, u32 dat) {
	UART_Send_Str(inf);
	UART_Send_Num(dat);
}
//-----------------------------------------------------------------
// 十六进制转换为字符串
//-----------------------------------------------------------------
void Hex2Str(u16 hex,char *str) {
	u8 t, i;
	for (i = 3; i != 0xFF; i--) {
		t= (hex >> (i*4)) & 0x000F;
		str[3 - i] = (t >= 10) ? (t - 10 + 'A') : (t + '0');
	}
}

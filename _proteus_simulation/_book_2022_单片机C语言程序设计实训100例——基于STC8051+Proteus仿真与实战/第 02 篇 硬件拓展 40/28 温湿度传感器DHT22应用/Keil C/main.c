//-------------------------- main.c -------------------------------
//	名称：温湿度传感器DHT22应用
//-----------------------------------------------------------------
//	说明：调用DHT22传感器库函数读取温湿度数据，经转换后在4位模式的
//        液晶屏上显示.
//
//-----------------------------------------------------------------
#include "STC15xxx.h"
#include <intrins.h>
#include <stdio.h>
#define u8  unsigned char
#define u16 unsigned int
#define u32 unsigned long
u8 disp_buff[17];
u32 Millis = 0;
#define NAN 		1000000.0
#define MAIN_Fosc	12000000L
//-----------------------------------------------------------------
extern void LCD_Initialise();
extern void LCD_ShowString(u8 r, u8 c,u8 *str);
extern float readTemperature(bit s);
extern float readHumidity();
extern void DHT_Init();
//-----------------------------------------------------------------
// 延时2000ms
//-----------------------------------------------------------------
void Delay2000ms() {	//@12MHz
	u8 i, j, k;
	_nop_(); _nop_();
	i = 92; j = 50; k = 238;
	do {
		do {
			while (--k);
		} while (--j);
	} while (--i);
}
//-----------------------------------------------------------------
void delay_ms(u8 ms) {
	u16 i;
	do{
		i = MAIN_Fosc / 13000; while(--i); 
	}while(--ms);
}
//-----------------------------------------------------------------
// T0初始化(在12T模式下运行)
//-----------------------------------------------------------------
void Timer0Init() {		//1ms@12MHz

}
//-----------------------------------------------------------------
// T0中断函数
//-----------------------------------------------------------------
void Timer0_INT () interrupt 1 {


}
//-----------------------------------------------------------------
// 主函数
//-----------------------------------------------------------------
void main() {
	float h,t;								//浮点湿度、温度
	P1M1 = 0; P1M0 = 0;						//配置为准双向口
	P3M1 = 0; P3M0 = 0;
	Timer0Init();							//T0初始化
	DHT_Init();								//DHT初始化
	LCD_Initialise(); 						//液晶初始化
	LCD_ShowString(0,0," DHT22 H&T Test ");//显示标题
	LCD_ShowString(1,0,"Starting...     ");	//显示等待信息
	ET0 = 1; EA = 1;						//许可T0中断
	while(1) {								//循环读取温度并显示

	
	}
}
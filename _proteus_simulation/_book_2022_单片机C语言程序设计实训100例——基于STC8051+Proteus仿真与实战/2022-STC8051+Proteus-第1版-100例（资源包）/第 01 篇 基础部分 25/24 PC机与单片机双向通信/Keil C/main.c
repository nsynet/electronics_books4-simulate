//-----------------------------------------------------------------
//  名称: PC机与STC15单片机双向通信
//-----------------------------------------------------------------
//  说明: 单片机可接收PC机发送的数字字符,按下单片机K1按键时,单片机
//		可向PC机发送字符串.在Proteus环境下完成本实验时,需要
//		先安装Virtual Serial Port Driver和串口调试助手软件.
//		建议在VSPD中将COM3和COM4设为对联端口.Proteus中设COMPIM
//		为COM4,在串口助手中选择COM3,完成配置后即可实现单片机程序
//		与XP下串口助手软件之间的双向通讯.
//		本例缓冲为4个数字字符,缓冲满后新接收的字符从缓冲前面存放
//		（环形缓冲）,覆盖原来放入的字符.
//		如果发送的数字串中遇到"#"号则从缓冲起始位置开始存放.
//
//-----------------------------------------------------------------
#include "STC15xxx.h"
#include <intrins.h>
#include <stdio.h>
#define u8  unsigned char
#define u16 unsigned int
#define MAIN_Fosc	18432000L	//振荡器频率18.432MHz
bit TX1_Busy; 					//发送忙标志
u8 code SEG_CODE[] = 			//共阴数码管数字段码表,最后为"-"的段码
{ 0x3F,0x06,0x5B,0x4F,0x66,0x6D,0x7D,0x07,0x7F,0x6F,0x40 };
u8 R[] = {10,10,10,10};			//保存接收到的四位数字(初始时为4个"-")
//-----------------------------------------------------------------
// 延时子程序（x=1~255ms,自适应时钟）
//-----------------------------------------------------------------
void delay_ms(u8 x) {
	u16 i;
	do{
		i = MAIN_Fosc / 13000;
		while(--i);
	}while(--x);
}
//-----------------------------------------------------------------
// 串口初始化(9600bps@18.432MHz,使用Timer2定时器)
//-----------------------------------------------------------------
void UartInit()	{



}
//-----------------------------------------------------------------
// 主程序
//-----------------------------------------------------------------
void main() {
	u8 i;

	
}
//-----------------------------------------------------------------
// 串口接收中断
//-----------------------------------------------------------------
void receive_4_digit() interrupt 4 {
	static u8 i = 0;			//接收缓冲索引(静态变量)
	u8 c;						//当前接收到的字符
	if (RI) {					//接收中断标志位判断

	
	
	}
	if (TI) {					//发送中断标志位判断

	
	
	}
}
//-----------------------------------------------------------------
// INT0中断发送字符串
//-----------------------------------------------------------------
void EX_INT0() interrupt 0 {
	char *s = "这是由STC8051单片机发送的字符串!!!\r\n";

	
	
	
}
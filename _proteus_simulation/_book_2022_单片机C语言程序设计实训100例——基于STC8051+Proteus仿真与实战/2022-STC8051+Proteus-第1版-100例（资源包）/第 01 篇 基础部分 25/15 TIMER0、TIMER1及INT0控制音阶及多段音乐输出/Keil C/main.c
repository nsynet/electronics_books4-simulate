//-----------------------------------------------------------------
//  名称: TIMER0、TIMER1及INT0控制音阶及多段音乐输出
//-----------------------------------------------------------------
//  说明: 本例使用定时器中断控制演奏一段音阶,按K1开始播放
//        程序同时内置三段音乐曲目,K2可启停音乐播放,K3用于选择音乐段.
//
//-----------------------------------------------------------------
#include "STC15xxx.h"
#include <intrins.h>
#define u8 	unsigned char
#define u16	unsigned int
//-----------------------------------------------------------------
//注：在12MHz系统时钟下仿真音频信号输出时可能有卡顿，故暂在6MHz系统时钟下仿真
#define  MAIN_Fosc 6000000L	//定义主时钟
//-----------------------------------------------------------------
sbit SPK = P3^7;	//扬声器输出引脚
//-----------------------------------------------------------------
sbit K1  = P0^0;	//音阶播放控制引脚K1
sbit K2  = P2^4;	//片断播放和停止键K2(注：曲目选择键K3由INT0中断控制)
//-----------------------------------------------------------------
code u8 SEG_CODE[] = {	//数码管段码表
 0xC0,0xF9,0xA4,0xB0,0x99,0x92,0x82,0xF8,0x80,0x90 };
//-----------------------------------------------------------------
//14个音符在STC15的T0/T1定时器12T/模式0下的定时/计数初值表(16位/自动重装)
//数组1：计算公式为(65536-音符半周期×(FOSC/12/1000000.0)) 本例：FOSC=6M
code u16 TONE1_LIST[] = {
 0,65058,65110,65156,65177,65217,65251,65283,
   65297,65323,65346,65357,65376,65394,65408 };
//-----------------------------------------------------------------
//数组2：计算公式为(-音符半周期×(FOSC/12/1000000.0))
//相对于数组1省略了被减数65536,使用时要注意添加“-”
code u16 TONE2_LIST[] = {
 0,478,425,379,358,318,284,253,238,212,189,178,159,142,127 };
//-----------------------------------------------------------------
//数组3：根据数组1拆成高低两个数组,例如65058=(254<<8)+34
code u8 HI_LIST[] = {
 0,254,254,254,254,254,254,255,255,255,255,255,255,255,255 };
code u8 LO_LIST[] = {
 0, 34, 86,133,154,193,228,  3, 17, 43, 66, 77, 97,114,129 };
//-----------------------------------------------------------------
//曲目索引,音符索引,音阶索引
volatile u8 Song_idx = 0, Tone_idx = 0, Tone_i = 0;
//-----------------------------------------------------------------
//三段曲目音符(这些数据是任意编写的,可自行修改)
u8 code Song[][50] = {
 {1,2,3,1,1,2,3,1,3,4,5,3,4,5,5,6,5,3,5,6,5,3,5,3,2,1,2,1,-1},
 {3,3,3,4,5,5,5,5,6,5,3,5,3,2,1,5,6,5,3,3,2,1,1,-1},
 {3,2,1,3,2,1,1,2,3,1,1,2,3,1,3,4,5,3,4,5,5,6,5,3,5,3,2,1,3,2,1,1,-1}
};
//三段曲目节拍
u8 code Len[][50] = {
 {1,1,1,1,1,1,1,1,1,1,2,1,1,2,1,1,1,1,1,1,1,1,1,1,1,2,1,2,-1},
 {1,1,1,1,1,1,2,1,1,1,1,1,1,1,2,1,1,1,1,1,1,2,2,-1},
 {1,1,2,1,1,2,1,1,1,1,1,1,1,1,1,1,2,1,1,2,1,1,1,1,1,1,1,2,1,1,2,2,-1}
};
//-----------------------------------------------------------------
// 延时子程序（x取值:1~65535）
//-----------------------------------------------------------------
void Delay1ms() {	//@6.000MHz
	u8 i = 6, j = 211;
	do {
		while (--j);
	} while (--i);
}
//-----------------------------------------------------------------
void delay_ms(u16 x) { while(x--) Delay1ms(); }
//-----------------------------------------------------------------
// Timer0初始配置（用于播放音阶）
//-----------------------------------------------------------------
void Timer0Init() {


}
//-----------------------------------------------------------------
// Timer1初始配置（用于播放音乐片断）
//----------------------------------------------------------------- 
void Timer1Init() {


}
//-----------------------------------------------------------------
// 主程序
//-----------------------------------------------------------------
void main() {
	P0M1 = 0x00; P0M0 = 0x00;	//P0~P3配置为准双向口
	P1M1 = 0x00; P1M0 = 0x00;
	P2M1 = 0x00; P2M0 = 0x00;
	P3M1 = 0x00; P3M0 = 0x00;
	P1 = SEG_CODE[0];			//数码管初始显示
	IT0 = 1;					//外部中断0触发方式:下降沿触发
	IP = 0x01;					//INT0设为高优先级
	Timer0Init();				//Timer0初始配置
	Timer1Init();				//Timer1初始配置
	EX0 = 1; ET0 = 1; ET1 = 1;	//许可INT0,T0,T1中断
	EA = 1;						//开总中断
	while (1) {
		if (K1 == 0) {			//K1按下（开始输出音阶：14个音符）

		
		}
		else if (K2 == 0) {		//K2按下（开始输出当前音乐片断）

		
		}
	}
}
//-----------------------------------------------------------------
// 定时器0中断例程（控制音阶输出）
//-----------------------------------------------------------------
void Timer0_INT() interrupt 1 {
	static u8 PRE_i = -1;
	SPK ^= 1;					//音频脉冲输出
	if (Tone_i != PRE_i) {		//索引变化时用软件重置初值

	
	}
}
//-----------------------------------------------------------------
// 定时器1中断例程（控制音乐片断输出）
//-----------------------------------------------------------------
void Timer1_INT() interrupt 3 {
	static u8 PRE_idx = -1; u8 i;
	SPK ^= 1;					//音频脉冲输出
	if (Tone_idx != PRE_idx) {	//索引变化时用软件重置初值

	
	}
}
//-----------------------------------------------------------------
// 外部中断0(K3)
//-----------------------------------------------------------------
void EX0_INT() interrupt 0 {


}
//-----------------------------------------------------------------
//  名称: PCA模块定时、高速脉冲、PWM输出测试(注：切换测试需重启Proteus)
//-----------------------------------------------------------------
//  说明: 多路开关切换到不同位置然后重启，可分别测试PCA软件定时输出
//       （控制LED闪烁）、高速脉冲输出（输出100KHz方波，需用示波器
//        观察）、PWM输出控制LED0亮度来回渐变.
//
//-----------------------------------------------------------------
#include "STC15xxx.h"
#include <intrins.h>
#define u8 	unsigned char
#define u16	unsigned int
#define u32	unsigned long
#define MAIN_Fosc 18432000L	//工作频率18.432MHz
//-----------------------------------------------------------------
#define CCP_S0	0x10		//P_SW1.4
#define CCP_S1	0x20		//P_SW1.5
//-----------------------------------------------------------------
#define T_Count_5ms	(0.005 * MAIN_Fosc / 12)	//PCA 5ms计数值
#define T100KHz (MAIN_Fosc / 4 / 100000)		//100KHz定时
u8 T_Count;					//累计计数变量
u16 value;					//16位计数值
//-----------------------------------------------------------------
//PCA_LED0用于PCA软件定时器输出测试
sbit PCA_LED0 = P1^1;		//PCA定时控制闪烁的LED(对应CCP0)
//PCA_LED1用于PCA高频输出测试
sbit PCA_LED1 = P1^0;		//PCA定时控制闪烁的LED(对应CCP1)
//-----------------------------------------------------------------
void PCA_Timer_Test();
void PCA_HighPulse_Test();
void PCA_PWM_Test();
//-----------------------------------------------------------------
// 延时函数(参数取值限于1~255)
//-----------------------------------------------------------------
void delay_ms(u8 ms) {
	u16 i;
	do{
		i = MAIN_Fosc / 13000;
		while(--i);
	}while(--ms);
}
//-----------------------------------------------------------------
// 主程序(每次切换测试时，须停止然后重新运行Proteus)
//-----------------------------------------------------------------
void main() {
	P0M0 = 0x00; P0M0 = 0x00;			//P0~P3配置为准双向
	P1M1 = 0x00; P1M0 = 0x00;
	P2M1 = 0x00; P2M0 = 0x00;
	P3M1 = 0x00; P3M0 = 0x00;
	P6M1 = 0xFF; P6M0 = 0x00;			//P6配置为高阻输入
	while (1) {

	
	}
}
//-----------------------------------------------------------------
// PCA定时器配置
//-----------------------------------------------------------------
void PCA_Timer_Test() {



}
//-----------------------------------------------------------------
// PCA高速脉冲输出配置
//-----------------------------------------------------------------
void PCA_HighPulse_Test() {



}
//-----------------------------------------------------------------
// PWM输出测试(PCA模块0的8位模式测试)
//-----------------------------------------------------------------
void PCA_PWM_Test() {
	u8 t = 0x20;
	P_SW1 = 0x00;		//选择：P1.2/ECI,P1.1/CCP0,P1.0/CCP1,P3.7/CCP2
	CCON = 0x00;				//初始化PCA控制寄存器
	CL = 0x00; CH = 0x00;		//复位PCA 16位计数寄存器
	CMOD = 0x02;				//PCA时钟源：SYSclk/2,禁止PCA定时溢出中断
	//PCA模块0测试
	PCA_PWM0 = 0x00;			//PCA模块0配置为8位PWM模式
	CCAP0H = CCAP0L = t;		//PWM0占空比为87.5% ((100H-20H)/100H)
	CCAPM0 = 0x42;				//PCA模块0使能比较匹配，置于PWM模式
	CR = 1;						//PCA定时器开始工作
	while (1) {					//PWM0占空比在87.5%-3.9%之间来回渐变
		for (t = 0x20; t < 0xF0; t++) {

		
		
		}
		for (t = 0xF0; t != 0x20; t--) {

		
		
		}
	}
}
//-----------------------------------------------------------------
// PCA中断处理程序（同时服务于: 1 软件定时器 2.高速脉冲输出）
//-----------------------------------------------------------------
void PCA_Handler() interrupt 7 using 1 {
	if (CCF0) {					//定时器模式触发，控制LED闪烁

	
	
	}
	//--------------------------------------------------------------
	if (CCF1) {					//高速脉冲模式触发：控制输出100KHz方波

	
	
	}
}
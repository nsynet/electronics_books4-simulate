//-----------------------------------------------------------------
//  名称: 数码管显示的GP2D12仿真测距警报器
//-----------------------------------------------------------------
//  说明: 程序运行时,数码管显示当前距离,当距离小于30CM时输出报警声音.
//
//-----------------------------------------------------------------
#define u8  unsigned char
#define u16 unsigned int
#define MAIN_Fosc 12000000L
#include "STC15xxx.h"
#include <intrins.h>
#include <stdio.h>
#include <math.h>
//595引脚定义
sbit DS		= P3^5;			//输出锁存器控制脉冲
sbit SH_CP	= P3^6;			//串行数据输入 
sbit ST_CP	= P3^7;			//移位时钟脉冲
sbit BEEP	= P2^7;			//蜂鸣器定义
//线性化系数(先实测8个距离的输出电压数据,再通过EXCEL表格公式计算得到)
#define M_C		3738		//分别标定m',b',k'
#define B_C		-353
#define K_C		2
//-----------------------------------------------------------------
#define ADC_POWER 	0x80 	//ADC电源控制位
#define ADC_FLAG 	0x10 	//ADC完成标志
#define ADC_START 	0x08 	//ADC起始控制位
#define ADC_SPEEDLL	0x00 	//540个时钟
#define ADC_SPEEDL 	0x20 	//360个时钟
#define ADC_SPEEDH 	0x40 	//180个时钟
#define ADC_SPEEDHH	0x60 	//90个时钟
code u8 SEG_CODE[] =		//共阴数码管段码表
{ 0xC0,0xF9,0xA4,0xB0,0x99,0x92,0x82,0xF8,0x80,0x90 };
u8 Disp_Buff[] = {0,0,0};	//距离显示缓冲(小数位,个位,十位)
extern u8 Get_CHx_AD_Value(u8 ch);
//-----------------------------------------------------------------
// 延时函数(参数值255以内)
//-----------------------------------------------------------------
void delay_ms(u8 ms) {
	u16 i;
	do{ i = MAIN_Fosc / 13000; while(--i); } while(--ms);
}
//-----------------------------------------------------------------
// 初始化ADC
//-----------------------------------------------------------------
void InitADC() {

}
//-----------------------------------------------------------------
// 对指定通道进行AD转换
//-----------------------------------------------------------------
u16 GetADCResult(u8 ch) {

}
//------------------------------------------------------------------
// 报警程序
//------------------------------------------------------------------
void Alarm() { 

}
//-----------------------------------------------------------------
// 串行输入子程序
//-----------------------------------------------------------------
void Serial_Input_595(u8 dat) {

}
//-----------------------------------------------------------------
// 并行输出子程序
//-----------------------------------------------------------------
void Parallel_Output_595() {

} 
//-----------------------------------------------------------------
// 进行连续采样,然后根据采样平均值及计算公式得到距离
//-----------------------------------------------------------------
float Get_Distance() {


}
//-----------------------------------------------------------------
// 将3位整数分解为3个数位
//-----------------------------------------------------------------
void DEC_TO_3DIGIT(u16 d) {


}
//------------------------------------------------------------------
// 主程序
//------------------------------------------------------------------
void main() { 
	float d; u8 i; 
	P1M1 = 0x00; P1M1 = 0x00;					//配置为准双向
	P2M1 = 0x00; P2M1 = 0x00;
	P3M1 = 0x00; P3M1 = 0x00;
	BEEP = 0;									//关闭蜂鸣器
	InitADC();									//AD端口初始化
	i = 4; while (i--) delay_ms(200);			//延时等待系统稳定
	while (1) {

	
	}
}
//-----------------------------------------------------------------
//  名称: L298N驱动双极步进电机运行
//-----------------------------------------------------------------
//	说明: 本例由L298驱动双极四相步进电机(20BY45),按下K1时电机正转10圈,
//		按下K2时反转10圈,按下K3时停止,按下K4与K5时分别进行加速与减速.
//
//-----------------------------------------------------------------
#include "STC15xxx.h"
#include <intrins.h>
#include <math.h>
#define u8	unsigned char
#define u16	unsigned int
#define u32	unsigned long
//本例两相四线步进电机工作于2-2P方式(双2拍)
//正转励磁序列为AB/CD->BA/CD->BA/DC->AB/DC
u8 code DRV_SEQ[] = {0x0A,0x06,0x05,0x09};
sbit K1 = P3^0;						//正转
sbit K2 = P3^1;						//反转
sbit K3 = P3^2;						//停止
sbit K4 = P3^3;						//加速
sbit K5 = P3^4;						//减速
//-----------------------------------------------------------------
int STEPS = 20;						//每圈总步数（20步电机/每步18°）
u8 Direct = 0;						//运行方向
u32 TimeLength;						//控制转速的延时时长控制变量
u32 LastStep_Time = 0;				//上一步所处的时间戳
volatile u32 NOW = 0, __curr_time;
int speed = 25;						//转速控制变量（RPM）
//-----------------------------------------------------------------
// T1初始配置（1ms定时@12.000MHz,12T/16位自动重装）
//----------------------------------------------------------------- 
void Timer1Init() {

}
//-----------------------------------------------------------------
// 定时器1中断例程(每1ms累加变量NOW)
//-----------------------------------------------------------------
void T1_INT() interrupt 3 {
	NOW++;
	//TL1 = 0x18;					//设置定时初值(16位自动重装,此2行可省略)
	//TH1 = 0xFC;					//设置定时初值
}
//-----------------------------------------------------------------
// 步进电机速度设置(单位:RPM)
//-----------------------------------------------------------------
void setSpeed(long speed) {
	TimeLength = 60L * 1000L / STEPS / speed;
	P2 = ~(0x80>>(speed/5 - 1));	//条形LED按比例显示速度：speed=5,10...
}
//-----------------------------------------------------------------
// 步进电机运转控制函数(参数为运转的步数,换为圈数需乘以20,即STEPS)
//-----------------------------------------------------------------
void Stepper_RUN(int _steps) {
	static int Curr_steps = 0;		//当前已运行总步数（对应当前位置）
	int Left_steps = abs(_steps);	//剩余需走的步数(初始为要运行的总步数)
	if (_steps > 0) Direct = 1;		//根据剩余步数判断运转方向
	if (_steps < 0) Direct = 0;
	while (Left_steps > 0) {		//剩余步数非0则继续
		if (K3 == 0) return;		//按下K3时提前结束运行
		if(K4 == 0) {				//加速控制
			while (K4 == 0);
			if (speed < 40) speed += 5; else speed = 40;
			setSpeed(speed);
		}
		if(K5 == 0) {				//减速控制
			while (K5 == 0);
			if (speed >= 10) speed -= 5; else speed = 5;
			setSpeed(speed);
		}
		__curr_time = NOW;			//获取当前计时值
		//到达指定节拍时长则执行一步（通过频率控制速度）
		if (__curr_time - LastStep_Time >= TimeLength) { 
			LastStep_Time = __curr_time;
			if (Direct == 1) {		//控制正转
				Curr_steps++;
				if (Curr_steps == STEPS) Curr_steps = 0;
			}
			else { 					//控制反转
				if (Curr_steps == 0) Curr_steps = STEPS;
				Curr_steps--;
			}
			Left_steps--; 			//剩余步数递减
			P1 = DRV_SEQ[Curr_steps % 4]; //输出1个驱动节拍(运行1步)
		}
	}
}
//-----------------------------------------------------------------
// 主程序
//-----------------------------------------------------------------
void main() { 
	P0M1 = 0x00; P0M0 = 0x00;		//配置为准双向口
	P1M1 = 0x00; P1M0 = 0x00;
	P2M1 = 0x00; P2M0 = 0x00;
	P3M1 = 0xFF; P3M0 = 0x00;		//配置为高阻输入
	Timer1Init();					//T1初始配置
	IE = 0x88;						//T1中断使能
	setSpeed(speed);				//设置转速
	while(1) {

	}
}
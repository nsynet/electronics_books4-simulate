//-----------------------------------------------------------------
//  名称：NTC热敏电阻应用测试
//-----------------------------------------------------------------
//  说明：使用负温度系数热敏电阻器（NTC）完成温度检测，在不同温度下分压电路
//       向STC15的AD0通道送入不同的模拟电压值，通过A/D转换值及特定计算公
//       式即可得出温度值.
//
//-----------------------------------------------------------------
#define MAIN_Fosc 11059200L	//晶振频率
#define u8 	unsigned char
#define u16	unsigned int
#include "STC15xxx.h"
#include <intrins.h>
#include <stdio.h>
#include <math.h>
//-----------------------------------------------------------------
#define ADC_POWER 	0x80 	//ADC电源控制位
#define ADC_FLAG 	0x10 	//ADC完成标志
#define ADC_START 	0x08 	//ADC起始控制位
#define ADC_SPEEDLL	0x00 	//540个时钟
#define ADC_SPEEDL 	0x20 	//360个时钟
#define ADC_SPEEDH 	0x40 	//180个时钟
#define ADC_SPEEDHH	0x60 	//90个时钟
//-----------------------------------------------------------------
#define tPin	0			//模拟信号输入通道0
#define R1		10000		//串接电阻R1的阻值(10K)
#define T2		(273.15+25)	//标称电阻下的温度（25℃，对应K温度为273.15+25）
#define R		10000		//25℃下的阻值（10K）
#define B		3950		//热敏电阻Beta系数（通常为：3000～4000）
//-----------------------------------------------------------------
bit TX1_Busy = 0;
char disp_buff[30];
//-----------------------------------------------------------------
// 延时函数(参数取值限于1~255)
//-----------------------------------------------------------------
void delay_ms(u8 ms) {
	u16 i;
	do{
		i = MAIN_Fosc / 13000;
		while(--i);
	}while(--ms);
}
//-----------------------------------------------------------------
// 初始化串口(9600bps@11.0592MHz)
//-----------------------------------------------------------------
void UartInit() {


}
//-----------------------------------------------------------------
// 向串口输出一个字符
//-----------------------------------------------------------------
void PutChar(u8 c) {


}
//------------------------------------------------------------------
// 串口输出字符串
//------------------------------------------------------------------
void Putstr(char *s) {

}
//-----------------------------------------------------------------
// 初始化ADC
//-----------------------------------------------------------------
void InitADC() {


}
//-----------------------------------------------------------------
// 读取ADC结果
//-----------------------------------------------------------------
u16 GetADCResult(u8 ch) {


}
//-----------------------------------------------------------------
// 获取NTC值
//-----------------------------------------------------------------
void get_NTC() {


}
//-----------------------------------------------------------------
// 主程序
//-----------------------------------------------------------------
void main() {
	P1M1 = 0xFF; P3M0 = 0x00;		//P1配置为高阻输入
	P3M1 = 0x00; P3M0 = 0x00;		//P3配置为准双向口
	InitADC();						//初始化ADC
	UartInit();						//初始化串口
	ES = 1; EA = 1;					//允许串口中断,开总中断
	while (1) {

	
	
	}
}
//-----------------------------------------------------------------
// 串口接收中断函数 
//-----------------------------------------------------------------
void Serial_INT() interrupt 4 {



}
//---------------------------- DHT22.c --------------------------------
//  名称: DHT温湿度传感器驱动程序
//---------------------------------------------------------------------
#include "DHT.h"
#include <math.h>
sbit DHT_Pin = P3^2;
#define MAIN_Fosc 12000000L
//---------------------------------------------------------------------
// 延时函数
//---------------------------------------------------------------------
extern u32 Millis;
extern void delay_ms(u8 ms);
void Delay1us() 	{ _nop_(); _nop_(); _nop_(); _nop_();}
void delay_us(u8 x)	{ while (x--) Delay1us(); }
//---------------------------------------------------------------------
// DHT初始化
//---------------------------------------------------------------------
void DHT_Init() {
	_type = DHT22;
	_count = 32;	//count=16~48，取中间值32
	First_Reading = 1;
	DHT_Pin = 1;	//将DHT引脚设为输入口
	_Last_ReadTime = 0;
}
//---------------------------------------------------------------------
// 读取温度数据 (参数值为0表示摄氏温度，1表示华氏温度)
//---------------------------------------------------------------------
float readTemperature(bit S) {
	float f;
	if (read()) {
		switch (_type) {
			case DHT11:
				f = DHT_data[2]; if(S) f = convertCtoF(f); return f;
			case DHT21:
			case DHT22:
				f = DHT_data[2] & 0x7F;
				f *= 256;
				f += DHT_data[3];
				f /= 10;
				if (DHT_data[2] & 0x80) f *= -1;
				if(S) f = convertCtoF(f);
				return f;
		}
	}
	return NAN;
}
//---------------------------------------------------------------------
// 转换为华氏温度
//---------------------------------------------------------------------
float convertCtoF(float c) { return c * 9 / 5 + 32; }
//---------------------------------------------------------------------
// 转换为摄氏温度
//---------------------------------------------------------------------
float convertFtoC(float f) { return (f - 32) * 5 / 9; }
//---------------------------------------------------------------------
// 读取湿度数据
//---------------------------------------------------------------------
float readHumidity() {
	float f;
	if (read()) {
		switch (_type) {
			case DHT11:
				f = DHT_data[0];
				return f;
			case DHT22:	case DHT21:
				f = DHT_data[0]; f *= 256; f += DHT_data[1]; f /= 10;
				return f;
		}
	}
	return NAN;
}
//---------------------------------------------------------------------
// 读取数据
//---------------------------------------------------------------------
bit read() {



}
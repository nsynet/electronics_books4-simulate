//-----------------------------------------------------------------
// 名称: 液晶控制与显示程序
//-----------------------------------------------------------------
#include "LCD1602.h"
//-----------------------------------------------------------------
// 延时（1ms,xms）
//-----------------------------------------------------------------
void Delay1ms() {		//@12MHz
	u8 i = 12, j = 169;
	do
	{
		while (--j);
	} while (--i);
}
//-----------------------------------------------------------------
void delay_ms(u8 x) {
	while(x--) Delay1ms();
}
//-----------------------------------------------------------------
// 写LCD命令
//-----------------------------------------------------------------
void Write_LCD_Command(u8 cmd) {

}
//-----------------------------------------------------------------
// 写LCD数据
//-----------------------------------------------------------------
void Write_LCD_Data(u8 dat) {

}
//-----------------------------------------------------------------
// LCD初始化
//-----------------------------------------------------------------
void Initialize_LCD() {

}
//-----------------------------------------------------------------
// 在指定位置显示字符串
//-----------------------------------------------------------------
void LCD_ShowString(u8 r, u8 c, char *str) {
	u8 i = 0;
	code u8 DDRAM[] = {0x80,0xC0};				//1602LCD两行的起始DDRAM地址
	Write_LCD_Command(DDRAM[r] | c);			//设置显示起始位置
	for ( i = 0; str[i] && i < 16 ;i++)		//输出字符串
	  Write_LCD_Data(str[i]);
	for (; i < 16; i++)	 									//不足一行时用空格填充
	  Write_LCD_Data(' ');
}
void DisplayOneChar(u8 r, u8 c, char d) {
	u8 i = 0;
	code u8 DDRAM[] = {0x80,0xC0};				//1602LCD两行的起始DDRAM地址
	Write_LCD_Command(DDRAM[r] | c);			//设置显示起始位置
	Delay1ms();
	Write_LCD_Data(d);
	Delay1ms();
}
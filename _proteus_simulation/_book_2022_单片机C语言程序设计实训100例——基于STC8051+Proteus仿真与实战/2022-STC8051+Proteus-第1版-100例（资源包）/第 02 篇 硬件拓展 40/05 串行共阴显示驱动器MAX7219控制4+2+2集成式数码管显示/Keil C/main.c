//-----------------------------------------------------------------
//  名称: 串行共阴显示驱动器MAX7219/7221控制集成式数码管显示
//-----------------------------------------------------------------
//  说明: 本例用MAX7219(MAX7221)控制两组8位数码管动态显示,大大减少了
//		  对单片机引脚和机器时间的占用.
//
//-----------------------------------------------------------------
#include "STC15xxx.h"
#include <intrins.h>
#define u8	unsigned char
#define u16	unsigned int
sbit DIN = 		P1^0;	//数据线
sbit CLK = 		P1^2;	//时钟线
sbit CS7221 =	P1^1;	//片选线
sbit CS7219 =	P1^3;
//在非解码模式下MAX7219/7221对应的段码表,此表不同于直接驱动时所使用的段码表
//原来的各段顺序是：			DP,G,F,E,D,C,B,A
//MAX7219/7221的驱动顺序是：	DP,A,B,C,D,E,F,G
//除小数点位未改变外，其他位是逆向排列的.
//下在前两行为0~F的段码,最后4位为"-(16)/°(17)/C(18)/黑屏(19)"的段码
code u8 SEGCODE_72XX[] = {
	0x7E,0x30,0x6D,0x79,0x33,0x5B,0x5F,0x70,	//0~7
	0x7F,0x7B,0x77,0x1F,0x4E,0x3D,0x4F,0x47,	//8~F
	0x01,0x63,0x4E,0x00							//16~19[ - °C 黑屏]
};
//7219待显示的内容为温度值:-32.75℃("-"前面的最高位黑屏)
//由于本例7219工作于非解码模式,在串行发送时,需要以下表为索引,
//发送SEGCODE_72XX中的对应段码
code u8 Disp_Buffer0[] = {19,16,3,2,7,5,17,18};
//7221待显示的数字串"20150925"(由于本例7221工作于解码模式,故各数位直接发送)
code u8 Disp_Buffer1[] = {2,0,3,5,0,9,2,5};
//-----------------------------------------------------------------
// 延时函数(取值1~65535)
//-----------------------------------------------------------------
void delay_ms(u16 x) { 
	u8 i = 12, j = 169;
	while(x--) {
		do {
			while (--j);
		} while (--i);
	}
}
//-----------------------------------------------------------------
// 向MAX7219/7221指定地址(寄存器)写入1字节数据
//-----------------------------------------------------------------
void Write(u8 addr,u8 dat,u8 Chip_No) {


}
//-----------------------------------------------------------------
// MAX7221/7219初始化
//-----------------------------------------------------------------
void Init_MAX72XX(u8 i) {


}
//-----------------------------------------------------------------
// 主程序
//-----------------------------------------------------------------
void main() {
	u8 i;
	P1M1 = 0x00; P1M0 = 0x00;		//P1配置为准双向口
	Init_MAX72XX(0);  delay_ms(5);	//MAX7219初始化
	Init_MAX72XX(1);  delay_ms(5);	//MAX7221初始化 

	
	
}
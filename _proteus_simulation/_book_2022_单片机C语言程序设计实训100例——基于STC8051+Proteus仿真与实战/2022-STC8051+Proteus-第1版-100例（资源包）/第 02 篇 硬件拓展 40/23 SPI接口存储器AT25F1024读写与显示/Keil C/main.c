//---------------------------------------------------------------------
//  名称: SPI接口存储器AT245F1024读写与显示
//---------------------------------------------------------------------
//  说明: 程序运行时,按下K1~K4所执行的操作如下
//        K1: 先清除数据,然后在前面写入256个有序字节(0x00~0xFF)
//            在最末尾写入256个随机字节(中间部分不写入)
//        K2: 读取并显示最前面256个有序字节
//        K3: 读取并显示最后面256个随机字节
//        K4: 读取并显示厂家/设备ID(AT25F1024A: VID/PID=1F60)
//
//---------------------------------------------------------------------
#define u8  unsigned char
#define u16 unsigned int
#define u32 unsigned long
#include "STC15xxx.h"
#include <intrins.h>
#include <stdlib.h>
//SPI接口存储器引脚定义
sbit CS  = P3^4;				//片选
sbit SO  = P3^5;				//串行数据输出
sbit SI  = P3^6;				//串行数据输入
sbit SCK = P3^7;				//串行时钟控制脚
//SPI接口存储器操作命令定义
#define WREN					0x06	//使能写
#define WRDI					0x04	//禁止写
#define RDSR					0x05	//读状态
#define WRSR					0x01	//写状态
#define READ					0x03	//读字节
#define WRITE					0x02	//写字节
#define SECTOR_ERASE			0x52	//删除区域数据
#define CHIP_ERASE				0x62	//删除芯片数据
#define RDID					0x15	//读厂商与产品ID
//按键定义
#define K1_DOWN() ((P0 & (1<<0)) == 0x00)	//写入两组字节
#define K2_DOWN() ((P0 & (1<<2)) == 0x00)	//读前面20个有序字节并显示
#define K3_DOWN() ((P0 & (1<<4)) == 0x00)	//读后面20个随机字节并显示
#define K4_DOWN() ((P0 & (1<<6)) == 0x00)	//显示厂家和产品ID
//LED操作定义
#define LED_ON()	P1 &= ~(1<<0)		//LED点亮
#define LED_BLINK()	P1 ^=  (1<<0)		//LED闪烁
//数码管位引脚定义
sbit D0  = P1^6;
sbit D1  = P1^7;
//0~F的数码管段码表(共阴数码管)
code u8 SEG_CODE[] = {
	0x3F,0x06,0x5B,0x4F,0x66,0x6D,0x7D,0x07,
	0x6F,0x77,0x7F,0x7C,0x39,0x5E,0x79,0x71
};
//读写数据字节的临时存放空间及有效数据长度
u8  TMP_Buffer[256];
u8 	Display_Buffer[] = {0,0};			//分解后的待显示数位
u16 Buffer_LEN = 256;
//---------------------------------------------------------------------
// 延时函数
//---------------------------------------------------------------------
#define MAIN_Fosc 12000000L
void delay_ms(u8 x) {
	unsigned int i;
	do{
		i = MAIN_Fosc / 13000;
		while(--i);
	}while(--x);
}
//---------------------------------------------------------------------
// 数码管显示1个字节(十六进制)
//---------------------------------------------------------------------
void Show_Count_ON_DSY() {   

}
//---------------------------------------------------------------------
// 从当前地址读取1个字节
//---------------------------------------------------------------------
u8 ReadByte() {

}
//---------------------------------------------------------------------
// 向当前地址写入1个字节
//---------------------------------------------------------------------
void WriteByte(u8 dat) {

}
//---------------------------------------------------------------------
// 读AT25F1024A芯片状态
//---------------------------------------------------------------------
u8 Read_SPI_Status() {

}
//---------------------------------------------------------------------
// AT25F1024A忙等待
//---------------------------------------------------------------------
void Busy_Wait(){      } //忙等待
//---------------------------------------------------------------------
// 删除AT25F1024A芯片未加保护的所有区域数据
//---------------------------------------------------------------------
void ChipErase() {

}
//---------------------------------------------------------------------
// 向AT25F1024A写入3个字节地址0x000000~0x01FFFF 
//---------------------------------------------------------------------
void Write_3_Bytes_SPI_Address(u32 addr) {

}
//---------------------------------------------------------------------
// 从指定地址读单个数据字节
//---------------------------------------------------------------------
u8 Read_From_AT25F1024A(u32 addr){

}
//---------------------------------------------------------------------
// 从指定地址读多个数据字节到缓冲区
//---------------------------------------------------------------------
//void Read_Bytes_From_AT25F1024A(u32 addr, u8 *p, u16 len) {
//	u16 i;
//	CS = 0;								//片选
//	WriteByte(READ);					//发送读指令
//	Write_3_Bytes_SPI_Address(addr);	//发送3个字节地址
//	for( i = 0; i < len; i++) p[i] = ReadByte();//读取多个数据字节
//	CS = 1;								//禁止片选
//}
//---------------------------------------------------------------------
// 向AT25F1024A指定地址写入单个数据字节
//---------------------------------------------------------------------
void Write_Byte_To_AT25F1024A(u32 addr,u8 dat) {	

}
//---------------------------------------------------------------------
// 向AT25F1024A指定地址开始写入多个数据字节
//---------------------------------------------------------------------
//void Write_Bytes_To_AT25F1024A(u32 addr,u8 *p,u16 len){
//	u16 i;
//	CS = 0;								//片选
//	WriteByte(WREN);					//使能写
//	CS = 1;								//禁止片选
//	Busy_Wait(); 						//忙等待
//	CS = 0;								//片选
//	WriteByte(WRITE);					//写指令
//	Write_3_Bytes_SPI_Address(addr);	//发送3个字节地址
//	for (i = 0; i < len; i++) WriteByte(p[i]);//写多个数据字节
//	CS = 1;								//禁止片选
//	Busy_Wait();
//}
//---------------------------------------------------------------------
// 读取AT25F1024A的厂商和产品ID
//---------------------------------------------------------------------
void Get_VID_PID() { 

}
//---------------------------------------------------------------------
// 主程序
//---------------------------------------------------------------------
void main() {
	u8 Current_Data,Current_Disp_Index = 0,LOOP_SHOW_FLAG = 0, k;
	u32 i;
	P0M1 = 0xFF; P0M0 = 0x00;			//将P0配置为高阻输入口
	P1M1 = 0x00; P1M0 = 0x00;			//将其他配置为准双向口
	P2M1 = 0x00; P2M0 = 0x00;
	P3M1 = 0x00; P3M0 = 0x00;
	while(1) {
		Begin:
		//K1:向AT25F1024A写入数据
		if(K1_DOWN()) {//-----------------------------------------------

		}
		//K2:读取并显示前面256个数据字节
	 	if (K2_DOWN()){ //----------------------------------------------

		}
		//K3:读取并显示后面256个数据字节
		if (K3_DOWN()){ //----------------------------------------------

		}
		//K4:显示厂家和设备ID
		if (K4_DOWN()){ //----------------------------------------------

		}
		//循环显示数据
		if (LOOP_SHOW_FLAG){  //----------------------------------------

		}
	}
}

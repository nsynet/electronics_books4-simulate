//-----------------------------------------------------------------
//  名称: 74HC595驱动16段数码管演示
//-----------------------------------------------------------------
//  说明: 本例运行时,8只集成式16段数码管在按键控制下依次显示几组英文
//		与数字字符串.案例中16段数码管段码表编码规则见程序内说明.
//  
//-----------------------------------------------------------------
#include "STC15xxx.h"
#include <intrins.h>
#include <ctype.h>
#include <string.h>
#include <math.h>
#define MAIN_Fosc 12000000L		//时钟频率定义
#define u8  unsigned char
#define u16 unsigned int
sbit K1 = P1^7;	//按键定义
//595引脚定义
sbit SH_CP	= P2^0;	//移位时钟脉冲
sbit DS	 	= P2^1;	//串行数据输入
sbit ST_CP	= P2^2;	//输出锁存器控制脉冲
sbit OE		= P2^3;	//使能输出
//本例编码按数码管各段字母顺序设计编码(先外框循环,后内部米字循环):
//A1 A2 B C D2 D1 E F H I J G2 K L M G1 DP(编码时注意逆向)
//16段共阳数码管段码表(本例用的是共阴数码管,输出时要取反)
code u16 SEG_CODE16[] = {
  0xEE00,0xFFF3,0x7788,0x77C0,0x7773,0x7744,0x7704,0xFFF0,0x7700,
  0x7740,0x7730,0x7304,0xFF0C,0xDDC0,0x770C,0x773C,0xF704,0x7733,
  0xDDCC,0xDD9C,0x6B3F,0xFF0F,0xFA33,0xEE33,0xFF00,0x7738,0xEF00,
  0x6738,0x6F4C,0xDDFC,0xFF03,0xBB3F,0xAF33,0xAAFF,0xDAFF,0xBBCC
};
//待显示字符串
code char str_buffer[] = "DEMO 320abcdefghijKLMNOPQRSTUVWXYZ 0123456789";
//上次按键状态
u8 pre_key_status = 1;
//595并行输出宏定义(上升沿将数据送到输出锁存器)
#define Parallel_Output() {ST_CP = 0; _nop_(); ST_CP = 1; _nop_(); }
//-----------------------------------------------------------------
// 延时函数(参数取值限于1~255)
//-----------------------------------------------------------------
void delay_ms(u8 ms) {
	u16 i;
	do{
		i = MAIN_Fosc / 13000;
		while(--i);
	}while(--ms);
}
//------------------------------------------------------------------
// 获取字符的16位段码
//------------------------------------------------------------------
u16 get_16_segcode(char c){


}
//-----------------------------------------------------------------
// 串行输入595子程序
//-----------------------------------------------------------------
void Serial_Input_595(u8 dat) {


}
//------------------------------------------------------------------
// 主程序
//------------------------------------------------------------------
void main() { 
	u8  i,j,len = strlen(str_buffer),n = ceil(len / 8.0); 
	u16 sCode = 0x0000;
	P2M1 = 0x00; P2M0 = 0x00;				//P2配置为准双向口
	while(1)	{

	
	}
}
//-----------------------------------------------------------------
//  名称: 74HC595驱动14段数码管演示
//-----------------------------------------------------------------
//  说明: 本例运行时,8只集成式14段数码管在按键控制下依次显示几组英文与
//		数字字符串.案例中14段数码管段码表编码规则见程序内说明.
//  
//-----------------------------------------------------------------
#include "STC15xxx.h"
#include <intrins.h>
#include <ctype.h>
#include <string.h>
#include <math.h>
#define u8  unsigned char
#define u16 unsigned int
#define MAIN_Fosc 12000000L			//时钟频率定义
sbit K1 = P1^7;			//按键定义
//595引脚定义
sbit SH_CP	= P0^0;	//移位时钟脉冲
sbit DS	 		= P0^1;	//串行数据输入
sbit ST_CP	= P0^2;	//输出锁存器控制脉冲
sbit OE			= P0^3;	//使能输出
//本例编码按数码管各段字母顺序设计编码(先外框循环,后内部米字循环):
//A B C D E F H I J G2 K L M G1 DP(编码时注意逆向)
//14段共阳数码管段码表(本例用的是共阴数码管,输出时要取反)
code u16 SEG_CODE14[] = {
  0xFB80,0xFFF9,0xDDE4,0xDDF0,0xDDD9,0xDDD2,0xDDC2,0xFFF8,0xDDC0,
  0xDDD0,0xDDC8,0xDCC2,0xFFC6,0xF770,0xDFC6,0xDFCE,0xFDC2,0xDDC9,
  0xF776,0xEF6E,0xDACF,0xFFC7,0xFE89,0xFB89,0xFFC0,0xDDCC,0xFBC0,
  0xD9CC,0xDBD6,0xF77E,0xFFC1,0xEECF,0xEBC9,0xEABF,0xF6BF,0xEEF6
};
//待显示字符串
code char str_buffer[] = "DEMO 730abcdefghijKLMNOPQRSTUVWXYZ 0123456789";
//上次按键状态
u8 pre_key_status = 1;
//595并行输出宏定义(上升沿将数据送到输出锁存器)
#define Parallel_Output() {ST_CP = 0; _nop_(); ST_CP = 1; _nop_(); }
//-----------------------------------------------------------------
// 延时函数(参数取值限于1~255)
//-----------------------------------------------------------------
void delay_ms(u8 ms) {
	u16 i;
	do{
		i = MAIN_Fosc / 13000;
		while(--i);
	}while(--ms);
}
//------------------------------------------------------------------
// 获取字符的16位段码
//------------------------------------------------------------------
u16 get_16_segcode(char c) {


}
//-----------------------------------------------------------------
// 串行输入595子程序
//-----------------------------------------------------------------
void Serial_Input_595(u8 dat) {


}
//------------------------------------------------------------------
// 主程序
//------------------------------------------------------------------
void main() { 
	u8  i,j,len = strlen(str_buffer),n = ceil(len / 8.0); 
	u16 sCode = 0x0000;
	while(1) {

	
	}
}
//------------------------------ main.c -----------------------------
//	名称: Nokia5110(PCD854)液晶演示
//-------------------------------------------------------------------
//	说明: 本例在Nokia5110液晶演示了3项菜单功能,分别是LED闪烁控制,A/D
//		转换控制,蜂鸣器输出.
// 
//-------------------------------------------------------------------
#define u8	unsigned char
#define u16	unsigned int
#include "STC15xxx.h"
#include <intrins.h>
#include <string.h>
#include <stdio.h>
#include "Nokia5110.h"
code char Text[][15] = {		//本例标题及菜单项等
	"  Nokia 5110  ",
	"--------------",
	"1.Flash LEDs  ",
	"2.A/D Convert ",
	"3.Beep Output ",
	"--------------"
};
#define ADC_POWER		0x80 	//ADC电源控制位
#define ADC_FLAG		0x10 	//ADC完成标志
#define ADC_START		0x08 	//ADC起始控制位
#define ADC_SPEEDLL		0x00 	//540个时钟
#define ADC_SPEEDL		0x20 	//360个时钟
#define ADC_SPEEDH		0x40 	//180个时钟
#define ADC_SPEEDHH		0x60 	//90个时钟
//按键引脚定义
#define K_UP()		((P0 & (1<<0))==0x00)	//上移
#define K_DOWN()	((P0 & (1<<1))==0x00)	//下移
#define K_OK()		((P0 & (1<<2))==0x00)	//执行
sbit BEEP = P2^4;							//蜂鸣器
char disp_buff[20];							//液晶显示缓冲
volatile u8 Pre_Key = 0x00, Curr_Menu = 1, Pre_Menu = 0, Func_NO = 0;
enum {WHITE = 0, BLACK = 1};
//-------------------------------------------------------------------
// 延时函数
//-------------------------------------------------------------------
#define MAIN_Fosc 12000000L
void delay_ms(u8 ms) {
	u16 i;
	do { i = MAIN_Fosc / 13000; while(--i); } while(--ms);
}
//-------------------------------------------------------------------
// 初始化ADC
//-------------------------------------------------------------------
void InitADC() {


}
//-------------------------------------------------------------------
// 读取指定通道的ADC结果并换算为电压值
//-------------------------------------------------------------------
float GetADCResult(u8 ch) {


}
//-------------------------------------------------------------------
// T0定时初始配置函数
//-------------------------------------------------------------------
void Timer0Init() {				//2ms@12MHz


}
//-------------------------------------------------------------------
// 按键扫描获取当前菜单项Curr_Menu(1,2,3)及待执行项Func_NO(1,2,3)
//-------------------------------------------------------------------
void Scan_Key() {


}
//-------------------------------------------------------------------
// 刷新菜单显示
//-------------------------------------------------------------------
void Refresh_Menu() {


}
//-------------------------------------------------------------------
// 执行菜单功能
//-------------------------------------------------------------------
void Execute_MENU() {


}
//-------------------------------------------------------------------
// 主程序
//-------------------------------------------------------------------
void main() {
	u8 i;
	P0M1 = 0xFF; P0M0 = 0x00;		//配置为高阻输入
	P1M1 = 0x00; P1M0 = 0x00;		//配置为准双向口
	P2M1 = 0x00; P2M0 = 0x00;
	P3M1 = 0x00; P3M0 = 0x00;
	Timer0Init();					//T0定时器初始化
	InitADC();						//初始化ADC
	Nokia_Init();					//初始化Nokia LCD
	Nokia_CLS();					//清屏
	Write_Nokia_POS(2,0);			//设置显示位置
	Show_String((char*)"Start System..",WHITE);
	i = 10; while (i--) delay_ms(100);
	//延时1000ms后开始显示标题及菜单项
	for ( i = 0; i < 6; i++)	{	//显示标题及菜单项

	
	}
	while (1) {

	
	}
}
//-------------------------------------------------------------------
// 定时器控制蜂鸣器输出
//-------------------------------------------------------------------
void T0_INT() interrupt 1 {


}

//-----------------------------------------------------------------
//	名称: ULN2803驱动单极步进电机正反转
//-----------------------------------------------------------------
//	说明: 本例电机为28BYJ-48，运行时按下K1电机正转3圈,按下K2反转3圈,
//		  按下K3时停止.在进行相应操作时,对应的指示灯被点亮.
//				
//-----------------------------------------------------------------
#include "STC15xxx.h"
#include <intrins.h>
#define u8		unsigned char
#define u16		unsigned int
//本例四相步进电机工作于八拍方式
//正转励磁序列为A->AB->B->BC->C->CD->D->DA
u8 code FFW[] = {0x01,0x03,0x02,0x06,0x04,0x0C,0x08,0x09};
//反转励磁序列为AD->D->CD->C->BC->B->AB->A
u8 code REV[] = {0x09,0x08,0x0C,0x04,0x06,0x02,0x03,0x01};
sbit	K1 = P3^0;		//正转
sbit	K2 = P3^1;		//反转
sbit	K3 = P3^2;		//停止
#define STEPS 64 //每圈需要64步，每步5.625
//-----------------------------------------------------------------
// 延时函数@12M
//-----------------------------------------------------------------
#define MAIN_Fosc 12000000L
void delay_ms(u8 ms) {
	u16 i;
	do{
		i = MAIN_Fosc / 13000;
		while(--i);	
	 }while(--ms);
}
//-----------------------------------------------------------------
// 正转		
//-----------------------------------------------------------------
void STEP_MOTOR_FFW(u8 n) { 

}
//-----------------------------------------------------------------
// 反转		 
//-----------------------------------------------------------------
void STEP_MOTOR_REV(u8 n) {

} 
//-----------------------------------------------------------------
// 主程序
// 注：以下所说的圈数是步进电机内部转子的圈数，非外部驱动轴的圈数，
// 因为步进电机28BYJ-48减速比为1:64,因此外部驱动轴速度是内部转子
// 速度的1/64.
//-----------------------------------------------------------------
void main() { 
	u8 N = 3;										//运转圈数
	P0M1 = 0x00; P0M0 = 0x00;		//配置为准双向口
	P1M1 = 0x00; P1M0 = 0x00;
	P3M1 = 0xFF; P3M0 = 0x00;		//配置为高阻输入
	while(1) {

	}
}
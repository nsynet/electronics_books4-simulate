//-----------------------------------------------------------------
//  名称: LM044L-4bit.h液晶驱动程序头文件（4位模式）
//-----------------------------------------------------------------
#include "LM044L-4bit.h"
//-----------------------------------------------------------------
// 延时函数
//-----------------------------------------------------------------
void Delay1ms()	{	//@12.000MHz
	u8 i = 12, j = 169;
	do {
		while (--j);
	} while (--i);
}
//-----------------------------------------------------------------
// 写液晶命令
//-----------------------------------------------------------------
void Write_LCD_Cmd(u8 cmd) {

}
//-----------------------------------------------------------------
// 向液晶写数据
//-----------------------------------------------------------------
void Write_LCD_Dat(u8 dat) {

} 
//-----------------------------------------------------------------
// 液晶初始化
//-----------------------------------------------------------------
void LCD_Initialize() {
	LCD_PORT = 0xFF;//初始时液晶端口全部置为高电平
	LCD_PORT = 0x24;//设置4位模式,并置EN,RW,RS = 100(4),准备写命令寄存器
	EN = 0;			//上一行EN已置为1,完成了控制命令写入,此行EN重置为低电平
	//以下每条命令都需要通过分别发送高4位与低四位完成
	Write_LCD_Cmd(0x28); Delay1ms();	//功能设置(4Bit,双行,5x7点阵)
	Write_LCD_Cmd(0x0C); Delay1ms();	//开显示
	Write_LCD_Cmd(0x06); Delay1ms();	//模式设置
	Write_LCD_Cmd(0x01); Delay1ms();	//清屏
	Write_LCD_Cmd(0x02); Delay1ms();	//光标定位于右上角
}
//-----------------------------------------------------------------
// 在指定位置显示字符串
//-----------------------------------------------------------------
void LCD_ShowString(u8 r, u8 c,char *s) {
	u8 i = 0; 
	//LCD 0~3行DDRAM起始地址表
	code u8 DDRAM_addr[] = {0x80,0xC0,0x94,0xD4};
	//设置显示起始位置(r,c)
	Write_LCD_Cmd(DDRAM_addr[r] + c);
	//输出字符串
	for ( i = 0; i < 20 && s[i] ;i++) Write_LCD_Dat(s[i]);
	//不足20个字符时用空格填充
	for (;i < 20; i++) Write_LCD_Dat(' ');
}
//-----------------------------------------------------------------
//  名称: I2C接口PCF8591驱动程序
//-----------------------------------------------------------------
#include "STC15xxx.h"
#include "I2C.h"
#include <intrins.h>
#define u8  unsigned char
#define u16 unsigned int
//-----------------------------------------------------------------
// 连续读入4路通道的A/D转换结果并保存到缓冲R
//-----------------------------------------------------------------
void ADC_PCF8591(u8 CtrlByte, u8 *R) { 
	u8 i ;	IIC_Start();		//IIC启动
	//------------------------------------------------------------
	// PCF8591地址定义: 1001****,高四位固定为1001
	// 第3,2,1位对应A2,A1,A0,第0位为读写标志位,1为读,0为写,
	// 下面代码中0x90,0x91分别为10010000,10010001
	//------------------------------------------------------------
	if (!IIC_WriteByte(0x90))		return;	//发送写地址
	if (!IIC_WriteByte(CtrlByte))	return;	//发送控制字节
	IIC_Start();							//重新发送开始命令
	if (!IIC_WriteByte(0x91))		return;	//发送读地址
	IIC_ReadByte();IIC_Ack();				//空读一次,调整读顺序
	for(i = 0; i < 3; i++) {				//依次接收3字节数据
		R[i] = IIC_ReadByte();				//每接收一字节后主机应答
		IIC_Ack();
	}
	R[3] = IIC_ReadByte();					//主机接收最后1字节
	IIC_NAck();								//主机发送非应答位
	IIC_Stop();								//IIC停止
}
//-----------------------------------------------------------------
// 向PCF8591发送1字节,进行D/A转换
//-----------------------------------------------------------------
void DAC_PCF8591(u8 CtrlByte,u8 dat) {
	IIC_Start();							//启动I2C
	if (!IIC_WriteByte(0x90))		return;	//发送写地址
	if (!IIC_WriteByte(CtrlByte))	return;	//发送控制字节
	if (!IIC_WriteByte(dat))		return;	//发送待转换为模拟量的数值
	IIC_Stop();								//IIC停止
}
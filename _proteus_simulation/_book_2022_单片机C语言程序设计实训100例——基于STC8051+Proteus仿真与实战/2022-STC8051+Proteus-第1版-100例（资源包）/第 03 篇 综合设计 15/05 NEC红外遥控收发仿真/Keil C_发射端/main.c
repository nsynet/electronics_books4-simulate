//--------------------------发送端程序-------------------------------
//  名称: 红外遥控仿真发射器(NEC协议)
//-----------------------------------------------------------------
//  说明: 本例运行时,按键键值以38KHz红外线载波发射出去,所模拟的载波
//        数据格式符合NEC红外遥控编码格式. 
//
//-----------------------------------------------------------------
#define u8  unsigned char
#define u16 unsigned int
#define u32 unsigned long
#include <reg51.h>
#include <intrins.h>
#include <stdio.h>
sbit IRLED	= P3^2;		//红外发射管定义 
sbit BEEP	= P3^7;		//蜂鸣器定义
#define KEY_IN P1 		//按键输入端口定义
u16 IR_Codes[] = {		//8组红外编码(每组8位地址8位命令)
  0x509A,0x3341,0x55A6,0x7378,0xB9AA,0xFDCC,0xD5A6,0xA1AC };
#define delayAus()	{	_nop_();_nop_();_nop_();_nop_();_nop_(); \
						_nop_();_nop_();_nop_();_nop_(); }
#define delayBus()	{	_nop_();_nop_();_nop_();_nop_();_nop_(); \
						_nop_();_nop_();_nop_();_nop_();_nop_(); \
						_nop_();_nop_();_nop_();_nop_();_nop_();}
//-----------------------------------------------------------------
// 延时函数(us)
//-----------------------------------------------------------------
void delay_us(u8 x)	{ while (--x);}
void Delay1690us()	{ u16 x = 189;	while (x--);}
void Delay560us()	{ u16 x = 67; 	while (x--);}
//-----------------------------------------------------------------
// 延时函数(ms)
//-----------------------------------------------------------------
void delay_ms(u16 x) { u8 t; while(x--) for(t = 0; t < 120; t++);}
//-----------------------------------------------------------------
// 输出提示音
//-----------------------------------------------------------------
void Sounder() {


}
//-----------------------------------------------------------------
// 发送560us/38KHz载波(1/38K = 26.3us 周期≈9+17) 560/26≈21.2
//-----------------------------------------------------------------
void send_560us_38K_IR_Carrier() {


}
//-----------------------------------------------------------------
// 发送指定长度38KHz载波
//-----------------------------------------------------------------
void send_Xus_38K_IR_Carrier(u16 t) {


}
//-----------------------------------------------------------------
// 发送1字节数据(低位优先)
//-----------------------------------------------------------------
void send_aByte(u8 t) {


}
//-----------------------------------------------------------------
// 发送完成信息帧（含头部，地址，地址反码，命令，命令反码）
//-----------------------------------------------------------------
void send_Addr_Comm(u16 dat) {
	u8 Addr,Comm;
	Addr = dat>>8; Comm = (u8)(dat & 0x00FF);
	//首先发送：信息帧头部(9ms载波，4.5ms低电平)
	send_Xus_38K_IR_Carrier(218);			//发送9ms载波
	IRLED = 0; delay_ms(4); delay_us(220);	//4.5ms低电平
	//接着发送：地址,地址反码,命令,命令反码
	send_aByte(Addr);	send_aByte(~Addr);
	send_aByte(Comm);	send_aByte(~Comm);
	//补发一个头部用于结束一帧
	send_Xus_38K_IR_Carrier(218);
}
//-----------------------------------------------------------------
// 主程序
//-----------------------------------------------------------------
void main() {
	u8 i; BEEP = 0; 					//初始时BEEP置0
	while(1) {							//按键K1~K8发射编码

	
	
	}
}
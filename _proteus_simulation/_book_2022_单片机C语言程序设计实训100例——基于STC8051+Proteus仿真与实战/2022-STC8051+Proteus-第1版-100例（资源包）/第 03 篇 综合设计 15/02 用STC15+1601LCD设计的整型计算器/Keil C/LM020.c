//-------------------------- LM020.c-------------------------------
// 名称: 液晶控制与显示程序
//-----------------------------------------------------------------
#include "STC15xxx.h"
#include <intrins.h>
#define u8  unsigned char
#define u16 unsigned int
sbit RS = P1^0;			//寄存器选择线
sbit RW = P1^1;			//读/写控制线
sbit EN = P1^2;			//使能控制线
sbit BF = P0^7;			//忙标识
//-----------------------------------------------------------------
// 延时（120us,1ms,xms）
//-----------------------------------------------------------------
void Delay120us(){		//@12MHz
	u8 i = 6, j = 211;
	do {
		while (--j);
	} while (--i);
}
//-----------------------------------------------------------------
void Delay1ms() {		//@12MHz
	u8 i = 12, j = 169;
	do {
		while (--j);
	} while (--i);
}
//-----------------------------------------------------------------
// 液晶忙检测
//-----------------------------------------------------------------
void CheckBusy() {
	u16 i;	for(i = 0; i < 5000; i++) if(!BF) break; 
}
//-----------------------------------------------------------------
void delay_ms(u8 x) {
	while(x--) Delay1ms();
}
//-----------------------------------------------------------------
// 写LCD命令
//-----------------------------------------------------------------
void Write_LCD_Command(u8 cmd) {

}
//-----------------------------------------------------------------
// 写LCD数据
//-----------------------------------------------------------------
void Write_LCD_Data(u8 dat) {

}
//-----------------------------------------------------------------
// LCD初始化
//-----------------------------------------------------------------
void Initialize_LCD() {
	Write_LCD_Command(0x30); Delay1ms();	//置功能,8位,1行,5*7
	Write_LCD_Command(0x01); Delay1ms();	//清屏
	Write_LCD_Command(0x06); Delay1ms();	//字符进入模式:屏幕不动,字符后移
	Write_LCD_Command(0x0C); Delay1ms();	//显示开,关光标
}
//-----------------------------------------------------------------
// 显示字符串
//-----------------------------------------------------------------
void LCD_Disp_String(char *str) {
	u8 i = 0;
	Write_LCD_Command(0x80);				//设置显示起始位置
	for ( i = 0; str[i] && i < 16 ;i++)	//输出字符串
	  Write_LCD_Data(str[i]);
	for (; i < 16; i++)	 					//不足一行时用空格填充
	  Write_LCD_Data(' ');
}

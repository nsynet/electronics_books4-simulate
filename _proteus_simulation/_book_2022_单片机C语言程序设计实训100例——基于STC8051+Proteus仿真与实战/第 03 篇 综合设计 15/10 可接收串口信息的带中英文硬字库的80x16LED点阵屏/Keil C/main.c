//--------------------------- main.c ------------------------------
//  名称: 可接收串口信息的带中英文硬字库的80x16LED点阵屏
//-----------------------------------------------------------------
//  说明: 本例运行时,点阵屏将滚动显示一组固定信息
//	当接收到串口发送来的中英文/全角/半角字符时,点屏将开始
//	滚动显示所接收到的信息.
//
//-----------------------------------------------------------------
#define u8s	signed	char
#define u8	unsigned char
#define u16	unsigned int
#define u32	unsigned long
#include "STC15xxx.h"
#include <intrins.h>
#include <string.h>
//74HC595相关引脚定义
sbit DS 	= P3^5;
sbit SH_CP	= P3^6;
sbit ST_CP	= P3^7;
//74154译码器使能与禁止
sbit EN_154	= P2^4;
#define EN_74HC154() EN_154 = 0
#define DI_74HC154() EN_154 = 1
//SPI相关函数
extern void Read_Bytes_From_AT25F4096A(u32, u8*, u16);
extern void delay_ms(u8);
#define MAX_WORD_COUNT 	50			//允许的最大汉字个数
//初始演示中英文字符串:"★LED点阵演示V1.0★"
//后续从串口接收的中英文信息将添加或覆盖保存到Buffer
u8 Buffer[MAX_WORD_COUNT*2 + 2] = "★LED点阵演示V1.0★";
u8 Dot_Matrix[MAX_WORD_COUNT * 32];//待显示点阵数据缓冲
u8 Buffer_Idx;						//串口缓冲区索引
volatile u8 Rec_END_Flag = 0;		//接收结束标志
void delay_xus(u16 x) {				//@12.000MHz
	while (x--) { _nop_();_nop_();_nop_();_nop_(); }
}
//-----------------------------------------------------------------
// 串口初始化
//-----------------------------------------------------------------
void UartInit() {					//9600bit/s@12MHz


}
//-----------------------------------------------------------------
// 串行输入子程序
//-----------------------------------------------------------------
void Serial_In595(u8 dat) {


}
//-----------------------------------------------------------------
// 并行输出子程序
//-----------------------------------------------------------------
void Parallel_Output_595() {


}
//-----------------------------------------------------------------
// 根据Buffer缓冲的字符,从硬字库读取点阵数据并转换为LED要求的格式
//-----------------------------------------------------------------
void Read_SPI_ZK_and_Convert() {  
	u16 i,j = 0, k;
	u32 Offset;						//偏移位置变量
	u8 SectionCode, PlaceCode;		//汉字区码与位码
	u8 Temp_Buf[32];				//转换用临时缓冲
	for (i = 0; i <MAX_WORD_COUNT * 32; i++)	//清空点阵缓冲
		Dot_Matrix[i] = 0x00;
	i = 0;
	while ( i < Buffer_Idx ) {
		if ( Buffer[i] >= 0xA0 ) {	//处理汉字编码

		
		}
		else {							//处理半角英文字符编码

		
		}
	}
}
//-----------------------------------------------------------------
// 主程序
//-----------------------------------------------------------------
void main() {
	u8 i,j,z,d = 0;
	P0M1 = 0x00; P0M0 = 0x00;			//配备为准双向口
	P1M1 = 0x00; P1M0 = 0x00;
	P2M1 = 0x00; P2M0 = 0x00;
	P3M1 = 0x00; P3M0 = 0x00;
	Buffer_Idx = strlen((char*)Buffer);//获取初始串长
	UartInit();							//初始化串口
	//根据Buffer从SPI存贮器读取全角或半角字符点阵数据并完成必要的转换
	Read_SPI_ZK_and_Convert(); 
	while(1) {

	
	}
}
//------------------------------------------------------------------
// 串口接收中断程序
//------------------------------------------------------------------
void ISR_Uart_INT() interrupt 4 {
	u8 c = 0;
	if(RI) {

	
	}
}

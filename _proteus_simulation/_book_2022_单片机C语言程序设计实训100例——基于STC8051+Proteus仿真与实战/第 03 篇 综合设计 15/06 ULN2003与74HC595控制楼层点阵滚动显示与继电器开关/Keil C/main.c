//-----------------------------------------------------------------
//  名称: ULN2003与74HC595控制楼层点阵滚动显示与继电器开关
//-----------------------------------------------------------------
//  说明: 本例模拟了电梯显示屏上下滚动显示楼层的效果,当目标楼层大于
//   	  当前楼层时将向上滚动显示,反之则向下滚动显示.目标楼层到达时
//	      点阵保持稳定显示,且对应继电器接通.
//
//-----------------------------------------------------------------
#define u8  unsigned char
#define u16 unsigned int
#define u32 unsigned int
#include "STC15xxx.h"
#include <intrins.h>
sbit SH_CP	=	P1^0;				//移位时钟脉冲
sbit DS		=	P1^1;				//串行数据输入
sbit ST_CP	=	P1^2;				//输出锁存器控制脉冲
//数字0~9的点阵字节(每个数字8字节)
const u8 Dots_Matrix[] = {
	0x00,0x3C,0x66,0x42,0x42,0x66,0x3C,0x00,	//0
	0x00,0x08,0x38,0x08,0x08,0x08,0x3E,0x00,	//1
	0x00,0x3C,0x42,0x04,0x08,0x32,0x7E,0x00,	//2
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	0x00,0x38,0x46,0x42,0x3E,0x06,0x3C,0x00 	//9
};
int Current_Level = 1;				//当前楼层号
int Dest_Level = 1;					//目标楼层号
int offset = 0;						//用于产生滚动效果的取点阵字节偏移变量
int r = 0, x = 0;					//点阵显示取字节索引及刷新遍数控制变量
//-----------------------------------------------------------------
// 1字节数据串行输入595子程序
//-----------------------------------------------------------------
void Serial_Input_595(u8 d) {


}
//-----------------------------------------------------------------
// 595并行输出子程序
//-----------------------------------------------------------------
void Parallel_Output_595() {


}
//------------------------------------------------------------------
// T0初始配置(4毫秒@12.000MHz)
//------------------------------------------------------------------
void Timer0Init() {


}
//------------------------------------------------------------------
// 主程序
//------------------------------------------------------------------
void main() {


} 
//------------------------------------------------------------------
// TIIMER0定时器控制点阵屏显示,同时处理按键操作及继电器开关
//------------------------------------------------------------------
void LED_Screen_Display() interrupt 1 {
	static u8 Scan_BIT = 0x80;	//初始列码
	u8 i, key_status;
	Scan_BIT <<= 1; if (Scan_BIT == 0x00) Scan_BIT = 0x01;//下一列码
	//如果当前已处于目标楼层，且有按键按下则判断目标楼层
	if (Current_Level == Dest_Level) {
		key_status = P0 & 0x1F;	//P0:1~5位为按键(0x1F即00011111)
		if (key_status != 0x1F ) {	//有键按下则扫描
			//扫描按键端口,获取当前楼层
			for (i = 0; i <= 4; i++) if (!(key_status & (1 << i))) break;
			Dest_Level = 5 - i;
		}
	}
	Serial_Input_595(Scan_BIT);			//先串行发送列选择码(列扫描码)
	i = Current_Level * 8 + r + offset;//取数字点阵字节索引
	Serial_Input_595(~Dots_Matrix[ i ]);//再发送1字节点阵编码(列内点阵)
	Parallel_Output_595();				//2片595同时并行输出
	//楼层数字上升显示
	if (Current_Level < Dest_Level){
		P2 = 0x00;						//上升过程中继电器端口输出全0
		if( ++r == 8) {					//每屏扫描显示共8个字节
			r = 0;						//8个字节扫描输出完后归0
			if (++x == 3) {				//每完成x次刷新后后偏
				x = 0;
				if (++offset == 8) { offset = 0; Current_Level++; }
			}
		}
	}
	//楼层数字下降显示
	else if (Current_Level > Dest_Level) {
		P2 = 0x00;						//下升过程中继电器端口输出全0
		if( ++r == 8) {					//每屏扫描显示共8个字节
			r = 0;						//8个字节扫描输出完后归0
			if (++x == 3) {				//每完成x次刷新后前偏
				x = 0;
				if (--offset == -8) { offset = 0; Current_Level--; }
			}
		}
	}
	else if( ++r == 8) {
		r = 0;							//停止滚动,保持稳定的刷新显示
		P2 = 1<<(Current_Level-1);		//对应楼层继电器接通
	}
}
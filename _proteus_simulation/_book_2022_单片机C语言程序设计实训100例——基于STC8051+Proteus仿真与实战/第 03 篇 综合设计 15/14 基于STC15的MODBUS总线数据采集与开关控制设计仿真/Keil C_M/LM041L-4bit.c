//-----------------------------------------------------------------
//	名称: LM041L液晶驱动程序
//-----------------------------------------------------------------
#include "LM041L-4bit.h"
void Delay100us()		//@11.0592MHz
{
	unsigned char i, j; 
	_nop_();
	_nop_();
	i = 2;
	j = 15;
	do
	{
		while (--j);
	} while (--i);
}
void Delay1ms()		//@11.0592MHz
{
	unsigned char i, j;
	_nop_();
	_nop_();
	_nop_();
	i = 11;
	j = 190;
	do
	{
		while (--j);
	} while (--i);
}
////-----------------------------------------------------------------
//// 延时函数
////-----------------------------------------------------------------
//void delay_ms(u8 x) {
//	while(x--) Delay1ms();
//}
//-----------------------------------------------------------------
// 延时子程序（x=1~255ms,自适应时钟）
//-----------------------------------------------------------------
#define MAIN_Fosc 11059200L
void delay_ms(u8 x) {
	u16 i;
	do{
		i = MAIN_Fosc / 13000;
		while(--i);
	}while(--x);
}
//-----------------------------------------------------------------
// 写液晶命令
//-----------------------------------------------------------------
void Write_LCD_Cmd(u8 cmd) {

}
//-----------------------------------------------------------------
// 向液晶写数据
//-----------------------------------------------------------------
void Write_LCD_Dat(u8 dat) {

} 
//-----------------------------------------------------------------
// 液晶初始化
//-----------------------------------------------------------------
void Initialize_LCD() {
	LCD_PORT = 0xFF;//初始时液晶端口全部置为高电平
	LCD_PORT = 0x24;//设置4位模式,并置EN,RW,RS = 100(4),准备写命令寄存器
	EN = 0;			//上一行EN已置为1,完成了控制命令写入,此行EN重置为低电平
	//以下每条命令都需要通过分别发送高4位与低四位完成
	Write_LCD_Cmd(0x28); Delay1ms();	//功能设置(4Bit,5x7点阵)
	Write_LCD_Cmd(0x0C); Delay1ms();	//开显示
	Write_LCD_Cmd(0x06); Delay1ms();	//模式设置
	Write_LCD_Cmd(0x01); Delay1ms();	//清屏
	Write_LCD_Cmd(0x02); Delay1ms();	//光标定位于右上角
}
//-----------------------------------------------------------------
// 在指定位置显示字符串
//-----------------------------------------------------------------
void LCD_ShowString(u8 r, u8 c,char *str) {
	u8 i = 0; 
	//液晶4行DDRAM起始地址
	code u8 DDRAM[] = {0x80,0xC0,0x90,0xD0};
	Write_LCD_Cmd(DDRAM[r] + c);				//设置显示起始位置
	//输出字符串
	for (i = 0; i < 16 && str[i]!= '\0';i++) Write_LCD_Dat(str[i]);
}
//------------------------ app_server.c ---------------------------
// 名称：TCP应用服务程序
//-----------------------------------------------------------------
#include "STC15xxx.h"
#include "delay.h"
#include "app_server.h"				//TCP服务程序头文件
//#include "httpd.h"				//htttd服务程序部文件
#include "uip.h"
#include "uart.h"
#include <string.h>
#include <stdlib.h>
sbit Relay_Control = P3^5;			//继电器控制引脚定义
volatile char LedMode = 0x00;
//-----------------------------------------------------------------
// 应用服务初始化
//-----------------------------------------------------------------
void app_server_init() { }
//-----------------------------------------------------------------
// 应用服务调用（处理）
//-----------------------------------------------------------------
void app_server_appcall() {
/******************************************************
	
	
	
	
	
	
	
	
	*****************************************************/
}
//-----------------------------------------------------------------
// T0定时器初始化(1毫秒@18.432MHz)
//-----------------------------------------------------------------
void Timer0Init() {
	AUXR |= 0x80;					//定时器时钟1T模式
	TMOD &= 0xF0;					//设置定时器模式
	TL0 = 0x00;						//设置定时初值
	TH0 = 0xB8;						//设置定时初值
	TF0 = 0;						//清除TF0标志
	TR0 = 1;						//定时器0开始计时
	ET0 = 1;						//使能定时中断
	EA = 1;							//开总中断
}
//-----------------------------------------------------------------
// T0中断程序(定时1ms)-控制LED显示刷新
//-----------------------------------------------------------------
void timer0_interrupt() interrupt 1 {
	static u8 tCount1 = 0;			//累加计时变量（静态）
	static u8 x1 = 0x10, x2 = 1;	//LED显示控制变量
	EA = 0;							//关总中断
	if (++tCount1 == 4) {			//累加定时为：4*1=4ms
		tCount1 = 0;				//累加变量清0
		if (LedMode == '1') {		//收到'1'则控制LED滚动显示
			P3 |= 0x1C; P3 &= ~x1; x1 >>= 1;
			if (x1 == 1<<1) x1 = 1<<4;
		}
		else if (LedMode == '2') {	//收到'2'则控制LED闪烁显示
			x2 = !x2; if (x2 == 0) P3 |= 0x1C; else P3 &= ~0x1C;
		} 
		else P3 |= 0x1C; 			//否则关闭LED显示
	}
	EA = 1;							//开总中断
}
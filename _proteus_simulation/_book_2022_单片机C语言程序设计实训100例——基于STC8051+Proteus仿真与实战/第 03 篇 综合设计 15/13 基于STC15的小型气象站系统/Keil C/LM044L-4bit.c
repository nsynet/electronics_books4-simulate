//-----------------------------------------------------------------
//	名称: LM044L液晶驱动程序
//-----------------------------------------------------------------
#include "LM044L-4bit.h"
void Delay100us()		//@11.0592MHz
{
	unsigned char i, j; 
	_nop_();
	_nop_();
	i = 2;
	j = 15;
	do
	{
		while (--j);
	} while (--i);
}
void Delay1ms()		//@11.0592MHz
{
	unsigned char i, j;
	_nop_();
	_nop_();
	_nop_();
	i = 11;
	j = 190;
	do
	{
		while (--j);
	} while (--i);
}
////-----------------------------------------------------------------
//// 延时函数
////-----------------------------------------------------------------
//void delay_ms(u8 x) {
//	while(x--) Delay1ms();
//}
//-----------------------------------------------------------------
// 延时子程序（x=1~255ms,自适应时钟）
//-----------------------------------------------------------------
#define MAIN_Fosc 11059200L
void delay_ms(u8 x) {
	u16 i;
	do{
		i = MAIN_Fosc / 13000;
		while(--i);
	}while(--x);
}
//-----------------------------------------------------------------
// 写液晶命令
//-----------------------------------------------------------------
void Write_LCD_Cmd(u8 cmd) {

}
//-----------------------------------------------------------------
// 向液晶写数据
//-----------------------------------------------------------------
void Write_LCD_Dat(u8 dat) {

} 
//-----------------------------------------------------------------
// 液晶初始化
//-----------------------------------------------------------------
void Initialize_LCD() {

}
//-----------------------------------------------------------------
// 在指定位置显示字符串
//-----------------------------------------------------------------
void LCD_ShowString(u8 r, u8 c,char *str) {
	u8 i = 0; 
	//液晶4行DDRAM起始地址
	code u8 DDRAM[] = {0x80,0xC0,0x94,0xD4};
	Write_LCD_Cmd(DDRAM[r] + c);				//设置显示起始位置
	//输出字符串
	for (i = 0; i < 20 && str[i]!= '\0';i++) Write_LCD_Dat(str[i]);
}
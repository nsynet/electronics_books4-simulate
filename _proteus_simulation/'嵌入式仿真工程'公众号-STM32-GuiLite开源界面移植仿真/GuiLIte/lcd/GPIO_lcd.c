

#include "GPIO_lcd.h"	
#include "stm32f4xx.h" 
uint16_t LCD_X_LENGTH = GPIO_LESS_PIXEL;
uint16_t LCD_Y_LENGTH = GPIO_MORE_PIXEL;

uint8_t LCD_SCAN_MODE = 6;
/***********************英文字模******************************/
/*
 * 常用ASCII表，偏移量32，大小:16（高度）* 8 （宽度）
 */
const uint8_t ASCII8x16_Table [ ] = {       //@conslons字体，阴码点阵格式，逐行顺向取摸
0x00,0x00,0x00,0x00,0x00,0x00,0x00,0x00,0x00,0x00,0x00,0x00,0x00,0x00,0x00,0x00,
0x00,0x00,0x00,0x18,0x18,0x18,0x18,0x18,0x18,0x08,0x00,0x08,0x18,0x00,0x00,0x00,
0x00,0x00,0x00,0x34,0x24,0x24,0x24,0x00,0x00,0x00,0x00,0x00,0x00,0x00,0x00,0x00,
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0x00,0x00,0x00,0x00,0x00,0x00,0x00,0x00,0x71,0x4b,0x06,0x00,0x00,0x00,0x00,0x00,
};  

/*
 * 常用ASCII表，偏移量32，大小:24（高度）* 16 （宽度）
 */
const uint8_t ASCII16x24_Table [ ] = {       //@conslons字体，阴码点阵格式，逐行顺向取摸
0x00,0x00,0x00,0x00,0x00,0x00,0x00,0x00,0x00,0x00,0x00,0x00,0x00,0x00,0x00,0x00,
0x00,0x00,0x00,0x00,0x00,0x00,0x00,0x00,0x00,0x00,0x00,0x00,0x00,0x00,0x00,0x00,
0x00,0x00,0x00,0x00,0x00,0x00,0x00,0x00,0x00,0x00,0x00,0x00,0x00,0x00,0x00,0x00,
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0x00,0x00,0x00,0x00,0x00,0x00,0x00,0x00,0x00,0x00,0x00,0x00,0x00,0x00,0x00,0x00,
};

/*
 * 常用ASCII表，偏移量32，大小:32（高度）* 24 （宽度）
 */
const uint8_t ASCII24x32_Table [ ] = {       //@conslons字体，阴码点阵格式，逐行顺向取摸
0x00,0x00,0x00,0x00,0x00,0x00,0x00,0x00,0x00,0x00,0x00,0x00,0x00,0x00,0x00,0x00,
0x00,0x00,0x00,0x00,0x00,0x00,0x00,0x00,0x00,0x00,0x00,0x00,0x00,0x00,0x00,0x00,
0x00,0x00,0x00,0x00,0x00,0x00,0x00,0x00,0x00,0x00,0x00,0x00,0x00,0x00,0x00,0x00,
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0x00,0x00,0x00,0x00,0x00,0x00,0x00,0x00,0x00,0x00,0x00,0x00,0x00,0x00,0x00,0x00,
};


sFONT Font8x16 = {
  ASCII8x16_Table, 
  8, /* Width */
  16, /* Height */
};

sFONT Font16x24 = {
  ASCII16x24_Table, 
  16, /* Width */
  24, /* Height */
};

sFONT Font24x32 = {
  ASCII24x32_Table, 
  24, /* Width */
  32, /* Height */
};
#define      WIDTH_CH_CHAR		                16	    //中文字符宽度 
#define      HEIGHT_CH_CHAR		              	16		  //中文字符高度 
static sFONT *LCD_Currentfonts = &Font8x16;  //英文字体
static uint16_t CurrentTextColor   = RED;//BLACK;//前景色
static uint16_t CurrentBackColor   = WHITE;//背景色

 void                 GPIO_Write_Cmd           ( uint8_t usCmd );
 void                 GPIO_Write_Data          ( uint16_t usData );
 uint16_t             GPIO_Read_Data           ( void );
 void                   GPIO_Delay               ( __IO uint32_t nCount );
 void                   GPIO_LCD_Config         ( void );
 void                   GPIO_REG_Config          ( void );
 void                   GPIO_SetCursor           ( uint16_t usX, uint16_t usY );
 void          GPIO_FillColor           ( uint32_t ulAmout_Point, uint16_t usColor );
 uint16_t               GPIO_Read_PixelData      ( void );

#if  GPIO_DATA_USE_ANYPORT == 1

//比起使用未位带操作满了大概800ms，肉眼可见
#if 0
void DATAOUT(unsigned int x)
{	
//--------------------------------------------
	GPIO_WriteBit(GPIO_D0_PORT,GPIO_D0_PIN,(BitAction)(x>>0&0x0001));
	GPIO_WriteBit(GPIO_D1_PORT,GPIO_D1_PIN,(BitAction)(x>>1&0x0001));
	GPIO_WriteBit(GPIO_D2_PORT,GPIO_D2_PIN,(BitAction)(x>>2&0x0001));
	GPIO_WriteBit(GPIO_D3_PORT,GPIO_D3_PIN,(BitAction)(x>>3&0x0001));
	GPIO_WriteBit(GPIO_D4_PORT,GPIO_D4_PIN,(BitAction)(x>>4&0x0001));
	GPIO_WriteBit(GPIO_D5_PORT,GPIO_D5_PIN,(BitAction)(x>>5&0x0001));
	GPIO_WriteBit(GPIO_D6_PORT,GPIO_D6_PIN,(BitAction)(x>>6&0x0001));
	GPIO_WriteBit(GPIO_D7_PORT,GPIO_D7_PIN,(BitAction)(x>>7&0x0001));
	GPIO_WriteBit(GPIO_D8_PORT,GPIO_D8_PIN,(BitAction)(x>>8&0x0001));
	GPIO_WriteBit(GPIO_D9_PORT,GPIO_D9_PIN,(BitAction)(x>>9&0x0001));
	GPIO_WriteBit(GPIO_D10_PORT,GPIO_D10_PIN,(BitAction)(x>>10&0x0001));
	GPIO_WriteBit(GPIO_D11_PORT,GPIO_D11_PIN,(BitAction)(x>>11&0x0001));
	GPIO_WriteBit(GPIO_D12_PORT,GPIO_D12_PIN,(BitAction)(x>>12&0x0001));
	GPIO_WriteBit(GPIO_D13_PORT,GPIO_D13_PIN,(BitAction)(x>>13&0x0001));
	GPIO_WriteBit(GPIO_D14_PORT,GPIO_D14_PIN,(BitAction)(x>>14&0x0001));
	GPIO_WriteBit(GPIO_D15_PORT,GPIO_D15_PIN,(BitAction)(x>>15&0x0001));
}
#endif

#if 0
unsigned short DATAIN(void)
{
    unsigned short data = 0;
    data |= GPIO_D15_READ;data <<= 1;
    data |= GPIO_D14_READ;data <<= 1;
    data |= GPIO_D13_READ;data <<= 1;
    data |= GPIO_D12_READ;data <<= 1;
    data |= GPIO_D11_READ;data <<= 1;
    data |= GPIO_D10_READ;data <<= 1;
    data |= GPIO_D9_READ;data <<= 1;
    data |= GPIO_D8_READ;data <<= 1;
    data |= GPIO_D7_READ;data <<= 1;
    data |= GPIO_D5_READ;data <<= 1;
	data |= GPIO_D5_READ;data <<= 1;
    data |= GPIO_D4_READ;data <<= 1;
    data |= GPIO_D3_READ;data <<= 1;
    data |= GPIO_D2_READ;data <<= 1;
    data |= GPIO_D1_READ;data <<= 1;
    data |= GPIO_D0_READ;

    return data;
}
#endif

#if 1
//空间换时间
//#define DATAOUT(x)	
void DATAOUT(unsigned short x)
{
	//GPIO_Write(GPIOA,x);
	GPIO_WriteBit(GPIOA,GPIO_Pin_0,x>>0&0x0001);
	GPIO_WriteBit(GPIOA,GPIO_Pin_1,x>>1&0x0001);
	GPIO_WriteBit(GPIOA,GPIO_Pin_2,x>>2&0x0001);
	GPIO_WriteBit(GPIOA,GPIO_Pin_3,x>>3&0x0001);
	GPIO_WriteBit(GPIOA,GPIO_Pin_4,x>>4&0x0001);
	GPIO_WriteBit(GPIOA,GPIO_Pin_5,x>>5&0x0001);
	GPIO_WriteBit(GPIOA,GPIO_Pin_6,x>>6&0x0001);
	GPIO_WriteBit(GPIOA,GPIO_Pin_7,x>>7&0x0001);
	GPIO_WriteBit(GPIOA,GPIO_Pin_8,x>>8&0x0001);
	GPIO_WriteBit(GPIOA,GPIO_Pin_9,x>>9&0x0001);
	GPIO_WriteBit(GPIOA,GPIO_Pin_10,x>>10&0x0001);
	GPIO_WriteBit(GPIOA,GPIO_Pin_11,x>>11&0x0001);
	GPIO_WriteBit(GPIOA,GPIO_Pin_12,x>>12&0x0001);
	GPIO_WriteBit(GPIOA,GPIO_Pin_13,x>>13&0x0001);
	GPIO_WriteBit(GPIOA,GPIO_Pin_14,x>>14&0x0001);
	GPIO_WriteBit(GPIOA,GPIO_Pin_15,x>>15&0x0001);
}
#endif




#if 1
unsigned short DATAIN(void)
{
    volatile unsigned short data = 0;
  
	  data=GPIO_ReadInputData(GPIOA);

    return data;
}
#endif 

void GPIO_SET_DATA_OUT(uint8_t Mode)
{
	GPIO_InitTypeDef  GPIO_InitStructure;
	/* 配置液晶相对应的数据线,PORT-D0~D15 */
	
  if(Mode == GPIO_Set_Mode_OUT)
	{
		GPIO_InitStructure.GPIO_Speed = GPIO_Speed_50MHz;
		GPIO_InitStructure.GPIO_Mode =  GPIO_Mode_OUT;
		GPIO_InitStructure.GPIO_OType=GPIO_OType_PP;
	}
	else{
		GPIO_InitStructure.GPIO_Mode =  GPIO_Mode_IN;//PU;
	}	

	
	GPIO_InitStructure.GPIO_Pin = GPIO_LCD_D0_PIN;
	GPIO_Init ( GPIO_LCD_D0_PORT, &GPIO_InitStructure );														
													
	GPIO_InitStructure.GPIO_Pin = GPIO_LCD_D1_PIN;
	GPIO_Init ( GPIO_LCD_D1_PORT, &GPIO_InitStructure );
	
	GPIO_InitStructure.GPIO_Pin = GPIO_LCD_D2_PIN;
	GPIO_Init ( GPIO_LCD_D2_PORT, &GPIO_InitStructure );														
													
	GPIO_InitStructure.GPIO_Pin = GPIO_LCD_D3_PIN;
	GPIO_Init ( GPIO_LCD_D3_PORT, &GPIO_InitStructure );	

	GPIO_InitStructure.GPIO_Pin = GPIO_LCD_D4_PIN;
	GPIO_Init ( GPIO_LCD_D4_PORT, &GPIO_InitStructure );														
													
	GPIO_InitStructure.GPIO_Pin = GPIO_LCD_D5_PIN;
	GPIO_Init ( GPIO_LCD_D5_PORT, &GPIO_InitStructure );

	GPIO_InitStructure.GPIO_Pin = GPIO_LCD_D6_PIN;
	GPIO_Init ( GPIO_LCD_D6_PORT, &GPIO_InitStructure );														
													
	GPIO_InitStructure.GPIO_Pin = GPIO_LCD_D7_PIN;
	GPIO_Init ( GPIO_LCD_D7_PORT, &GPIO_InitStructure );

	GPIO_InitStructure.GPIO_Pin = GPIO_LCD_D8_PIN;
	GPIO_Init ( GPIO_LCD_D8_PORT, &GPIO_InitStructure );														
													
	GPIO_InitStructure.GPIO_Pin = GPIO_LCD_D9_PIN;
	GPIO_Init ( GPIO_LCD_D9_PORT, &GPIO_InitStructure );

	GPIO_InitStructure.GPIO_Pin = GPIO_LCD_D10_PIN;
	GPIO_Init ( GPIO_LCD_D10_PORT, &GPIO_InitStructure );														
													
	GPIO_InitStructure.GPIO_Pin = GPIO_LCD_D11_PIN;
	GPIO_Init ( GPIO_LCD_D11_PORT, &GPIO_InitStructure );

	GPIO_InitStructure.GPIO_Pin = GPIO_LCD_D12_PIN;
	GPIO_Init ( GPIO_LCD_D12_PORT, &GPIO_InitStructure );														
													
	GPIO_InitStructure.GPIO_Pin = GPIO_LCD_D13_PIN;
	GPIO_Init ( GPIO_LCD_D13_PORT, &GPIO_InitStructure );
	
	GPIO_InitStructure.GPIO_Pin = GPIO_LCD_D14_PIN;
	GPIO_Init ( GPIO_LCD_D14_PORT, &GPIO_InitStructure );														
													
	GPIO_InitStructure.GPIO_Pin = GPIO_LCD_D15_PIN;
	GPIO_Init ( GPIO_LCD_D15_PORT, &GPIO_InitStructure );	
}

#endif

/**
  * @brief  用于 GPIO 简单延时函数
  * @param  nCount ：延时计数值
  * @retval 无
  */	
static void GPIO_Delay ( __IO uint32_t nCount )
{
  for ( ; nCount != 0; nCount -- );
	
}
void GPIO_LCD_Select() {
    GPIO_ResetBits(GPIOB,GPIO_Pin_0);
}
void GPIO_LCD_Unselect() {
    GPIO_SetBits(GPIOB,GPIO_Pin_0);
}
static void GPIO_LCD_WriteCommand(uint8_t cmd) {
    GPIO_ResetBits(GPIOB,GPIO_Pin_1);
    DATAOUT(cmd);
}


/**
  * @brief  向GPIO写入命令
  * @param  usCmd :要写入的命令（表寄存器地址）
  * @retval 无
  */	
 void GPIO_Write_Cmd ( uint8_t usCmd )
{
	GPIO_LCD_CS_CLR;//开始片选      
	GPIO_LCD_DC_CLR;//写命令
	GPIO_LCD_RD_SET;//禁止读
	DATAOUT(usCmd);//输出命令
	GPIO_LCD_WR_CLR;//写入开始
	//GPIO_Delay(10);
	GPIO_LCD_WR_SET;//写入结束
	GPIO_LCD_CS_SET;//结束片选        	
}


/**
  * @brief  向GPIO写入数据
  * @param  usData :要写入的数据
  * @retval 无
  */	
 void GPIO_Write_Data ( uint16_t usData )
{
	GPIO_LCD_CS_CLR;//开始片选      
	GPIO_LCD_DC_SET;//写数据
	GPIO_LCD_RD_SET;//禁止读
	DATAOUT(usData);//输出数据
	GPIO_LCD_WR_CLR;//写入开始
	//GPIO_Delay(5);
	GPIO_LCD_WR_SET;//写入结束
	GPIO_LCD_CS_SET;//结束片选   
	
}


/**
  * @brief  从GPIO读取数据
  * @param  无
  * @retval 读取到的数据
  */	
 uint16_t GPIO_Read_Data ( void )
{
	uint16_t data;
	
#if	 	 GPIO_DATA_USE_ONEPORT == 1	
	
 	GPIO_DATA_PORT->CRL=0X88888888; //上拉输入
	GPIO_DATA_PORT->CRH=0X88888888; //上拉输入
	GPIO_DATA_PORT->ODR=0X0000;     //全部输出0

#elif  GPIO_DATA_USE_ANYPORT == 1
	GPIO_SET_DATA_OUT(GPIO_Set_Mode_IN);
	DATAOUT(0X0000);
#endif		
	
	GPIO_LCD_DC_SET;
	GPIO_LCD_WR_SET;

	GPIO_LCD_CS_CLR;
	//读取数据
	GPIO_LCD_RD_CLR;    
    
	data = DATAIN();  
	GPIO_LCD_RD_SET;
	GPIO_LCD_CS_SET; 

#if	 	 GPIO_DATA_USE_ONEPORT == 1	
	
	GPIO_DATA_PORT->CRL=0X33333333; // 上拉输出
	GPIO_DATA_PORT->CRH=0X33333333; // 上拉输出
	GPIO_DATA_PORT->ODR=0XFFFF;    //全部输出高

#elif  GPIO_DATA_USE_ANYPORT == 1
	GPIO_SET_DATA_OUT(GPIO_Set_Mode_OUT);
	DATAOUT(0XFFFF);
#endif	
	return data;  
}


/**
  * @brief  初始化GPIO的IO引脚
  * @param  无
  * @retval 无
  */
static void GPIO_LCD_Config ( void )
{
	GPIO_InitTypeDef GPIO_InitStructure;

		/* 使能复用IO时钟*/
//	RCC_APB2PeriphClockCmd ( RCC_APB2Periph_AFIO, ENABLE );
	
	//复位引脚直接使用NRST，开发板复位的时候会使液晶复位
#if GPIO_DATA_USE_ONEPORT == 1
	/* 使能FSMC对应相应管脚时钟*/
	RCC_APB2PeriphClockCmd ( 	
													/*控制信号*/
													GPIO_CS_CLK|GPIO_DC_CLK|GPIO_WR_CLK|
													GPIO_RD_CLK	|GPIO_BK_CLK|
													/*数据信号*/
													GPIO_DATA_CLK, ENABLE );
	
	//开启SWD，失能JTAG (部分PB引脚用在了jtag接口，改成SWD接口就不会有干扰)
//	GPIO_PinRemapConfig(GPIO_Remap_SWJ_JTAGDisable , ENABLE);	
		
	
	/* 配置液晶相对应的数据线,PORT-D0~D15 */	
	GPIO_InitStructure.GPIO_Speed = GPIO_Speed_50MHz;
	GPIO_InitStructure.GPIO_Mode =  GPIO_Mode_Out_PP;
	
	GPIO_InitStructure.GPIO_Pin = GPIO_DATA_PIN;
	GPIO_Init ( GPIO_DATA_PORT, &GPIO_InitStructure );	
#elif GPIO_DATA_USE_ANYPORT == 1
	//RCC_AHB1PeriphClockCmd ( RCC_AHB1Periph_GPIOE |RCC_AHB1Periph_GPIOD,ENABLE );
	                        /*//控制信号
													GPIO_LCD_CS_CLK|GPIO_LCD_DC_CLK|GPIO_LCD_WR_CLK|
													GPIO_LCD_RD_CLK|GPIO_LCD_BK_CLK|
													//数据信号
													GPIO_LCD_D0_CLK|GPIO_LCD_D1_CLK|GPIO_LCD_D2_CLK|
													GPIO_LCD_D3_CLK|GPIO_LCD_D4_CLK|GPIO_LCD_D5_CLK|
													GPIO_LCD_D6_CLK|GPIO_LCD_D7_CLK|GPIO_LCD_D8_CLK|
													GPIO_LCD_D9_CLK|GPIO_LCD_D10_CLK|GPIO_LCD_D11_CLK|
													GPIO_LCD_D12_CLK|GPIO_LCD_D13_CLK|GPIO_LCD_D14_CLK|
													GPIO_LCD_D15_CLK, ENABLE );*/
													
		//RCC_AHB1PeriphClockCmd ( RCC_AHB1Periph_GPIOD,ENABLE );	
   // RCC_AHB1PeriphClockCmd ( RCC_AHB1Periph_GPIOE,ENABLE );	
   //GPIO_InitTypeDef  GPIO_InitStructure;

  RCC_AHB1PeriphClockCmd(RCC_AHB1Periph_GPIOE |RCC_AHB1Periph_GPIOD, ENABLE);//使能GPIOA时钟

  //GPIOA0-7初始化设置
  GPIO_InitStructure.GPIO_Pin = GPIO_Pin_0|GPIO_Pin_1|GPIO_Pin_2|GPIO_Pin_3|GPIO_Pin_4|GPIO_Pin_5|GPIO_Pin_6|GPIO_Pin_7| \
	                            GPIO_Pin_8|GPIO_Pin_9|GPIO_Pin_10|GPIO_Pin_11|GPIO_Pin_12|GPIO_Pin_13|GPIO_Pin_14|GPIO_Pin_15;// | GPIO_Pin_10;//LED0和LED1对应IO口
  GPIO_InitStructure.GPIO_Mode = GPIO_Mode_OUT;//普通输出模式
  GPIO_InitStructure.GPIO_OType = GPIO_OType_PP;//推挽输出
  GPIO_InitStructure.GPIO_Speed = GPIO_Speed_50MHz;//100MHz
 // GPIO_InitStructure.GPIO_PuPd = GPIO_PuPd_UP;//上拉
  GPIO_Init(GPIOD, &GPIO_InitStructure);//初始化GPIO
	
	//GPIO_SetBits(GPIOA,GPIO_Pin_0|GPIO_Pin_1|GPIO_Pin_2|GPIO_Pin_3|GPIO_Pin_4|GPIO_Pin_5|GPIO_Pin_6|GPIO_Pin_7);//		
	/* 配置液晶相对应的数据线,PORT-D0~D15 */	
	/*GPIO_InitStructure.GPIO_Speed = GPIO_Speed_50MHz;
	GPIO_InitStructure.GPIO_Mode =  GPIO_Mode_OUT;
	GPIO_InitStructure.GPIO_OType=GPIO_OType_PP;
	
	GPIO_InitStructure.GPIO_Pin = GPIO_LCD_D0_PIN;
	GPIO_Init ( GPIO_LCD_D0_PORT, &GPIO_InitStructure );														
													
	GPIO_InitStructure.GPIO_Pin = GPIO_LCD_D1_PIN;
	GPIO_Init ( GPIO_LCD_D1_PORT, &GPIO_InitStructure );
	
	GPIO_InitStructure.GPIO_Pin = GPIO_LCD_D2_PIN;
	GPIO_Init ( GPIO_LCD_D2_PORT, &GPIO_InitStructure );														
													
	GPIO_InitStructure.GPIO_Pin = GPIO_LCD_D3_PIN;
	GPIO_Init ( GPIO_LCD_D3_PORT, &GPIO_InitStructure );	

	GPIO_InitStructure.GPIO_Pin = GPIO_LCD_D4_PIN;
	GPIO_Init ( GPIO_LCD_D4_PORT, &GPIO_InitStructure );														
													
	GPIO_InitStructure.GPIO_Pin = GPIO_LCD_D5_PIN;
	GPIO_Init ( GPIO_LCD_D5_PORT, &GPIO_InitStructure );

	GPIO_InitStructure.GPIO_Pin = GPIO_LCD_D6_PIN;
	GPIO_Init ( GPIO_LCD_D6_PORT, &GPIO_InitStructure );														
													
	GPIO_InitStructure.GPIO_Pin = GPIO_LCD_D7_PIN;
	GPIO_Init ( GPIO_LCD_D7_PORT, &GPIO_InitStructure );

	GPIO_InitStructure.GPIO_Pin = GPIO_LCD_D8_PIN;
	GPIO_Init ( GPIO_LCD_D8_PORT, &GPIO_InitStructure );														
													
	GPIO_InitStructure.GPIO_Pin = GPIO_LCD_D9_PIN;
	GPIO_Init ( GPIO_LCD_D9_PORT, &GPIO_InitStructure );

	GPIO_InitStructure.GPIO_Pin = GPIO_LCD_D10_PIN;
	GPIO_Init ( GPIO_LCD_D10_PORT, &GPIO_InitStructure );														
													
	GPIO_InitStructure.GPIO_Pin = GPIO_LCD_D11_PIN;
	GPIO_Init ( GPIO_LCD_D11_PORT, &GPIO_InitStructure );

	GPIO_InitStructure.GPIO_Pin = GPIO_LCD_D12_PIN;
	GPIO_Init ( GPIO_LCD_D12_PORT, &GPIO_InitStructure );														
													
	GPIO_InitStructure.GPIO_Pin = GPIO_LCD_D13_PIN;
	GPIO_Init ( GPIO_LCD_D13_PORT, &GPIO_InitStructure );
	
	GPIO_InitStructure.GPIO_Pin = GPIO_LCD_D14_PIN;
	GPIO_Init ( GPIO_LCD_D14_PORT, &GPIO_InitStructure );														
													
	GPIO_InitStructure.GPIO_Pin = GPIO_LCD_D15_PIN;
	GPIO_Init ( GPIO_LCD_D15_PORT, &GPIO_InitStructure );	*/
	
#endif
	/* 配置液晶相对应的控制线
	 * 读   			:LCD-RD
	 * 写   			:LCD-WR
	 * 片选   		:LCD-CS
	 * 数据/命令 	:LCD-DC
	 */
	/*GPIO_InitStructure.GPIO_Pin = GPIO_LCD_RD_PIN; 
	GPIO_Init (GPIO_LCD_RD_PORT, & GPIO_InitStructure );
	
	GPIO_InitStructure.GPIO_Pin = GPIO_LCD_WR_PIN; 
	GPIO_Init (GPIO_LCD_WR_PORT, & GPIO_InitStructure );
	
	GPIO_InitStructure.GPIO_Pin = GPIO_LCD_CS_PIN; 
	GPIO_Init ( GPIO_LCD_CS_PORT, & GPIO_InitStructure );  
	
	GPIO_InitStructure.GPIO_Pin = GPIO_LCD_DC_PIN; 
	GPIO_Init ( GPIO_LCD_DC_PORT, & GPIO_InitStructure );*/
	GPIO_InitStructure.GPIO_Pin = GPIO_Pin_0|GPIO_Pin_1|GPIO_Pin_2|GPIO_Pin_3;
	GPIO_Init(GPIOE, &GPIO_InitStructure);		
	/* 配置LCD背光控制管脚BK*/	
	//GPIO_InitStructure.GPIO_Pin = GPIO_BK_PIN; 
	//GPIO_Init ( GPIO_BK_PORT, &GPIO_InitStructure );
}
void GPIO_LCD_RESET ( void )
{
	GPIO_SetBits(GPIOB,GPIO_Pin_5);
	GPIO_Delay(150);
	GPIO_ResetBits(GPIOB,GPIO_Pin_5);
}

/**
 * @brief  初始化GPIO寄存器
 * @param  无
 * @retval 无
 */
static void GPIO_REG_Config ( void )
{	
	
	GPIO_Write_Cmd(0x01);
  GPIO_Delay(1000);
  GPIO_Write_Cmd(0xCB);
  GPIO_Write_Data(0x39);
  GPIO_Write_Data(0x2C); 
  GPIO_Write_Data(0x00); 
  GPIO_Write_Data(0x34); 
  GPIO_Write_Data(0x02);   
    // POWER CONTROL A
    GPIO_Write_Cmd(0xCB);
  GPIO_Write_Data(0x39);
  GPIO_Write_Data(0x2C); 
  GPIO_Write_Data(0x00); 
  GPIO_Write_Data(0x34); 
  GPIO_Write_Data(0x02); 

    // POWER CONTROL B
	GPIO_Write_Cmd(0xCF);
  GPIO_Write_Data(0x00);
  GPIO_Write_Data(0xC1); 
  GPIO_Write_Data(0x30);
    

    // DRIVER TIMING CONTROL A
	GPIO_Write_Cmd(0xE8);
  GPIO_Write_Data(0x85);
  GPIO_Write_Data(0x00); 
  GPIO_Write_Data(0x78);

    // DRIVER TIMING CONTROL B
	GPIO_Write_Cmd(0xEA);
  GPIO_Write_Data(0x00);
  GPIO_Write_Data(0x00); 
    

    // POWER ON SEQUENCE CONTROL
	GPIO_Write_Cmd(0xED);
  GPIO_Write_Data(0x64);
  GPIO_Write_Data(0x03); 
  GPIO_Write_Data(0x12); 
  GPIO_Write_Data(0x81); 
   
    // PUMP RATIO CONTROL
	GPIO_Write_Cmd(0xF7);
  GPIO_Write_Data(0x20);
    

    // POWER CONTROL,VRH[5:0]
	GPIO_Write_Cmd(0xC0);
  GPIO_Write_Data(0x23);
    

    // POWER CONTROL,SAP[2:0];BT[3:0]
	GPIO_Write_Cmd(0xC1);
  GPIO_Write_Data(0x10);
    

    // VCM CONTROL
	GPIO_Write_Cmd(0xC5);
  GPIO_Write_Data(0x3E);
  GPIO_Write_Data(0x28); 
    
    // VCM CONTROL 2
	GPIO_Write_Cmd(0xC7);
  GPIO_Write_Data(0x86);
   

    // MEMORY ACCESS CONTROL
	GPIO_Write_Cmd(0x36);
  GPIO_Write_Data(0x48);
    

    // PIXEL FORMAT
	GPIO_Write_Cmd(0x3A);
  GPIO_Write_Data(0x55);
    
    // FRAME RATIO CONTROL, STANDARD RGB COLOR
	GPIO_Write_Cmd(0xB1);
  GPIO_Write_Data(0x00);
  GPIO_Write_Data(0x18); 
   

    // DISPLAY FUNCTION CONTROL
	GPIO_Write_Cmd(0xB6);
	GPIO_Write_Data(0x08);
  GPIO_Write_Data(0x82);
  GPIO_Write_Data(0x27); 
    

    // 3GAMMA FUNCTION DISABLE
	GPIO_Write_Cmd(0xF2);
  GPIO_Write_Data(0x00);
   

    // GAMMA CURVE SELECTED
	GPIO_Write_Cmd(0x26);
  GPIO_Write_Data(0x01);
   

    // POSITIVE GAMMA CORRECTION
	GPIO_Write_Cmd(0xE0);
    GPIO_Write_Data(0x0F);
	GPIO_Write_Data(0x31);
	GPIO_Write_Data(0x2B);
	GPIO_Write_Data(0x0C);
	GPIO_Write_Data(0x0E);
	GPIO_Write_Data(0x08);
	GPIO_Write_Data(0x4E);
	GPIO_Write_Data(0xF1);
	GPIO_Write_Data(0x37);
	GPIO_Write_Data(0x07);
	GPIO_Write_Data(0x10);
	GPIO_Write_Data(0x03);
	GPIO_Write_Data(0x0E);
	GPIO_Write_Data(0x09);
	GPIO_Write_Data(0x00);
    

    // NEGATIVE GAMMA CORRECTION
	GPIO_Write_Cmd(0xE1);
	GPIO_Write_Data(0x00);
    GPIO_Write_Data(0x0E);
	GPIO_Write_Data(0x14);
	GPIO_Write_Data(0x03);
	GPIO_Write_Data(0x11);
	GPIO_Write_Data(0x07);
	GPIO_Write_Data(0x31);
	GPIO_Write_Data(0xC1);
	GPIO_Write_Data(0x48);
	GPIO_Write_Data(0x08);
	GPIO_Write_Data(0x0F);
	GPIO_Write_Data(0x0C);
	GPIO_Write_Data(0x31);
	GPIO_Write_Data(0x36);
	GPIO_Write_Data(0x0F);

    // EXIT SLEEP
	 GPIO_Write_Cmd(0x11);
     GPIO_Delay(120);

    // TURN ON DISPLAY
	GPIO_Write_Cmd(0x29);

    // MADCTL
	GPIO_Write_Cmd(0x36);
	//GPIO_Write_Data(0x48);
	GPIO_Write_Data(0xD8);
	
  GPIO_Write_Cmd(0x2A); 
  GPIO_Write_Data(0x00);
	GPIO_Write_Data(0x00);
	GPIO_Write_Data(0x01);
	GPIO_Write_Data(0x3F);	
  
  GPIO_Write_Cmd(0x2B); 
  GPIO_Write_Data(0x00);
	GPIO_Write_Data(0x00);
	GPIO_Write_Data(0x00);
	GPIO_Write_Data(0xEF);	
}

/**
 * @brief  GPIO读取芯片ID函数，可用于测试底层的读写函数
 * @param  无
 * @retval 正常时返回值为 0x9341 
 */
uint16_t GPIO_Read_ID(void)
{
	uint16_t id = 0;
	
	GPIO_Write_Cmd(0xD3);
	GPIO_Read_Data();
	GPIO_Read_Data();
	id = GPIO_Read_Data();
	id<<=8;
	id|=GPIO_Read_Data();
	
	return id;
	
}

/**
 * @brief  GPIO初始化函数，如果要用到lcd，一定要调用这个函数
 * @param  无
 * @retval 无
 */
void GPIO_LCD_Init ( void )
{
	//GPIO_LCD_Config ();
	
	//GPIO_BackLed_Control ( DISABLE );      //点亮LCD背光灯

	GPIO_REG_Config ();
	
	//设置默认扫描方向，其中 6 模式为大部分液晶例程的默认显示方向  
	//GPIO_GramScan(LCD_SCAN_MODE);
}


/**
 * @brief  GPIO背光LED控制
 * @param  enumState ：决定是否使能背光LED
  *   该参数为以下值之一：
  *     @arg ENABLE :使能背光LED
  *     @arg DISABLE :禁用背光LED
 * @retval 无
 */
void GPIO_BackLed_Control ( FunctionalState enumState )
{
//	if ( enumState )
//		GPIO_ResetBits ( GPIO_LCD_BK_PORT, GPIO_LCD_BK_PIN );	
//	else
//		GPIO_SetBits ( GPIO_LCD_BK_PORT, GPIO_LCD_BK_PIN );
		
}


/**
 * @brief  设置GPIO的GRAM的扫描方向 
 * @param  ucOption ：选择GRAM的扫描方向 
 *     @arg 0-7 :参数可选值为0-7这八个方向
 *
 *	！！！其中0、3、5、6 模式适合从左至右显示文字，
 *				不推荐使用其它模式显示文字	其它模式显示文字会有镜像效果			
 *		
 *	其中0、2、4、6 模式的X方向像素为240，Y方向像素为320
 *	其中1、3、5、7 模式下X方向像素为320，Y方向像素为240
 *
 *	其中 6 模式为大部分液晶例程的默认显示方向
 *	其中 3 模式为摄像头例程使用的方向
 *	其中 0 模式为BMP图片显示例程使用的方向
 *
 * @retval 无
 * @note  坐标图例：A表示向上，V表示向下，<表示向左，>表示向右
					X表示X轴，Y表示Y轴

------------------------------------------------------------
模式0：				.		模式1：		.	模式2：			.	模式3：					
					A		.					A		.		A					.		A									
					|		.					|		.		|					.		|							
					Y		.					X		.		Y					.		X					
					0		.					1		.		2					.		3					
	<--- X0 o		.	<----Y1	o		.		o 2X--->  .		o 3Y--->	
------------------------------------------------------------	
模式4：				.	模式5：			.	模式6：			.	模式7：					
	<--- X4 o		.	<--- Y5 o		.		o 6X--->  .		o 7Y--->	
					4		.					5		.		6					.		7	
					Y		.					X		.		Y					.		X						
					|		.					|		.		|					.		|							
					V		.					V		.		V					.		V		
---------------------------------------------------------				
											 LCD屏示例
								|-----------------|
								|			野火Logo		|
								|									|
								|									|
								|									|
								|									|
								|									|
								|									|
								|									|
								|									|
								|-----------------|
								屏幕正面（宽240，高320）

 *******************************************************/
void GPIO_GramScan ( uint8_t ucOption )
{	
	//参数检查，只可输入0-7
	if(ucOption >7 )
		return;
	
	//根据模式更新LCD_SCAN_MODE的值，主要用于触摸屏选择计算参数
	LCD_SCAN_MODE = ucOption;
	
	//根据模式更新XY方向的像素宽度
	if(ucOption%2 == 0)	
	{
		//0 2 4 6模式下X方向像素宽度为240，Y方向为320
		LCD_X_LENGTH = GPIO_LESS_PIXEL;
		LCD_Y_LENGTH =	GPIO_MORE_PIXEL;
	}
	else				
	{
		//1 3 5 7模式下X方向像素宽度为320，Y方向为240
		LCD_X_LENGTH = GPIO_MORE_PIXEL;
		LCD_Y_LENGTH =	GPIO_LESS_PIXEL; 
	}

	//0x36命令参数的高3位可用于设置GRAM扫描方向	
	GPIO_Write_Cmd ( 0x36 ); 
	GPIO_Write_Data ( 0x08 |(ucOption<<5));//根据ucOption的值设置LCD参数，共0-7种模式
	GPIO_Write_Cmd ( CMD_SetCoordinateX ); 
	GPIO_Write_Data ( 0x00 );		/* x 起始坐标高8位 */
	GPIO_Write_Data ( 0x00 );		/* x 起始坐标低8位 */
	GPIO_Write_Data ( ((LCD_X_LENGTH-1)>>8)&0xFF ); /* x 结束坐标高8位 */	
	GPIO_Write_Data ( (LCD_X_LENGTH-1)&0xFF );				/* x 结束坐标低8位 */

	GPIO_Write_Cmd ( CMD_SetCoordinateY ); 
	GPIO_Write_Data ( 0x00 );		/* y 起始坐标高8位 */
	GPIO_Write_Data ( 0x00 );		/* y 起始坐标低8位 */
	GPIO_Write_Data ( ((LCD_Y_LENGTH-1)>>8)&0xFF );	/* y 结束坐标高8位 */	 
	GPIO_Write_Data ( (LCD_Y_LENGTH-1)&0xFF );				/* y 结束坐标低8位 */

	/* write gram start */
	GPIO_Write_Cmd ( CMD_SetPixel );	
}



/**
 * @brief  在GPIO显示器上开辟一个窗口
 * @param  usX ：在特定扫描方向下窗口的起点X坐标
 * @param  usY ：在特定扫描方向下窗口的起点Y坐标
 * @param  usWidth ：窗口的宽度
 * @param  usHeight ：窗口的高度
 * @retval 无
 */
void GPIO_OpenWindow ( uint16_t usX, uint16_t usY, uint16_t usWidth, uint16_t usHeight )
{	
	GPIO_Write_Cmd ( CMD_SetCoordinateX ); 				 /* 设置X坐标 */
	GPIO_Write_Data ( usX >> 8  );	 /* 先高8位，然后低8位 */
	GPIO_Write_Data ( usX & 0xff  );	 /* 设置起始点和结束点*/
	GPIO_Write_Data ( ( usX + usWidth - 1 ) >> 8  );
	GPIO_Write_Data ( ( usX + usWidth - 1 ) & 0xff  );

	GPIO_Write_Cmd ( CMD_SetCoordinateY ); 			     /* 设置Y坐标*/
	GPIO_Write_Data ( usY >> 8  );
	GPIO_Write_Data ( usY & 0xff  );
	GPIO_Write_Data ( ( usY + usHeight - 1 ) >> 8 );
	GPIO_Write_Data ( ( usY + usHeight - 1) & 0xff );
	
}


/**
 * @brief  设定GPIO的光标坐标
 * @param  usX ：在特定扫描方向下光标的X坐标
 * @param  usY ：在特定扫描方向下光标的Y坐标
 * @retval 无
 */
/* void GPIO_SetCursor ( uint16_t usX, uint16_t usY )	
{
	GPIO_OpenWindow ( usX, usY, 1, 1 );
}*/


/**
 * @brief  在GPIO显示器上以某一颜色填充像素点
 * @param  ulAmout_Point ：要填充颜色的像素点的总数目
 * @param  usColor ：颜色
 * @retval 无
 */
void GPIO_FillColor ( uint32_t ulAmout_Point, uint16_t usColor )
{
	uint32_t i = 0;
	
	
	/* memory write */
	GPIO_Write_Cmd ( CMD_SetPixel );	
		GPIO_Write_Data ( usColor&0xff );
	  GPIO_Write_Data ( (usColor>>8)&0xff );
}


/**
 * @brief  对GPIO显示器的某一窗口以某种颜色进行清屏
 * @param  usX ：在特定扫描方向下窗口的起点X坐标
 * @param  usY ：在特定扫描方向下窗口的起点Y坐标
 * @param  usWidth ：窗口的宽度
 * @param  usHeight ：窗口的高度
 * @note 可使用LCD_SetBackColor、LCD_SetTextColor、LCD_SetColors函数设置颜色
 * @retval 无
 */
void GPIO_Clear ( uint16_t usX, uint16_t usY, uint16_t usWidth, uint16_t usHeight )
{
	GPIO_OpenWindow ( usX, usY, usWidth, usHeight );

	GPIO_FillColor ( usWidth * usHeight, CurrentBackColor );		
	
}


/**
 * @brief  对GPIO显示器的某一点以某种颜色进行填充
 * @param  usX ：在特定扫描方向下该点的X坐标
 * @param  usY ：在特定扫描方向下该点的Y坐标
 * @note 可使用LCD_SetBackColor、LCD_SetTextColor、LCD_SetColors函数设置颜色
 * @retval 无
 */
void ILI9341_SetAddressWindow(uint16_t x0, uint16_t y0, uint16_t x1, uint16_t y1) {
    // column address set
    GPIO_Write_Cmd(0x2A); // CASET
		
	  GPIO_Write_Data((y0 >> 8) & 0xFF);
		GPIO_Write_Data(y0 & 0xFF);
		GPIO_Write_Data((y1 >> 8) & 0xFF);
		GPIO_Write_Data(y1 & 0xFF);
    

    // row address set
    GPIO_Write_Cmd(0x2B); // RASET
	  GPIO_Write_Data((x0 >> 8) & 0xFF);
		GPIO_Write_Data(x0 & 0xFF);
		GPIO_Write_Data((x1 >> 8) & 0xFF);
		GPIO_Write_Data(x1 & 0xFF);

    // write to RAM
    GPIO_Write_Cmd(0x2C); // RAMWR
}
void GPIO_SetPointPixel ( uint16_t usX, uint16_t usY,uint16_t color )	
{	
	if ( ( usX < LCD_X_LENGTH ) && ( usY < LCD_Y_LENGTH ) )
  {
		ILI9341_SetAddressWindow(usX, usY, usX+1, usY+1);
		GPIO_Write_Data(color >> 8);
		GPIO_Write_Data(color & 0xFF);
	}
	
}


/**
 * @brief  读取GPIO GRAN 的一个像素数据
 * @param  无
 * @retval 像素数据
 */
uint16_t GPIO_Read_PixelData ( void )	
{	
	uint16_t usR=0, usG=0, usB=0 ;

	
	GPIO_Write_Cmd ( 0x2E );   /* 读数据 */
	
	usR = GPIO_Read_Data (); 	/*FIRST READ OUT DUMMY DATA*/
	
	usR = GPIO_Read_Data ();  	/*READ OUT RED DATA  */
	usB = GPIO_Read_Data ();  	/*READ OUT BLUE DATA*/
	usG = GPIO_Read_Data ();  	/*READ OUT GREEN DATA*/	
	
  return ( ( ( usR >> 11 ) << 11 ) | ( ( usG >> 10 ) << 5 ) | ( usB >> 11 ) );
	
}


/**
 * @brief  获取 GPIO 显示器上某一个坐标点的像素数据
 * @param  usX ：在特定扫描方向下该点的X坐标
 * @param  usY ：在特定扫描方向下该点的Y坐标
 * @retval 像素数据
 */
uint16_t GPIO_GetPointPixel ( uint16_t usX, uint16_t usY )
{ 
	uint16_t usPixelData;

	
	//GPIO_SetCursor ( usX, usY );
	
	usPixelData = GPIO_Read_PixelData ();
	
	return usPixelData;
	
}


/**
 * @brief  在 GPIO 显示器上使用 Bresenham 算法画线段 
 * @param  usX1 ：在特定扫描方向下线段的一个端点X坐标
 * @param  usY1 ：在特定扫描方向下线段的一个端点Y坐标
 * @param  usX2 ：在特定扫描方向下线段的另一个端点X坐标
 * @param  usY2 ：在特定扫描方向下线段的另一个端点Y坐标
 * @note 可使用LCD_SetBackColor、LCD_SetTextColor、LCD_SetColors函数设置颜色
 * @retval 无
 */
void GPIO_DrawLine ( uint16_t usX1, uint16_t usY1, uint16_t usX2, uint16_t usY2,uint16_t color )
{
	uint16_t us; 
	uint16_t usX_Current, usY_Current;
	
	int32_t lError_X = 0, lError_Y = 0, lDelta_X, lDelta_Y, lDistance; 
	int32_t lIncrease_X, lIncrease_Y; 	
	
	
	lDelta_X = usX2 - usX1; //计算坐标增量 
	lDelta_Y = usY2 - usY1; 
	
	usX_Current = usX1; 
	usY_Current = usY1; 
	
	
	if ( lDelta_X > 0 ) 
		lIncrease_X = 1; //设置单步方向 
	
	else if ( lDelta_X == 0 ) 
		lIncrease_X = 0;//垂直线 
	
	else 
  { 
    lIncrease_X = -1;
    lDelta_X = - lDelta_X;
  } 

	
	if ( lDelta_Y > 0 )
		lIncrease_Y = 1; 
	
	else if ( lDelta_Y == 0 )
		lIncrease_Y = 0;//水平线 
	
	else 
  {
    lIncrease_Y = -1;
    lDelta_Y = - lDelta_Y;
  } 

	
	if (  lDelta_X > lDelta_Y )
		lDistance = lDelta_X; //选取基本增量坐标轴 
	
	else 
		lDistance = lDelta_Y; 

	//GPIO_OpenWindow ( usX1, usY1, usX2, usY2);
	for ( us = 0; us <= lDistance + 1; us ++ )//画线输出 
	{  
		GPIO_SetPointPixel ( usX_Current, usY_Current,color );//画点 
		
		lError_X += lDelta_X ; 
		lError_Y += lDelta_Y ; 
		
		if ( lError_X > lDistance ) 
		{ 
			lError_X -= lDistance; 
			usX_Current += lIncrease_X; 
		}  
		
		if ( lError_Y > lDistance ) 
		{ 
			lError_Y -= lDistance; 
			usY_Current += lIncrease_Y; 
		} 
		
	}  
	
	
}   
/**
 * @brief  在 GPIO 显示器上画一个矩形
 * @param  usX_Start ：在特定扫描方向下矩形的起始点X坐标
 * @param  usY_Start ：在特定扫描方向下矩形的起始点Y坐标
 * @param  usWidth：矩形的宽度（单位：像素）
 * @param  usHeight：矩形的高度（单位：像素）
 * @param  ucFilled ：选择是否填充该矩形
  *   该参数为以下值之一：
  *     @arg 0 :空心矩形
  *     @arg 1 :实心矩形 
 * @note 可使用LCD_SetBackColor、LCD_SetTextColor、LCD_SetColors函数设置颜色
 * @retval 无
 */
void GPIO_DrawRectangle ( uint16_t usX_Start, uint16_t usY_Start, uint16_t usWidth, uint16_t usHeight, uint16_t ucFilled )//uint8_t ucFilled )
{

	if((usX_Start >= LCD_X_LENGTH) || (usY_Start >= LCD_Y_LENGTH)) return;
    if((usX_Start + usWidth - 1) >= LCD_X_LENGTH) usWidth = LCD_X_LENGTH - usX_Start;
    if((usX_Start + usHeight - 1) >= LCD_Y_LENGTH) usHeight = LCD_Y_LENGTH - usY_Start;
    ILI9341_SetAddressWindow(usX_Start, usX_Start, usX_Start+usWidth-1, usY_Start+usHeight-1);
    for(usY_Start= usHeight; usY_Start > 0; usY_Start--) {
        for(usX_Start = usWidth; usX_Start > 0; usX_Start--) {
          GPIO_Write_Data(ucFilled >> 8);
		      GPIO_Write_Data(ucFilled & 0xFF);
        }
    }


}
void GPIO_FillScreen(uint16_t color) {
    GPIO_DrawRectangle(0, 0, LCD_X_LENGTH, LCD_Y_LENGTH, color);
}

/**
 * @brief  在 GPIO 显示器上使用 Bresenham 算法画圆
 * @param  usX_Center ：在特定扫描方向下圆心的X坐标
 * @param  usY_Center ：在特定扫描方向下圆心的Y坐标
 * @param  usRadius：圆的半径（单位：像素）
 * @param  ucFilled ：选择是否填充该圆
  *   该参数为以下值之一：
  *     @arg 0 :空心圆
  *     @arg 1 :实心圆
 * @note 可使用LCD_SetBackColor、LCD_SetTextColor、LCD_SetColors函数设置颜色
 * @retval 无
 */
void GPIO_DrawCircle ( uint16_t usX_Center, uint16_t usY_Center, uint16_t usRadius, uint8_t ucFilled )
{
	int16_t sCurrentX, sCurrentY;
	int16_t sError;
	
	
	sCurrentX = 0; sCurrentY = usRadius;	  
	
	sError = 3 - ( usRadius << 1 );     //判断下个点位置的标志
	
	
	while ( sCurrentX <= sCurrentY )
	{
		int16_t sCountY;
		
		
		if ( ucFilled ) 			
			for ( sCountY = sCurrentX; sCountY <= sCurrentY; sCountY ++ ) 
			{                      
				GPIO_SetPointPixel ( usX_Center + sCurrentX, usY_Center + sCountY,ucFilled );           //1，研究对象 
				GPIO_SetPointPixel ( usX_Center - sCurrentX, usY_Center + sCountY,ucFilled );           //2       
				GPIO_SetPointPixel ( usX_Center - sCountY,   usY_Center + sCurrentX,ucFilled );           //3
				GPIO_SetPointPixel ( usX_Center - sCountY,   usY_Center - sCurrentX,ucFilled );           //4
				GPIO_SetPointPixel ( usX_Center - sCurrentX, usY_Center - sCountY,ucFilled );           //5    
        GPIO_SetPointPixel ( usX_Center + sCurrentX, usY_Center - sCountY ,ucFilled);           //6
				GPIO_SetPointPixel ( usX_Center + sCountY,   usY_Center - sCurrentX,ucFilled );           //7 	
        GPIO_SetPointPixel ( usX_Center + sCountY,   usY_Center + sCurrentX ,ucFilled);           //0				
			}
		
		else
		{          
			GPIO_SetPointPixel ( usX_Center + sCurrentX, usY_Center + sCurrentY,ucFilled );             //1，研究对象
			GPIO_SetPointPixel ( usX_Center - sCurrentX, usY_Center + sCurrentY,ucFilled );             //2      
			GPIO_SetPointPixel ( usX_Center - sCurrentY, usY_Center + sCurrentX,ucFilled );             //3
			GPIO_SetPointPixel ( usX_Center - sCurrentY, usY_Center - sCurrentX ,ucFilled);             //4
			GPIO_SetPointPixel ( usX_Center - sCurrentX, usY_Center - sCurrentY,ucFilled );             //5       
			GPIO_SetPointPixel ( usX_Center + sCurrentX, usY_Center - sCurrentY,ucFilled );             //6
			GPIO_SetPointPixel ( usX_Center + sCurrentY, usY_Center - sCurrentX ,ucFilled);             //7 
			GPIO_SetPointPixel ( usX_Center + sCurrentY, usY_Center + sCurrentX ,ucFilled);             //0
    }			
		
		
		sCurrentX ++;

		
		if ( sError < 0 ) 
			sError += 4 * sCurrentX + 6;	  
		
		else
		{
			sError += 10 + 4 * ( sCurrentX - sCurrentY );   
			sCurrentY --;
		} 	
		
		
	}
	
	
}

/**
 * @brief  在 GPIO 显示器上显示一个英文字符
 * @param  usX ：在特定扫描方向下字符的起始X坐标
 * @param  usY ：在特定扫描方向下该点的起始Y坐标
 * @param  cChar ：要显示的英文字符
 * @note 可使用LCD_SetBackColor、LCD_SetTextColor、LCD_SetColors函数设置颜色
 * @retval 无
 */
void GPIO_DispChar_EN ( uint16_t usX, uint16_t usY, const char cChar )
{
	uint8_t  byteCount, bitCount,fontLength;	
	uint16_t ucRelativePositon;
	uint8_t *Pfont;
	
	//对ascii码表偏移（字模表不包含ASCII表的前32个非图形符号）
	ucRelativePositon = cChar - ' ';
	
	//每个字模的字节数
	fontLength = (LCD_Currentfonts->Width*LCD_Currentfonts->Height)/8;
		
	//字模首地址
	/*ascii码表偏移值乘以每个字模的字节数，求出字模的偏移位置*/
	Pfont = (uint8_t *)&LCD_Currentfonts->table[ucRelativePositon * fontLength];
	
	//设置显示窗口
	GPIO_OpenWindow ( usX, usY, LCD_Currentfonts->Width, LCD_Currentfonts->Height);
	
	GPIO_Write_Cmd ( CMD_SetPixel );			

	//按字节读取字模数据
	//由于前面直接设置了显示窗口，显示数据会自动换行
	for ( byteCount = 0; byteCount < fontLength; byteCount++ )
	{
			//一位一位处理要显示的颜色
			for ( bitCount = 0; bitCount < 8; bitCount++ )
			{
					if ( Pfont[byteCount] & (0x80>>bitCount) )
						GPIO_Write_Data ( CurrentTextColor );			
					else
						GPIO_Write_Data ( CurrentBackColor );
			}	
	}	
}


/**
 * @brief  在 GPIO 显示器上显示英文字符串
 * @param  line ：在特定扫描方向下字符串的起始Y坐标
  *   本参数可使用宏LINE(0)、LINE(1)等方式指定文字坐标，
  *   宏LINE(x)会根据当前选择的字体来计算Y坐标值。
	*		显示中文且使用LINE宏时，需要把英文字体设置成Font8x16
 * @param  pStr ：要显示的英文字符串的首地址
 * @note 可使用LCD_SetBackColor、LCD_SetTextColor、LCD_SetColors函数设置颜色
 * @retval 无
 */
void GPIO_DispStringLine_EN (  uint16_t line,  char * pStr )
{
	uint16_t usX = 0;
	
	while ( * pStr != '\0' )
	{
		if ( ( usX - GPIO_DispWindow_X_Star + LCD_Currentfonts->Width ) > LCD_X_LENGTH )
		{
			usX = GPIO_DispWindow_X_Star;
			line += LCD_Currentfonts->Height;
		}
		
		if ( ( line - GPIO_DispWindow_Y_Star + LCD_Currentfonts->Height ) > LCD_Y_LENGTH )
		{
			usX = GPIO_DispWindow_X_Star;
			line = GPIO_DispWindow_Y_Star;
		}
		
		GPIO_DispChar_EN ( usX, line, * pStr);
		
		pStr ++;
		
		usX += LCD_Currentfonts->Width;
		
	}
	
}


/**
 * @brief  在 GPIO 显示器上显示英文字符串
 * @param  usX ：在特定扫描方向下字符的起始X坐标
 * @param  usY ：在特定扫描方向下字符的起始Y坐标
 * @param  pStr ：要显示的英文字符串的首地址
 * @note 可使用LCD_SetBackColor、LCD_SetTextColor、LCD_SetColors函数设置颜色
 * @retval 无
 */
void GPIO_DispString_EN ( 	uint16_t usX ,uint16_t usY,  char * pStr )
{
	while ( * pStr != '\0' )
	{
		if ( ( usX - GPIO_DispWindow_X_Star + LCD_Currentfonts->Width ) > LCD_X_LENGTH )
		{
			usX = GPIO_DispWindow_X_Star;
			usY += LCD_Currentfonts->Height;
		}
		
		if ( ( usY - GPIO_DispWindow_Y_Star + LCD_Currentfonts->Height ) > LCD_Y_LENGTH )
		{
			usX = GPIO_DispWindow_X_Star;
			usY = GPIO_DispWindow_Y_Star;
		}
		
		GPIO_DispChar_EN ( usX, usY, * pStr);
		
		pStr ++;
		
		usX += LCD_Currentfonts->Width;
		
	}
	
}


/**
 * @brief  在 GPIO 显示器上显示英文字符串(沿Y轴方向)
 * @param  usX ：在特定扫描方向下字符的起始X坐标
 * @param  usY ：在特定扫描方向下字符的起始Y坐标
 * @param  pStr ：要显示的英文字符串的首地址
 * @note 可使用LCD_SetBackColor、LCD_SetTextColor、LCD_SetColors函数设置颜色
 * @retval 无
 */
void GPIO_DispString_EN_YDir (	 uint16_t usX,uint16_t usY ,  char * pStr )
{	
	while ( * pStr != '\0' )
	{
		if ( ( usY - GPIO_DispWindow_Y_Star + LCD_Currentfonts->Height ) >LCD_Y_LENGTH  )
		{
			usY = GPIO_DispWindow_Y_Star;
			usX += LCD_Currentfonts->Width;
		}
		
		if ( ( usX - GPIO_DispWindow_X_Star + LCD_Currentfonts->Width ) >  LCD_X_LENGTH)
		{
			usX = GPIO_DispWindow_X_Star;
			usY = GPIO_DispWindow_Y_Star;
		}
		
		GPIO_DispChar_EN ( usX, usY, * pStr);
		
		pStr ++;
		
		usY += LCD_Currentfonts->Height;		
	}	
}

/**
 * @brief  在 GPIO 显示器上显示一个中文字符
 * @param  usX ：在特定扫描方向下字符的起始X坐标
 * @param  usY ：在特定扫描方向下字符的起始Y坐标
 * @param  usChar ：要显示的中文字符（国标码）
 * @note 可使用LCD_SetBackColor、LCD_SetTextColor、LCD_SetColors函数设置颜色
 * @retval 无
 */ 
void GPIO_DispChar_CH ( uint16_t usX, uint16_t usY, uint16_t usChar )
{
	uint8_t rowCount, bitCount;
	uint8_t ucBuffer [ WIDTH_CH_CHAR*HEIGHT_CH_CHAR/8 ];	
  uint16_t usTemp; 	

	//设置显示窗口
	GPIO_OpenWindow ( usX, usY, WIDTH_CH_CHAR, HEIGHT_CH_CHAR );
	
	GPIO_Write_Cmd ( CMD_SetPixel );
	
	//取字模数据  
  //GetGBKCode ( ucBuffer, usChar );	
	
	for ( rowCount = 0; rowCount < HEIGHT_CH_CHAR; rowCount++ )
	{
    /* 取出两个字节的数据，在lcd上即是一个汉字的一行 */
		usTemp = ucBuffer [ rowCount * 2 ];
		usTemp = ( usTemp << 8 );
		usTemp |= ucBuffer [ rowCount * 2 + 1 ];
		
		for ( bitCount = 0; bitCount < WIDTH_CH_CHAR; bitCount ++ )
		{			
			if ( usTemp & ( 0x8000 >> bitCount ) )  //高位在前 
			  GPIO_Write_Data ( CurrentTextColor );				
			else
				GPIO_Write_Data ( CurrentBackColor );			
		}		
	}
	
}


/**
 * @brief  在 GPIO 显示器上显示中文字符串
 * @param  line ：在特定扫描方向下字符串的起始Y坐标
  *   本参数可使用宏LINE(0)、LINE(1)等方式指定文字坐标，
  *   宏LINE(x)会根据当前选择的字体来计算Y坐标值。
	*		显示中文且使用LINE宏时，需要把英文字体设置成Font8x16
 * @param  pStr ：要显示的英文字符串的首地址
 * @note 可使用LCD_SetBackColor、LCD_SetTextColor、LCD_SetColors函数设置颜色
 * @retval 无
 */
void GPIO_DispString_CH ( 	uint16_t usX , uint16_t usY, char * pStr )
{	
	uint16_t usCh;

	
	while( * pStr != '\0' )
	{		
		if ( ( usX - GPIO_DispWindow_X_Star + WIDTH_CH_CHAR ) > LCD_X_LENGTH )
		{
			usX = GPIO_DispWindow_X_Star;
			usY += HEIGHT_CH_CHAR;
		}
		
		if ( ( usY - GPIO_DispWindow_Y_Star + HEIGHT_CH_CHAR ) > LCD_Y_LENGTH )
		{
			usX = GPIO_DispWindow_X_Star;
			usY = GPIO_DispWindow_Y_Star;
		}	
		
		usCh = * ( uint16_t * ) pStr;	
	  usCh = ( usCh << 8 ) + ( usCh >> 8 );

		GPIO_DispChar_CH ( usX, usY, usCh );
		
		usX += WIDTH_CH_CHAR;
		
		pStr += 2;           //一个汉字两个字节 

	}	   
	
}

/**
 * @brief  在 GPIO 显示器上显示中英文字符串
 * @param  usX ：在特定扫描方向下字符的起始X坐标
 * @param  usY ：在特定扫描方向下字符的起始Y坐标
 * @param  pStr ：要显示的字符串的首地址
 * @note 可使用LCD_SetBackColor、LCD_SetTextColor、LCD_SetColors函数设置颜色
 * @retval 无
 */
void GPIO_DispString_EN_CH ( 	uint16_t usX , uint16_t usY, char * pStr )
{
	uint16_t usCh;
	
	while( * pStr != '\0' )
	{
		if ( * pStr <= 126 )	           	//英文字符
		{
			if ( ( usX - GPIO_DispWindow_X_Star + LCD_Currentfonts->Width ) > LCD_X_LENGTH )
			{
				usX = GPIO_DispWindow_X_Star;
				usY += LCD_Currentfonts->Height;
			}
			
			if ( ( usY - GPIO_DispWindow_Y_Star + LCD_Currentfonts->Height ) > LCD_Y_LENGTH )
			{
				usX = GPIO_DispWindow_X_Star;
				usY = GPIO_DispWindow_Y_Star;
			}			
		
		  GPIO_DispChar_EN ( usX, usY, * pStr );
			
			usX +=  LCD_Currentfonts->Width;
		
		  pStr ++;

		}
		
		else	                            //汉字字符
		{
			if ( ( usX - GPIO_DispWindow_X_Star + WIDTH_CH_CHAR ) > LCD_X_LENGTH )
			{
				usX = GPIO_DispWindow_X_Star;
				usY += HEIGHT_CH_CHAR;
			}
			
			if ( ( usY - GPIO_DispWindow_Y_Star + HEIGHT_CH_CHAR ) > LCD_Y_LENGTH )
			{
				usX = GPIO_DispWindow_X_Star;
				usY = GPIO_DispWindow_Y_Star;
			}	
			
			usCh = * ( uint16_t * ) pStr;	
			
			usCh = ( usCh << 8 ) + ( usCh >> 8 );		

			GPIO_DispChar_CH ( usX, usY, usCh );
			
			usX += WIDTH_CH_CHAR;
			
			pStr += 2;           //一个汉字两个字节 
		
    }
		
  }	
} 

/**
 * @brief  在 GPIO 显示器上显示中英文字符串
 * @param  line ：在特定扫描方向下字符串的起始Y坐标
  *   本参数可使用宏LINE(0)、LINE(1)等方式指定文字坐标，
  *   宏LINE(x)会根据当前选择的字体来计算Y坐标值。
	*		显示中文且使用LINE宏时，需要把英文字体设置成Font8x16
 * @param  pStr ：要显示的字符串的首地址
 * @note 可使用LCD_SetBackColor、LCD_SetTextColor、LCD_SetColors函数设置颜色
 * @retval 无
 */
void GPIO_DispStringLine_EN_CH (  uint16_t line, char * pStr )
{
	uint16_t usCh;
	uint16_t usX = 0;
	
	while( * pStr != '\0' )
	{
		if ( * pStr <= 126 )	           	//英文字符
		{
			if ( ( usX - GPIO_DispWindow_X_Star + LCD_Currentfonts->Width ) > LCD_X_LENGTH )
			{
				usX = GPIO_DispWindow_X_Star;
				line += LCD_Currentfonts->Height;
			}
			
			if ( ( line - GPIO_DispWindow_Y_Star + LCD_Currentfonts->Height ) > LCD_Y_LENGTH )
			{
				usX = GPIO_DispWindow_X_Star;
				line = GPIO_DispWindow_Y_Star;
			}			
		
		  GPIO_DispChar_EN ( usX, line, * pStr );
			
			usX +=  LCD_Currentfonts->Width;
		
		  pStr ++;

		}
		
		else	                            //汉字字符
		{
			if ( ( usX - GPIO_DispWindow_X_Star + WIDTH_CH_CHAR ) > LCD_X_LENGTH )
			{
				usX = GPIO_DispWindow_X_Star;
				line += HEIGHT_CH_CHAR;
			}
			
			if ( ( line - GPIO_DispWindow_Y_Star + HEIGHT_CH_CHAR ) > LCD_Y_LENGTH )
			{
				usX = GPIO_DispWindow_X_Star;
				line = GPIO_DispWindow_Y_Star;
			}	
			
			usCh = * ( uint16_t * ) pStr;	
			
			usCh = ( usCh << 8 ) + ( usCh >> 8 );		

			GPIO_DispChar_CH ( usX, line, usCh );
			
			usX += WIDTH_CH_CHAR;
			
			pStr += 2;           //一个汉字两个字节 
		
    }
		
  }	
} 

/**
 * @brief  在 GPIO 显示器上显示中英文字符串(沿Y轴方向)
 * @param  usX ：在特定扫描方向下字符的起始X坐标
 * @param  usY ：在特定扫描方向下字符的起始Y坐标
 * @param  pStr ：要显示的中英文字符串的首地址
 * @note 可使用LCD_SetBackColor、LCD_SetTextColor、LCD_SetColors函数设置颜色
 * @retval 无
 */
void GPIO_DispString_EN_CH_YDir (  uint16_t usX,uint16_t usY , char * pStr )
{
	uint16_t usCh;
	
	while( * pStr != '\0' )
	{			
			//统一使用汉字的宽高来计算换行
			if ( ( usY - GPIO_DispWindow_Y_Star + HEIGHT_CH_CHAR ) >LCD_Y_LENGTH  )
			{
				usY = GPIO_DispWindow_Y_Star;
				usX += WIDTH_CH_CHAR;
			}			
			if ( ( usX - GPIO_DispWindow_X_Star + WIDTH_CH_CHAR ) >  LCD_X_LENGTH)
			{
				usX = GPIO_DispWindow_X_Star;
				usY = GPIO_DispWindow_Y_Star;
			}
			
		//显示	
		if ( * pStr <= 126 )	           	//英文字符
		{			
			GPIO_DispChar_EN ( usX, usY, * pStr);
			
			pStr ++;
			
			usY += HEIGHT_CH_CHAR;		
		}
		else	                            //汉字字符
		{			
			usCh = * ( uint16_t * ) pStr;	
			
			usCh = ( usCh << 8 ) + ( usCh >> 8 );		

			GPIO_DispChar_CH ( usX,usY , usCh );
			
			usY += HEIGHT_CH_CHAR;
			
			pStr += 2;           //一个汉字两个字节 
		
    }
		
  }	
} 

/***********************缩放字体****************************/
#define ZOOMMAXBUFF 16384
uint8_t zoomBuff[ZOOMMAXBUFF] = {0};	//用于缩放的缓存，最大支持到128*128
uint8_t zoomTempBuff[1024] = {0};

/**
 * @brief  缩放字模，缩放后的字模由1个像素点由8个数据位来表示
										0x01表示笔迹，0x00表示空白区
 * @param  in_width ：原始字符宽度
 * @param  in_heig ：原始字符高度
 * @param  out_width ：缩放后的字符宽度
 * @param  out_heig：缩放后的字符高度
 * @param  in_ptr ：字库输入指针	注意：1pixel 1bit
 * @param  out_ptr ：缩放后的字符输出指针 注意: 1pixel 8bit
 *		out_ptr实际上没有正常输出，改成了直接输出到全局指针zoomBuff中
 * @param  en_cn ：0为英文，1为中文
 * @retval 无
 */
void GPIO_zoomChar(uint16_t in_width,	//原始字符宽度
									uint16_t in_heig,		//原始字符高度
									uint16_t out_width,	//缩放后的字符宽度
									uint16_t out_heig,	//缩放后的字符高度
									uint8_t *in_ptr,	//字库输入指针	注意：1pixel 1bit
									uint8_t *out_ptr, //缩放后的字符输出指针 注意: 1pixel 8bit
									uint8_t en_cn)		//0为英文，1为中文	
{
	uint8_t *pts,*ots;
	//根据源字模及目标字模大小，设定运算比例因子，左移16是为了把浮点运算转成定点运算
	unsigned int xrIntFloat_16=(in_width<<16)/out_width+1; 
  unsigned int yrIntFloat_16=(in_heig<<16)/out_heig+1;
	
	unsigned int srcy_16=0;
	unsigned int y,x;
	uint8_t *pSrcLine;
	
	uint16_t byteCount,bitCount;
	
	//检查参数是否合法
	if(in_width >= 32) return;												//字库不允许超过32像素
	if(in_width * in_heig == 0) return;	
	if(in_width * in_heig >= 1024 ) return; 					//限制输入最大 32*32
	
	if(out_width * out_heig == 0) return;	
	if(out_width * out_heig >= ZOOMMAXBUFF ) return; //限制最大缩放 128*128
	pts = (uint8_t*)&zoomTempBuff;
	
	//为方便运算，字库的数据由1 pixel/1bit 映射到1pixel/8bit
	//0x01表示笔迹，0x00表示空白区
	if(en_cn == 0x00)//英文
	{
		//英文和中文字库上下边界不对，可在此处调整。需要注意tempBuff防止溢出
			for(byteCount=0;byteCount<in_heig*in_width/8;byteCount++)	
			{
				for(bitCount=0;bitCount<8;bitCount++)
					{						
						//把源字模数据由位映射到字节
						//in_ptr里bitX为1，则pts里整个字节值为1
						//in_ptr里bitX为0，则pts里整个字节值为0
						*pts++ = (in_ptr[byteCount] & (0x80>>bitCount))?1:0; 
					}
			}				
	}
	else //中文
	{			
			for(byteCount=0;byteCount<in_heig*in_width/8;byteCount++)	
			{
				for(bitCount=0;bitCount<8;bitCount++)
					{						
						//把源字模数据由位映射到字节
						//in_ptr里bitX为1，则pts里整个字节值为1
						//in_ptr里bitX为0，则pts里整个字节值为0
						*pts++ = (in_ptr[byteCount] & (0x80>>bitCount))?1:0; 
					}
			}		
	}

	//zoom过程
	pts = (uint8_t*)&zoomTempBuff;	//映射后的源数据指针
	ots = (uint8_t*)&zoomBuff;	//输出数据的指针
	for (y=0;y<out_heig;y++)	/*行遍历*/
    {
				unsigned int srcx_16=0;
        pSrcLine=pts+in_width*(srcy_16>>16);				
        for (x=0;x<out_width;x++) /*行内像素遍历*/
        {
            ots[x]=pSrcLine[srcx_16>>16]; //把源字模数据复制到目标指针中
            srcx_16+=xrIntFloat_16;			//按比例偏移源像素点
        }
        srcy_16+=yrIntFloat_16;				  //按比例偏移源像素点
        ots+=out_width;						
    }
	/*！！！缩放后的字模数据直接存储到全局指针zoomBuff里了*/
	out_ptr = (uint8_t*)&zoomBuff;	//out_ptr没有正确传出，后面调用直接改成了全局变量指针！
	
	/*实际中如果使用out_ptr不需要下面这一句！！！
		只是因为out_ptr没有使用，会导致warning。强迫症*/
	out_ptr++; 
}			


/**
 * @brief  利用缩放后的字模显示字符
 * @param  Xpos ：字符显示位置x
 * @param  Ypos ：字符显示位置y
 * @param  Font_width ：字符宽度
 * @param  Font_Heig：字符高度
 * @param  c ：要显示的字模数据
 * @param  DrawModel ：是否反色显示 
 * @retval 无
 */
void GPIO_DrawChar_Ex(uint16_t usX, //字符显示位置x
												uint16_t usY, //字符显示位置y
												uint16_t Font_width, //字符宽度
												uint16_t Font_Height,  //字符高度 
												uint8_t *c,						//字模数据
												uint16_t DrawModel)		//是否反色显示
{
  uint32_t index = 0, counter = 0;

	//设置显示窗口
	GPIO_OpenWindow ( usX, usY, Font_width, Font_Height);
	
	GPIO_Write_Cmd ( CMD_SetPixel );		
	
	//按字节读取字模数据
	//由于前面直接设置了显示窗口，显示数据会自动换行
	for ( index = 0; index < Font_Height; index++ )
	{
			//一位一位处理要显示的颜色
			for ( counter = 0; counter < Font_width; counter++ )
			{
					//缩放后的字模数据，以一个字节表示一个像素位
					//整个字节值为1表示该像素为笔迹
					//整个字节值为0表示该像素为背景
					if ( *c++ == DrawModel )
						GPIO_Write_Data ( CurrentBackColor );			
					else
						GPIO_Write_Data ( CurrentTextColor );
			}	
	}	
}


/**
 * @brief  利用缩放后的字模显示字符串
 * @param  Xpos ：字符显示位置x
 * @param  Ypos ：字符显示位置y
 * @param  Font_width ：字符宽度，英文字符在此基础上/2。注意为偶数
 * @param  Font_Heig：字符高度，注意为偶数
 * @param  c ：要显示的字符串
 * @param  DrawModel ：是否反色显示 
 * @retval 无
 */
void GPIO_DisplayStringEx(uint16_t x, 		//字符显示位置x
														 uint16_t y, 				//字符显示位置y
														 uint16_t Font_width,	//要显示的字体宽度，英文字符在此基础上/2。注意为偶数
														 uint16_t Font_Height,	//要显示的字体高度，注意为偶数
														 uint8_t *ptr,					//显示的字符内容
														 uint16_t DrawModel)  //是否反色显示



{
	uint16_t Charwidth = Font_width; //默认为Font_width，英文宽度为中文宽度的一半
	uint8_t *psr;
	uint8_t Ascii;	//英文
	uint16_t usCh;  //中文
	uint8_t ucBuffer [ WIDTH_CH_CHAR*HEIGHT_CH_CHAR/8 ];	
	
	while ( *ptr != '\0')
	{
			/****处理换行*****/
			if ( ( x - GPIO_DispWindow_X_Star + Charwidth ) > LCD_X_LENGTH )
			{
				x = GPIO_DispWindow_X_Star;
				y += Font_Height;
			}
			
			if ( ( y - GPIO_DispWindow_Y_Star + Font_Height ) > LCD_Y_LENGTH )
			{
				x = GPIO_DispWindow_X_Star;
				y = GPIO_DispWindow_Y_Star;
			}	
			
		if(*ptr > 0x80) //如果是中文
		{			
			Charwidth = Font_width;
			usCh = * ( uint16_t * ) ptr;				
			usCh = ( usCh << 8 ) + ( usCh >> 8 );
			//GetGBKCode ( ucBuffer, usCh );	//取字模数据
			//缩放字模数据，源字模为16*16
			GPIO_zoomChar(WIDTH_CH_CHAR,HEIGHT_CH_CHAR,Charwidth,Font_Height,(uint8_t *)&ucBuffer,psr,1); 
			//显示单个字符
			GPIO_DrawChar_Ex(x,y,Charwidth,Font_Height,(uint8_t*)&zoomBuff,DrawModel);
			x+=Charwidth;
			ptr+=2;
		}
		else
		{
				Charwidth = Font_width / 2;
				Ascii = *ptr - 32;
				//使用16*24字体缩放字模数据
				GPIO_zoomChar(16,24,Charwidth,Font_Height,(uint8_t *)&Font16x24.table[Ascii * Font16x24.Height*Font16x24.Width/8],psr,0);
			  //显示单个字符
				GPIO_DrawChar_Ex(x,y,Charwidth,Font_Height,(uint8_t*)&zoomBuff,DrawModel);
				x+=Charwidth;
				ptr++;
		}
	}
}


/**
 * @brief  利用缩放后的字模显示字符串(沿Y轴方向)
 * @param  Xpos ：字符显示位置x
 * @param  Ypos ：字符显示位置y
 * @param  Font_width ：字符宽度，英文字符在此基础上/2。注意为偶数
 * @param  Font_Heig：字符高度，注意为偶数
 * @param  c ：要显示的字符串
 * @param  DrawModel ：是否反色显示 
 * @retval 无
 */
void GPIO_DisplayStringEx_YDir(uint16_t x, 		//字符显示位置x
																		 uint16_t y, 				//字符显示位置y
																		 uint16_t Font_width,	//要显示的字体宽度，英文字符在此基础上/2。注意为偶数
																		 uint16_t Font_Height,	//要显示的字体高度，注意为偶数
																		 uint8_t *ptr,					//显示的字符内容
																		 uint16_t DrawModel)  //是否反色显示
{
	uint16_t Charwidth = Font_width; //默认为Font_width，英文宽度为中文宽度的一半
	uint8_t *psr;
	uint8_t Ascii;	//英文
	uint16_t usCh;  //中文
	uint8_t ucBuffer [ WIDTH_CH_CHAR*HEIGHT_CH_CHAR/8 ];	
	
	while ( *ptr != '\0')
	{			
			//统一使用汉字的宽高来计算换行
			if ( ( y - GPIO_DispWindow_X_Star + Font_width ) > LCD_X_LENGTH )
			{
				y = GPIO_DispWindow_X_Star;
				x += Font_width;
			}
			
			if ( ( x - GPIO_DispWindow_Y_Star + Font_Height ) > LCD_Y_LENGTH )
			{
				y = GPIO_DispWindow_X_Star;
				x = GPIO_DispWindow_Y_Star;
			}	
			
		if(*ptr > 0x80) //如果是中文
		{			
			Charwidth = Font_width;
			usCh = * ( uint16_t * ) ptr;				
			usCh = ( usCh << 8 ) + ( usCh >> 8 );
			//GetGBKCode ( ucBuffer, usCh );	//取字模数据
			//缩放字模数据，源字模为16*16
			GPIO_zoomChar(WIDTH_CH_CHAR,HEIGHT_CH_CHAR,Charwidth,Font_Height,(uint8_t *)&ucBuffer,psr,1); 
			//显示单个字符
			GPIO_DrawChar_Ex(x,y,Charwidth,Font_Height,(uint8_t*)&zoomBuff,DrawModel);
			y+=Font_Height;
			ptr+=2;
		}
		else
		{
				Charwidth = Font_width / 2;
				Ascii = *ptr - 32;
				//使用16*24字体缩放字模数据
				GPIO_zoomChar(16,24,Charwidth,Font_Height,(uint8_t *)&Font16x24.table[Ascii * Font16x24.Height*Font16x24.Width/8],psr,0);
			  //显示单个字符
				GPIO_DrawChar_Ex(x,y,Charwidth,Font_Height,(uint8_t*)&zoomBuff,DrawModel);
				y+=Font_Height;
				ptr++;
		}
	}
}

/**
  * @brief  设置英文字体类型
  * @param  fonts: 指定要选择的字体
	*		参数为以下值之一
  * 	@arg：Font24x32;
  * 	@arg：Font16x24;
  * 	@arg：Font8x16;
  * @retval None
  */
void LCD_SetFont(sFONT *fonts)
{
  LCD_Currentfonts = fonts;
}

/**
  * @brief  获取当前字体类型
  * @param  None.
  * @retval 返回当前字体类型
  */
sFONT *LCD_GetFont(void)
{
  return LCD_Currentfonts;
}


/**
  * @brief  设置LCD的前景(字体)及背景颜色,RGB565
  * @param  TextColor: 指定前景(字体)颜色
  * @param  BackColor: 指定背景颜色
  * @retval None
  */
void LCD_SetColors(uint16_t TextColor, uint16_t BackColor) 
{
  CurrentTextColor = TextColor; 
  CurrentBackColor = BackColor;
}

/**
  * @brief  获取LCD的前景(字体)及背景颜色,RGB565
  * @param  TextColor: 用来存储前景(字体)颜色的指针变量
  * @param  BackColor: 用来存储背景颜色的指针变量
  * @retval None
  */
void LCD_GetColors(uint16_t *TextColor, uint16_t *BackColor)
{
  *TextColor = CurrentTextColor;
  *BackColor = CurrentBackColor;
}

/**
  * @brief  设置LCD的前景(字体)颜色,RGB565
  * @param  Color: 指定前景(字体)颜色 
  * @retval None
  */
void LCD_SetTextColor(uint16_t Color)
{
  CurrentTextColor = Color;
}

/**
  * @brief  设置LCD的背景颜色,RGB565
  * @param  Color: 指定背景颜色 
  * @retval None
  */
void LCD_SetBackColor(uint16_t Color)
{
  CurrentBackColor = Color;
}

/**
  * @brief  清除某行文字
  * @param  Line: 指定要删除的行
  *   本参数可使用宏LINE(0)、LINE(1)等方式指定要删除的行，
  *   宏LINE(x)会根据当前选择的字体来计算Y坐标值，并删除当前字体高度的第x行。
  * @retval None
  */
void LCD_ClearLine(uint16_t Line)
{
  GPIO_Clear(0,Line,LCD_X_LENGTH,((sFONT *)LCD_GetFont())->Height);	/* 清屏，显示全黑 */

}
/*********************end of file*************************/




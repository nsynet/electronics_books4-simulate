//-----------------------------------------------------------
//程序由AVR辅助开发工具V2.1.0自动生成     
//MCU系统的处理器为：    ATMega16
//MCU系统的晶振频率：    8.0000 Mhz
//-----------------------------------------------------------

#include <iom16v.h>
#include "uart.h"

unsigned char rx_buff = 0;       //串口接收中断缓冲区

//-----------------------------------------------------------
//串口初始化子程序
//字符长度：8位
//奇偶校验：禁止
//通讯模式：异步
//-----------------------------------------------------------
void Uart_Init(void)
{
    UCSRB  =  0x00;     //disable while setting baud rate
    UCSRA  =  0x00;     //Bit1为1则倍速发送
    UCSRC  =  0x86;  
    UBRRL  =  0x19;     //波特率：19200 Bps
    UBRRH  =  0x00;     //误差率：0.156%
    UCSRB  =  0x98;  
}

//-----------------------------------------------------------
//串口接收中断子程序
//-----------------------------------------------------------
#pragma interrupt_handler Uart_Rx_Isr:iv_USART_RX
void Uart_Rx_Isr(void)
{
//uart has received a character in UDR
//   unsigned char c;
   rx_buff = UDR;
}

//-----------------------------------------------------------
//串口发送字节子程序
//-----------------------------------------------------------
void Putchar(unsigned char c)
{
   while (!(UCSRA&(1<<UDRE)));
   UDR=c;
}

//-----------------------------------------------------------
//串口发送字符串子程序
//-----------------------------------------------------------
void Putstr(char *s)
{
   while (*s)
   {
      Putchar(*s);
      s++;
   }
}

//-----------------------------------------------------------
//串口发送字符串子程序(带有换行符)
//-----------------------------------------------------------
void Puts(char *s)
{
   while (*s)
   {
      Putchar(*s);
      s++;
   }
   Putchar(0x0d);   //回车换行
   Putchar(0x0a);
}

//-----------------------------------------------------------
//数组转换成可发送的字符串
//-----------------------------------------------------------
char *buffer2str(char *hhh)
{
   unsigned char i=0;

   while (i<40)
   {
      hhh[i]=hhh[i]+48;
      i++;
   }	
   return hhh;
}

//-----------------------------------------------------------
//数字转换成可发送的字符串
//-----------------------------------------------------------
char *long2str(unsigned long hh)
{
   char *ss="    ";

   ss[0]=48+hh/1000;
   ss[1]=48+(hh%1000)/100;
   ss[2]=48+(hh%100)/10;
   ss[3]=48+(hh%10);

   return ss;	
}

